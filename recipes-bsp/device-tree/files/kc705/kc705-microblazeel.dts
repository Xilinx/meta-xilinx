/*
 * CAUTION: This file is automatically generated by Xilinx.
 * Version:  
 * Today is: Wed Aug  2 18:22:34 2017
 */


/dts-v1/;
/include/ "pl.dtsi"
/include/ "kc705-full.dtsi"
/ {
	hard-reset-gpios = <&reset_gpio 0 1>;
	chosen {
		bootargs = "earlycon";
		stdout-path = "serial0:115200n8";
	};
	aliases {
		ethernet0 = &axi_ethernet;
		i2c0 = &iic_main;
		serial0 = &rs232_uart;
	};
	memory {
		device_type = "memory";
		reg = <0x80000000 0x40000000>;
	};
};
/include/ "system-conf.dtsi"
