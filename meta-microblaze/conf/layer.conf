## meta-microblaze/conf/layer.conf
```bitbake
# We have a conf and classes directory, add to BBPATH
BBPATH .= ":${LAYERDIR}"

# We have a packages directory, add to BBFILES
BBFILES += "${LAYERDIR}/recipes-*/*/*.bb"
BBFILES += "${LAYERDIR}/recipes-*/*/*.bbappend"

BBFILE_COLLECTIONS += "xilinx-microblaze"
BBFILE_PATTERN_xilinx-microblaze = "^${LAYERDIR}/"
BBFILE_PRIORITY_xilinx-microblaze = "5"

LAYERSUMMARY_xilinx-microblaze = "AMD MicroBlaze architecture \
enablement"
LAYERDESCRIPTION_xilinx-microblaze = "Architecture enablement layer \
adding MicroBlaze and MicroBlaze-V (RISC-V) tunings, multilibs, and \
helpers used by AMD's standalone and embedded software flows."

LAYERDEPENDS_xilinx-microblaze = "core"

LAYERSERIES_COMPAT_xilinx-microblaze = "blacksail"

# Microblaze does not support stack-protector!
SECURITY_STACK_PROTECTOR:microblaze = ""

OLDEST_KERNEL:microblaze = "3.15"
```
