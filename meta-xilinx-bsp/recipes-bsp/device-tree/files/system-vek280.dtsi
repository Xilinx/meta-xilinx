/ {
/* Reserve the bad block DDR memory for linux to not touch it, refer:CR-1143646 */
reserved-memory {
        #address-cells = <2>;
        #size-cells = <2>;
        ranges;
        pl_ddr: buffer@0
        {
        no-map;
        reg = <0x08 0x00 0x00 0x80000000>;
        };

        lpddr_memory: buffer@1
        {
        no-map;
        reg = <0x500 0x0 0x2 0x0>;
        };

};
};
