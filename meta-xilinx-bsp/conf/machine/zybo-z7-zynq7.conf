## meta-xilinx-core/conf/machine/include/soc-tune-include.inc
```bitbake
DEFAULTTUNE ??= "armv8a"

# Unfortunately various tunefiles don't include each other, so create
# a list of things to require based on the DEFAULTTUNE setting.
TUNEFILE[cortexr5] = "conf/machine/include/arm/armv7r/tune-cortexr5.inc"
TUNEFILE[cortexr5hf] = "conf/machine/include/arm/armv7r/tune-cortexr5.inc"
TUNEFILE[cortexr52] = "conf/machine/include/arm/armv8r/tune-cortexr52.inc"
TUNEFILE[cortexr52hf] = "conf/machine/include/arm/armv8r/tune-cortexr52.inc"
TUNEFILE[cortexa9thf-neon] = "conf/machine/include/arm/armv7a/tune-cortexa9.inc"
TUNEFILE[cortexa9] = "conf/machine/include/arm/armv7a/tune-cortexa9.inc"
TUNEFILE[armv8a] = "conf/machine/include/arm/arch-armv8a.inc"
TUNEFILE[cortexa53] = "conf/machine/include/arm/armv8a/tune-cortexa53.inc"
TUNEFILE[cortexa72] = "conf/machine/include/arm/armv8a/tune-cortexa72.inc"
TUNEFILE[cortexa78] = "conf/machine/include/arm/armv8-2a/tune-cortexa78.inc"
TUNEFILE[cortexa72-cortexa53] = "conf/machine/include/arm/armv8a/tune-cortexa72-cortexa53.inc"
TUNEFILE[cortexa72-cortexa53-crypto] = "conf/machine/include/arm/armv8a/tune-cortexa72-cortexa53.inc"
TUNEFILE[microblaze] = "conf/machine/include/xilinx-microblaze.inc"

# Capture the defaulttune, to make sure it's been modified in the right order
DEFAULTTUNE_PRIOR := "${DEFAULTTUNE}"

# Default to arch-armv8a.inc
TUNEFILE = "${@ d.getVarFlag('TUNEFILE', d.getVar('DEFAULTTUNE')) or 'conf/machine/include/arm/arch-armv8a.inc'}"

require ${TUNEFILE}
```

## meta-xilinx-core/conf/machine/include/soc-versal-2ve-2vm.inc
```bitbake
# This has a cortex-a78, but for compatibility set the same as versal
DEFAULTTUNE ?= "cortexa72-cortexa53"

SOC_FAMILY ?= "versal-2ve-2vm"

require conf/machine/include/soc-family.inc
require conf/machine/include/soc-tune-include.inc

# Linux Configuration
ARCH_DEFAULT_KERNELIMAGETYPE:versal-2ve-2vm = "Image"

UBOOT_ELF ?= "u-boot.elf"

# Default, if multiconfig is off, call plm/psm-firmware directly, otherwise call the versal-fw multiconfig version
# The Linux compatible plm/psm-firmware though requires meta-xilinx-tools
PLM_DEPENDS ??= ""
PLM_MCDEPENDS ??= ""
PLM_DEPLOY_DIR ??= "${DEPLOY_DIR_IMAGE}"
PLM_IMAGE_NAME ??= "plm-${MACHINE}"
PLM_DEPLOY_DIR[vardepsexclude] += "TOPDIR"

ASU_DEPENDS ??= ""
ASU_MCDEPENDS ??= ""
ASU_DEPLOY_DIR ??= "${DEPLOY_DIR_IMAGE}"
ASU_IMAGE_NAME ??= "asu-${MACHINE}"
ASU_DEPLOY_DIR[vardepsexclude] += "TOPDIR"

# versal 2ve 2vm (AM026 Table: Primary Boot Interfaces Table):
# 1: QSPI24
# 2: QSPI32
# 3: SD v3.0 first
# 5: SD v2.0
# 6: eMMC (v5.1)
# 8: OSPI
# 11: UFS
# 14: SD v3.0 second
#
# Note: JTAG is defined as 0, but this is not a primary boot mode
#
# If the user does not want to use any of the AVAIL_HW_BOOT_MODES then
# DEFAULT_HW_BOOT_MODE should be blank (or unset)
#
AVAIL_HW_BOOT_MODES = "1 2 3 5 6 8 11 14"

# Verbose mapping for debug
SOC_BOOT_MODE_MAPPING = "1:QSPI24 2:QSPI32 3:SD0_v3.0 5:SD0_v2.0 6:eMMC_v5.1 8:OSPI 11:UFS 14:SD1_v3.0"

# The boot modes that require a boot.bin on the disk
# Note: the disk must be msdos (or gpt-hybrid) partitioned
#       partition 1 must be FAT16/32 (or vFAT)
#       boot.bin file named "boot.bin" or "bootXXXX.bin" where XXXX is 8191 or less.
SOC_DISK_BOOT_MODE_MAPPING = "3 5 6 11 14"
```

## meta-xilinx-core/conf/machine/include/soc-versal-net.inc
```bitbake
DEFAULTTUNE ?= "cortexa72-cortexa53"
SOC_FAMILY ?= "versal-net"

require conf/machine/include/soc-family.inc
require soc-tune-include.inc

# Linux Configuration
KERNEL_IMAGETYPE ?= "Image"

UBOOT_ELF ?= "u-boot.elf"

# Default, if multiconfig is off, call plm/psm-firmware directly, otherwise call the versal-fw multiconfig version
# The Linux compatible plm/psm-firmware though requires meta-xilinx-tools
PLM_DEPENDS ??= ""
PLM_MCDEPENDS ??= ""
PLM_DEPLOY_DIR ??= "${DEPLOY_DIR_IMAGE}"
PLM_IMAGE_NAME ??= "plm-${MACHINE}"
PLM_DEPLOY_DIR[vardepsexclude] += "TOPDIR"

PSM_DEPENDS ??= ""
PSM_MCDEPENDS ??= ""
PSM_FIRMWARE_DEPLOY_DIR ??= "${DEPLOY_DIR_IMAGE}"
PSM_FIRMWARE_IMAGE_NAME ??= "psm-firmware-${MACHINE}"
PSM_DEPLOY_DIR[vardepsexclude] += "TOPDIR"
```

## meta-xilinx-core/conf/machine/include/soc-versal.inc
```bitbake
DEFAULTTUNE ?= "cortexa72-cortexa53"
SOC_FAMILY ?= "versal"

# Available MACHINE_FETURES for versal processors:
# prime   - (none)
# premium - aie
# hbm     - (none)
# ai-core - aie, vdu
# ai-edge - aie, vdu

require conf/machine/include/soc-family.inc
require soc-tune-include.inc

# Linux Configuration
ARCH_DEFAULT_KERNELIMAGETYPE:versal = "Image"

UBOOT_ELF ?= "u-boot.elf"

# Default, if multiconfig is off, call plm/psm-firmware directly, otherwise call the versal-fw multiconfig version
# The Linux compatible plm/psm-firmware though requires meta-xilinx-tools
PLM_DEPENDS ??= ""
PLM_MCDEPENDS ??= ""
PLM_DEPLOY_DIR ??= "${DEPLOY_DIR_IMAGE}"
PLM_IMAGE_NAME ??= "plm-${MACHINE}"
PLM_DEPLOY_DIR[vardepsexclude] += "TOPDIR"

PSM_DEPENDS ??= ""
PSM_MCDEPENDS ??= ""
PSM_FIRMWARE_DEPLOY_DIR ??= "${DEPLOY_DIR_IMAGE}"
PSM_FIRMWARE_IMAGE_NAME ??= "psm-firmware-${MACHINE}"
PSM_DEPLOY_DIR[vardepsexclude] += "TOPDIR"

# versal (AM011 See Table: Primary Boot Interfaces Table):
# 1: QSPI24
# 2: QSPI32
# 3: SD0 v3.0
# 5: SD1 (v2.0)
# 6: eMMC1 (v4.51)
# 8: OSPI
# 14: SD1 (v3.0)
#
# Note: JTAG is defined as 0, but this is not a primary boot mode
#
# If the user does not want to use any of the AVAIL_HW_BOOT_MODES then
# DEFAULT_HW_BOOT_MODE should be blank (or unset)
#
AVAIL_HW_BOOT_MODES = "1 2 3 5 6 8 14"

# Verbose mapping for debug
SOC_BOOT_MODE_MAPPING = "1:QSPI24 2:QSPI32 3:SD0_v3.0 5:SD1_v2.0 6:eMMC_v4.51 8:OSPI 14:SD1_v3.0"

# The boot modes that require a boot.bin on the disk
# Note: the disk must be msdos (or gpt-hybrid) partitioned
#       partition 1 must be FAT16/32 (or vFAT)
#       boot.bin file named "boot.bin" or "bootXXXX.bin" where XXXX is 8191 or less.
SOC_DISK_BOOT_MODE_MAPPING = "3 5 6 14"
```

## meta-xilinx-core/conf/machine/include/soc-zynq.inc
```bitbake
DEFAULTTUNE ?= "cortexa9thf-neon"
SOC_FAMILY ?= "zynq"

require conf/machine/include/soc-family.inc
require soc-tune-include.inc

# Linux Configuration
ARCH_DEFAULT_KERNELIMAGETYPE:zynq = "uImage"

UBOOT_ELF ?= "u-boot.elf"

# zynq (UG585 See Boot Mode MIO Strapping Pins):
# 1: QSPI
# 2: NOR
# 4: NAND
# 5: SD Card
#
# Note: JTAG is defined as 0, but this is not a primary boot mode
#
# If the user does not want to use any of the AVAIL_HW_BOOT_MODES then
# DEFAULT_HW_BOOT_MODE should be blank (or unset)
#
AVAIL_HW_BOOT_MODES = "1 2 4 5"

# Verbose mapping for debug
SOC_BOOT_MODE_MAPPING = "1:QSPI 2:NOR 3:NAND 5:SD"

# The boot modes that require a boot.bin on the disk
# Note: the disk must be msdos (or gpt-hybrid) partitioned
#       partition 1 must be FAT16/32 (or vFAT)
#       boot.bin file named "boot.bin"
SOC_DISK_BOOT_MODE_MAPPING = "5"
```

## meta-xilinx-core/conf/machine/include/soc-zynqmp.inc
```bitbake
DEFAULTTUNE ?= "cortexa72-cortexa53"
SOC_FAMILY ?= "zynqmp"

# Available MACHINE_FETURES for zynqmp processors:
# zynqmp-cg - (none)
# zynqmp-eg - mali400
# zynqmp-ev - mali400, vcu
# zynqmp-dr - rfsoc

require conf/machine/include/soc-family.inc
require soc-tune-include.inc

# Linux Configuration
ARCH_DEFAULT_KERNELIMAGETYPE:zynqmp = "Image"

# Support multilib on zynqmp
DEFAULTTUNE:virtclass-multilib-lib32 ?= "armv7vethf-neon-vfpv4"

UBOOT_SUFFIX ?= "bin"

XSERVER_EXT:zynqmp ?= "xf86-video-armsoc"

# Default expects the user to provide a specific pmu-firwmare in the deploy
# directory, named "pmu-firmware-${MACHINE}.elf"
PMU_DEPENDS ??= ""
PMU_MCDEPENDS ??= ""
PMU_FIRMWARE_DEPLOY_DIR ??= "${DEPLOY_DIR_IMAGE}"
PMU_FIRMWARE_IMAGE_NAME ??= "pmu-firmware-${MACHINE}"

PMU_FIRMWARE_DEPLOY_DIR[vardepsexclude] += "TOPDIR"

# zynqmp (UG1085 See Table 11-1: Boot Modes):
# 1: QSPI (24b)
# 2: QSPI (32b)
# 3: SD0 (2.0)
# 4: NAND
# 5: SD1 (2.0)
# 6: eMMC (1.8V)
# 14: SD1 LS (3.0)
#
# Note: JTAG is defined as 0, but this is not a primary boot mode
#
# If the user does not want to use any of the AVAIL_HW_BOOT_MODES then
# DEFAULT_HW_BOOT_MODE should be blank (or unset)
#
AVAIL_HW_BOOT_MODES = "1 2 3 4 5 6 14"

# Verbose mapping for debug
SOC_BOOT_MODE_MAPPING = "1:QSPI_24b 2:QSPI_32b 3:SD_2.0 4:NAND 5:SD1_2.0 6:eMMC_1.8V 14:SD1_LS_3.0"

# The boot modes that require a boot.bin on the disk
# Note: the disk must be msdos (or gpt-hybrid) partitioned
#       partition 1 must be FAT16/32 (or vFAT)
#       boot.bin file named "boot.bin" or "bootXXXX.bin" where XXXX is 8191 or less.
SOC_DISK_BOOT_MODE_MAPPING = "3 5 6 14"
```
