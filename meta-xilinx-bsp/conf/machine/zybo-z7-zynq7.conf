## meta-xilinx-bsp/conf/machine/zybo-z7-zynq7.conf
```bitbake
#@TYPE: Machine
#@NAME: zybo-z7-zynq7
#@DESCRIPTION: Machine support for ZYBO Z7.
#
# For details on the ZYBO Z7 board:
#     https://reference.digilentinc.com/reference/programmable-logic/zybo-z7/start
#

SOC_VARIANT ?= "7z"

require conf/machine/include/tune-zynq.inc
require conf/machine/include/machine-xilinx-overrides.inc
require conf/machine/include/machine-xilinx-default.inc

MACHINE_FEATURES = "ext2 vfat usbhost usbgadget"

# u-boot configuration
PREFERRED_PROVIDER_virtual/bootloader = "u-boot"
UBOOT_MACHINE = "zynq_zybo_z7_config"
SPL_BINARY ?= "spl/boot.bin"
UBOOT_ELF_zynq = "u-boot"

EXTRA_IMAGEDEPENDS += " \
		u-boot-zynq-uenv \
		virtual/boot-bin \
		virtual/bootloader \
		u-boot-zynq-scr \
		"

SERIAL_CONSOLE = "115200 ttyPS0"

KERNEL_DEVICETREE = "zynq-zybo-z7.dtb"

IMAGE_BOOT_FILES += " \
		boot.bin \
		uEnv.txt \
		"
```

## meta-xilinx-bsp/conf/machine/zynq-generic.conf
```bitbake
#@TYPE: Machine
#@NAME:
#@DESCRIPTION: zynq devices

require conf/machine/include/soc-zynq.inc
require conf/machine/include/machine-xilinx-default.inc
require conf/machine/include/machine-xilinx-qemu.inc

MACHINE_FEATURES = "rtc ext2 ext3 vfat usbhost usbgadget"

EXTRA_IMAGEDEPENDS += "libyaml-native python3-cython-native python3-pyyaml-native"
```

## meta-xilinx-bsp/conf/machine/zynqmp-generic.conf
```bitbake
#@TYPE: Machine
#@NAME:
#@DESCRIPTION: zynqmp devices

require conf/machine/include/tune-zynqmp.inc
require conf/machine/include/machine-xilinx-overrides.inc
require conf/machine/include/machine-xilinx-default.inc

MACHINE_FEATURES = "rtc ext2 ext3 vfat usbhost"

EXTRA_IMAGEDEPENDS += "libyaml-native python3-cython-native python3-pyyaml-native"
```

## meta-xilinx-contrib/conf/layer.conf
```bitbake
# We have a conf and classes directory, add to BBPATH
BBPATH .= ":${LAYERDIR}"

# We have a packages directory, add to BBFILES
BBFILES += " \
    ${LAYERDIR}/recipes-*/*/*.bb \
    ${LAYERDIR}/recipes-*/*/*.bbappend \
    "

BBFILES_DYNAMIC += " \
    xilinx-tools:${LAYERDIR}/dynamic-layers/meta-xilinx-tools/recipes-*/*/*.bb \
    xilinx-tools:${LAYERDIR}/dynamic-layers/meta-xilinx-tools/recipes-*/*/*.bbappend \
    "

BBFILE_COLLECTIONS += "xilinx-contrib"
BBFILE_PATTERN_xilinx-contrib = "^${LAYERDIR}/"
BBFILE_PRIORITY_xilinx-contrib = "5"

LAYERSUMMARY_xilinx-contrib = "Community-contributed AMD Xilinx BSPs"
LAYERDESCRIPTION_xilinx-contrib = "Community / third-party BSP \
contribution layer carrying machines and recipes for AMD Xilinx \
hardware that is not part of the core supported set."

LAYERDEPENDS_xilinx-contrib = " \
    core \
    xilinx \
    "

LAYERSERIES_COMPAT_xilinx-contrib = "scarthgap"
```

## meta-xilinx-contrib/conf/machine/ml605-qemu-microblazeel.conf
```bitbake
#@TYPE: Machine
#@NAME: ml605-qemu-microblazeel
#@DESCRIPTION: Machine configuration for QEMU emulating the Xilinx ML605 evaluation board (Virtex-6 FPGA) with a little-endian MicroBlaze soft processor; uses the QEMU 'petalogix-ml605' machine model.

TUNE_FEATURES:tune-microblaze ?= "microblaze v8.50 barrel-shift reorder pattern-compare divide-hard multiply-high fpu-hard"

require conf/machine/microblaze-generic.conf

USE_VT = ""

# Use the networking setup from qemuarm
MACHINEOVERRIDES:prepend:pn-init-ifupdown = "qemuall:"
FILESOVERRIDES:append:pn-init-ifupdown = ":qemuarm"

# This machine is a targeting a QEMU model, runqemu setup:
QB_MEM = "-m 256"
QB_MACHINE = "-machine petalogix-ml605"
QB_OPT_APPEND = "-nographic -serial mon:stdio"
QB_NETWORK_DEVICE = "-net nic,netdev=net0,macaddr=@MAC@"
```

## meta-xilinx-core/conf/layer.conf
```bitbake
# We have a conf and classes directory, add to BBPATH
BBPATH .= ":${LAYERDIR}"

# We have a packages directory, add to BBFILES
BBFILES += "${LAYERDIR}/recipes-*/*/*.bb"
BBFILES += "${LAYERDIR}/recipes-*/*/*.bbappend"

BBFILE_COLLECTIONS += "xilinx"
BBFILE_PATTERN_xilinx = "^${LAYERDIR}/"
BBFILE_PRIORITY_xilinx = "5"

BBFILES_DYNAMIC += " \
meta-mingw:${LAYERDIR}/dynamic-layers/meta-mingw/recipes-*/*/*.bb \
meta-mingw:${LAYERDIR}/dynamic-layers/meta-mingw/recipes-*/*/*.bbappend \
openembedded-layer:${LAYERDIR}/dynamic-layers/openembedded-layer/recipes-*/*/*.bb \
openembedded-layer:${LAYERDIR}/dynamic-layers/openembedded-layer/recipes-*/*/*.bbappend \
meta-python:${LAYERDIR}/dynamic-layers/meta-python/recipes-*/*/*.bb \
meta-python:${LAYERDIR}/dynamic-layers/meta-python/recipes-*/*/*.bbappend \
multimedia-layer:${LAYERDIR}/dynamic-layers/multimedia-layer/recipes-*/*/*.bb \
multimedia-layer:${LAYERDIR}/dynamic-layers/multimedia-layer/recipes-*/*/*.bbappend \
networking-layer:${LAYERDIR}/dynamic-layers/networking-layer/recipes-*/*/*.bb \
networking-layer:${LAYERDIR}/dynamic-layers/networking-layer/recipes-*/*/*.bbappend \
openamp-layer:${LAYERDIR}/dynamic-layers/openamp-layer/recipes-*/*/*.bb \
openamp-layer:${LAYERDIR}/dynamic-layers/openamp-layer/recipes-*/*/*.bbappend \
virtualization-layer:${LAYERDIR}/dynamic-layers/virtualization-layer/recipes-*/*/*.bb \
virtualization-layer:${LAYERDIR}/dynamic-layers/virtualization-layer/recipes-*/*/*.bbappend \
xilinx-tools:${LAYERDIR}/dynamic-layers/meta-xilinx-tools/recipes-*/*/*.bb \
xilinx-tools:${LAYERDIR}/dynamic-layers/meta-xilinx-tools/recipes-*/*/*.bbappend \
core:${LAYERDIR}/dynamic-layers/poky/recipes-*/*/*.bb \
core:${LAYERDIR}/dynamic-layers/poky/recipes-*/*/*.bbappend \
"

LAYERDEPENDS_xilinx = "core meta-arm"
LAYERRECOMMENDS_xilinx = "openembedded-layer networking-layer"

LAYERPATH_xilinx = "${LAYERDIR}"

LAYERSERIES_COMPAT_xilinx = "scarthgap"

SIGGEN_EXCLUDE_SAFE_RECIPE_DEPS += " \
  *->xrt \
  *->zocl \
  *->cairo \
  *->libepoxy \
  *->gstreamer1.0-plugins-base \
  *->gtk+ \
  *->gtk+3 \
  *->libglu \
  *->libsdl \
  *->libsdl2 \
  *->qemu \
  *->xserver-xorg \
"

XILINX_RELEASE_VERSION ??= "v2026.1"

BUILDCFG_VARS:append = " XILINX_RELEASE_VERSION"

XILINX_ATF_VERSION[v2023.1] = "2.8-xilinx-v2023.1%"
XILINX_ATF_VERSION[v2023.2] = "2.8-xilinx-v2023.2%"
XILINX_ATF_VERSION[v2024.1] = "2.10-xilinx-v2024.1%"
XILINX_ATF_VERSION[v2024.2] = "2.10-xilinx-v2024.2%"
XILINX_ATF_VERSION[v2025.1] = "2.12-xilinx-v2025.1%"
XILINX_ATF_VERSION[v2025.2] = "2.12-xilinx-v2025.2%"
XILINX_ATF_VERSION[v2026.1] = "2.14-xilinx-v2026.1%"
PREFERRED_VERSION_virtual/arm-trusted-firmware ?= "${@d.getVarFlag('XILINX_ATF_VERSION', d.getVar('XILINX_RELEASE_VERSION')) or 'undefined'}"

# The name of the software has changed to match upstream ARM
XILINX_ATF_PROVIDERS[v2024.2] = "trusted-firmware-a"
XILINX_ATF_PROVIDERS[v2025.1] = "trusted-firmware-a"
XILINX_ATF_PROVIDERS[v2025.2] = "trusted-firmware-a"
XILINX_ATF_PROVIDERS[v2026.1] = "trusted-firmware-a"
PREFERRED_PROVIDER_virtual/arm-trusted-firmware = "${@d.getVarFlag('XILINX_ATF_PROVIDERS', d.getVar('XILINX_RELEASE_VERSION')) or 'arm-trusted-firmware'}"

XILINX_OPTEE_CLIENT[v2025.1] = "4.5.0-xlnx-v2025.1%"
XILINX_OPTEE_CLIENT[v2025.2] = "4.5.0-xlnx-v2025.1%"
XILINX_OPTEE_CLIENT[v2026.1] = "4.9.0-xlnx-v2026.1%"
PREFERRED_VERSION_optee-client ?= "${@d.getVarFlag('XILINX_OPTEE_CLIENT', d.getVar('XILINX_RELEASE_VERSION')) or 'undefined'}"

XILINX_OPTEE_EXAMPLES[v2025.1] = "4.5.0-xlnx-v2025.1%"
XILINX_OPTEE_EXAMPLES[v2025.2] = "4.5.0-xlnx-v2025.2%"
XILINX_OPTEE_EXAMPLES[v2026.1] = "4.9.0-xlnx-v2026.1%"
PREFERRED_VERSION_optee-examples ?= "${@d.getVarFlag('XILINX_OPTEE_EXAMPLES', d.getVar('XILINX_RELEASE_VERSION')) or 'undefined'}"

XILINX_OPTEE_OS[v2025.1] = "4.5.0-xlnx-v2025.1%"
XILINX_OPTEE_OS[v2025.2] = "4.5.0-xlnx-v2025.2%"
XILINX_OPTEE_OS[v2026.1] = "4.9.0-xlnx-v2026.1%"
PREFERRED_VERSION_optee-os ?= "${@d.getVarFlag('XILINX_OPTEE_OS', d.getVar('XILINX_RELEASE_VERSION')) or 'undefined'}"

XILINX_OPTEE_OS_TADEKIT[v2025.1] = "4.5.0-xlnx-v2025.1%"
XILINX_OPTEE_OS_TADEKIT[v2025.2] = "4.5.0-xlnx-v2025.1%"
XILINX_OPTEE_OS_TADEKIT[v2026.1] = "4.9.0-xlnx-v2026.1%"
PREFERRED_VERSION_optee-tadekit ?= "${@d.getVarFlag('XILINX_OPTEE_OS_TADEKIT', d.getVar('XILINX_RELEASE_VERSION')) or 'undefined'}"

XILINX_OPTEE_TEST[v2025.1] = "4.5.0-xlnx-v2025.1%"
XILINX_OPTEE_TEST[v2025.2] = "4.5.0-xlnx-v2025.1%"
XILINX_OPTEE_TEST[v2026.1] = "4.9.0-xlnx-v2026.1%"
PREFERRED_VERSION_optee-test ?= "${@d.getVarFlag('XILINX_OPTEE_TEST', d.getVar('XILINX_RELEASE_VERSION')) or 'undefined'}"

# Community meta-arm does not have 2.14 version
PREFERRED_VERSION_fiptool-native = "${@"2.14%" if (d.getVar('PREFERRED_VERSION_trusted-firmware-a') or d.getVar('PREFERRED_VERSION_virtual/arm-trusted-firmware') or d.getVarFlag('XILINX_ATF_VERSION', d.getVar('XILINX_RELEASE_VERSION')) or '').startswith("2.14") else ''}"
PREFERRED_VERSION_tf-a-tests = "${@"2.14%" if (d.getVar('PREFERRED_VERSION_trusted-firmware-a') or d.getVar('PREFERRED_VERSION_virtual/arm-trusted-firmware') or d.getVarFlag('XILINX_ATF_VERSION', d.getVar('XILINX_RELEASE_VERSION')) or '').startswith("2.14") else ''}"

XILINX_UBOOT_VERSION[v2023.1] = "1:2023.01-xilinx-v2023.1%"
XILINX_UBOOT_VERSION[v2023.2] = "1:2023.01-xilinx-v2023.2%"
XILINX_UBOOT_VERSION[v2024.1] = "1:2024.01-xilinx-v2024.1%"
XILINX_UBOOT_VERSION[v2024.2] = "1:2024.01-xilinx-v2024.2%"
XILINX_UBOOT_VERSION[v2025.1] = "1:2025.01-xilinx-v2025.1%"
XILINX_UBOOT_VERSION[v2025.2] = "1:2025.01-xilinx-v2025.1%"
XILINX_UBOOT_VERSION[v2026.1] = "1:2026.01-xilinx-v2026.1%"

PREFERRED_VERSION_u-boot-xlnx ?= "${@d.getVarFlag('XILINX_UBOOT_VERSION', d.getVar('XILINX_RELEASE_VERSION')) or 'undefined'}"
PREFERRED_VERSION_u-boot-tools-xlnx ?= "${@d.getVarFlag('XILINX_UBOOT_VERSION', d.getVar('XILINX_RELEASE_VERSION')) or 'undefined'}"
PREFERRED_VERSION_u-boot-tools-xlnx-native ?= "${@d.getVarFlag('XILINX_UBOOT_VERSION', d.getVar('XILINX_RELEASE_VERSION')) or 'undefined'}"

XILINX_LINUX_VERSION[v2023.1] = "6.1.30%"
XILINX_LINUX_VERSION[v2023.2] = "6.1.60%"
XILINX_LINUX_VERSION[v2024.1] = "6.6.10%"
XILINX_LINUX_VERSION[v2024.2] = "6.6.40%"
XILINX_LINUX_VERSION[v2025.1] = "6.12.10%"
XILINX_LINUX_VERSION[v2025.2] = "6.12.40%"
XILINX_LINUX_VERSION[v2026.1] = "6.18.10%"
PREFERRED_VERSION_linux-xlnx ?= "${@d.getVarFlag('XILINX_LINUX_VERSION', d.getVar('XILINX_RELEASE_VERSION')) or 'undefined'}"

# XRT/ZOCL
XRT_ZOCL_VERSION[v2023.1] = "202310.2.15.0"
XRT_ZOCL_VERSION[v2023.2] = "202320.2.16.0"
XRT_ZOCL_VERSION[v2024.1] = "202410.2.17.319"
XRT_ZOCL_VERSION[v2024.2] = "202420.2.18.0"
XRT_ZOCL_VERSION[v2025.1] = "202510.2.19.0"
XRT_ZOCL_VERSION[v2025.2] = "202520.2.20.0"
XRT_ZOCL_VERSION[v2026.1] = "202610.2.23.0"
PREFERRED_VERSION_xrt ?= "${@d.getVarFlag('XRT_ZOCL_VERSION', d.getVar('XILINX_RELEASE_VERSION')) or 'undefined'}"
PREFERRED_VERSION_zocl ?= "${@d.getVarFlag('XRT_ZOCL_VERSION', d.getVar('XILINX_RELEASE_VERSION')) or 'undefined'}"

# AI-Engine
AIEFAL_VERSION[v2023.1] = "1.5"
AIEFAL_VERSION[v2023.2] = "1.5"
AIEFAL_VERSION[v2024.1] = "1.6"
AIEFAL_VERSION[v2024.2] = "1.7"
AIEFAL_VERSION[v2025.1] = "1.8"
AIEFAL_VERSION[v2025.2] = "1.9"
AIEFAL_VERSION[v2026.1] = "2.0"
PREFERRED_VERSION_aiefal ?= "${@d.getVarFlag('AIEFAL_VERSION', d.getVar('XILINX_RELEASE_VERSION')) or 'undefined'}"

AI_ENGINE_DRIVER_VERSION[v2023.1] = "3.4"
AI_ENGINE_DRIVER_VERSION[v2023.2] = "3.4"
AI_ENGINE_DRIVER_VERSION[v2024.1] = "3.5"
AI_ENGINE_DRIVER_VERSION[v2024.2] = "3.6"
AI_ENGINE_DRIVER_VERSION[v2025.1] = "3.7"
AI_ENGINE_DRIVER_VERSION[v2025.2] = "3.8"
AI_ENGINE_DRIVER_VERSION[v2026.1] = "3.9"
PREFERRED_VERSION_ai-engine-driver ?= "${@d.getVarFlag('AI_ENGINE_DRIVER_VERSION', d.getVar('XILINX_RELEASE_VERSION')) or 'undefined'}"

# Linuxptp for scarhtgap is currently at 4.1, but we want to be able to update
# to 4.4 backport from meta-oe master to test 6.18 kernel drivers using 4.4 new
# features, so we set the version per release and default to 4.1 for older releases.
LINUX_PTP_VERSION[v2024.2] = "4.1"
LINUX_PTP_VERSION[v2025.1] = "4.1"
LINUX_PTP_VERSION[v2025.2] = "4.1"
LINUX_PTP_VERSION[v2026.1] = "4.4"
PREFERRED_VERSION_linuxptp ?= "${@d.getVarFlag('LINUX_PTP_VERSION', d.getVar('XILINX_RELEASE_VERSION')) or 'undefined'}"

# Define the pmu-rom filename, needed for coordination between native and machine recipes
PMU_ROM ?= "pmu-rom.elf"

# Add support to eSDK for gen-machine-conf if it exists
PLNX_SCRIPTS_PATH = "${LAYERDIR}/gen-machine-conf/gen-machine-scripts"
BB_HASHEXCLUDE_COMMON:append = " PLNX_SCRIPTS_PATH"

IMAGE_CLASSES += "gen-machine-conf"

# Add our local, forked version of wic to the bitbake's path
INHERIT += "xilinx-wic"
```

## meta-xilinx-core/conf/machine/amd-cortexa53-common.conf
```bitbake
#@TYPE: Machine
#@NAME: amd-cortexa53-common
#@DESCRIPTION: Machine configuration for a common AMD filesystem for devices with cortexa53 and w/o mali400

#### Preamble
MACHINEOVERRIDES =. "${@['', 'amd-cortexa53-common:']['amd-cortexa53-common' != '${MACHINE}']}"
#### Regular settings follow

DEFAULTTUNE = "cortexa72-cortexa53"

# These devices are all zynqmp related
require conf/machine/zynqmp-generic.conf

# Clear the machine specifc settings
QB_CMDLINE_IP_SLIRP = ""
QB_CMDLINE_IP_TAP = ""
QB_DEFAULT_KERNEL = ""
QB_DTB = ""
QB_MACHINE = ""
QB_MEM = ""
QB_NETWORK_DEVICE = ""
QB_NO_PNI = ""
QB_OPT_APPEND = ""
QB_ROOTFS_OPT = ""
QB_SERIAL_OPT = ""

MACHINE_FEATURES += "rfsoc fpga-overlay"

#### No additional settings should be after the Postamble
#### Postamble
PACKAGE_EXTRA_ARCHS:append = "${@['', ' amd_cortexa53_common']['amd-cortexa53-common' != "${MACHINE}"]}"
```

## meta-xilinx-core/conf/machine/amd-cortexa53-mali-common.conf
```bitbake
#@TYPE: Machine
#@NAME: amd-cortexa53-mali-common
#@DESCRIPTION: Machine configuration for a common AMD filesystem for devices with cortexa53 and mali400

#### Preamble
MACHINEOVERRIDES =. "${@['', 'amd-cortexa53-mali-common:']['amd-cortexa53-mali-common' != '${MACHINE}']}"
#### Regular settings follow

DEFAULTTUNE = "cortexa72-cortexa53"

# These devices are all zynqmp related
require conf/machine/zynqmp-generic.conf

# Clear the machine specifc settings
QB_CMDLINE_IP_SLIRP = ""
QB_CMDLINE_IP_TAP = ""
QB_DEFAULT_KERNEL = ""
QB_DTB = ""
QB_MACHINE = ""
QB_MEM = ""
QB_NETWORK_DEVICE = ""
QB_NO_PNI = ""
QB_OPT_APPEND = ""
QB_ROOTFS_OPT = ""
QB_SERIAL_OPT = ""

MACHINE_FEATURES += "mali400 vcu fpga-overlay"

#### No additional settings should be after the Postamble
#### Postamble
PACKAGE_EXTRA_ARCHS:append = "${@['', ' amd_cortexa53_mali_common']['amd-cortexa53-mali-common' != "${MACHINE}"]}"
```

## meta-xilinx-core/conf/machine/amd-cortexa72-common.conf
```bitbake
#@TYPE: Machine
#@NAME: amd-cortexa72-common
#@DESCRIPTION: Machine configuration for a common AMD filesystem for devices with cortexa72

#### Preamble
MACHINEOVERRIDES =. "${@['', 'amd-cortexa72-common:']['amd-cortexa72-common' != '${MACHINE}']}"
#### Regular settings follow

DEFAULTTUNE = "cortexa72-cortexa53"

# These devices are all 'versal' based
require conf/machine/versal-generic.conf

# Clear the machine specifc settings
QB_CMDLINE_IP_SLIRP = ""
QB_CMDLINE_IP_TAP = ""
QB_DEFAULT_KERNEL = ""
QB_DTB = ""
QB_MACHINE = ""
QB_MEM = ""
QB_NETWORK_DEVICE = ""
QB_NO_PNI = ""
QB_OPT_APPEND = ""
QB_ROOTFS_OPT = ""
QB_SERIAL_OPT = ""

MACHINE_FEATURES += "aie vdu fpga-overlay"

#### No additional settings should be after the Postamble
#### Postamble
PACKAGE_EXTRA_ARCHS:append = "${@['', ' amd_cortexa72_common']['amd-cortexa72-common' != "${MACHINE}"]}"
```
