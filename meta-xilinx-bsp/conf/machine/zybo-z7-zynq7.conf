## meta-xilinx-core/conf/machine/amd-cortexa78-common.conf
```bitbake
#@TYPE: Machine
#@NAME: amd-cortexa78-common
#@DESCRIPTION: Machine configuration for a common AMD filesystem for devices with cortexa78 w/o mali

#### Preamble
MACHINEOVERRIDES =. "${@['', 'amd-cortexa78-common:']['amd-cortexa78-common' != '${MACHINE}']}"
#### Regular settings follow

DEFAULTTUNE = "cortexa72-cortexa53"

# Currently these devices are primarily versal-net based
require conf/machine/versal-net-generic.conf

# Clear the machine specifc settings
QB_CMDLINE_IP_SLIRP = ""
QB_CMDLINE_IP_TAP = ""
QB_DEFAULT_KERNEL = ""
QB_DTB = ""
QB_MACHINE = ""
QB_MEM = ""
QB_NETWORK_DEVICE = ""
QB_NO_PNI = ""
QB_OPT_APPEND = ""
QB_ROOTFS_OPT = ""
QB_SERIAL_OPT = ""

MACHINE_FEATURES += "fpga-overlay"

#### No additional settings should be after the Postamble
#### Postamble
PACKAGE_EXTRA_ARCHS:append = "${@['', ' amd_cortexa78_common']['amd-cortexa78-common' != "${MACHINE}"]}"
```

## meta-xilinx-core/conf/machine/amd-cortexa78-mali-common.conf
```bitbake
#@TYPE: Machine
#@NAME: amd-cortexa78-mali-common
#@DESCRIPTION: Machine configuration for a common AMD filesystem for devices with cortexa78 and malig78

#### Preamble
MACHINEOVERRIDES =. "${@['', 'amd-cortexa78-mali-common:']['amd-cortexa78-mali-common' != '${MACHINE}']}"
#### Regular settings follow

DEFAULTTUNE = "cortexa72-cortexa53"

# These devices are all Versal Gen 2 related
require conf/machine/versal-2ve-2vm-generic.conf

MACHINE_FEATURES += "\
    vcu2 \
    malig78ae \
    fpga-overlay \
    optee \
    efi \
    "

#### No additional settings should be after the Postamble
#### Postamble
PACKAGE_EXTRA_ARCHS:append = "${@['', ' amd_cortexa78_mali_common']['amd-cortexa78-mali-common' != "${MACHINE}"]}"
```

## meta-xilinx-core/conf/machine/amd-cortexa9thf-neon-common.conf
```bitbake
#@TYPE: Machine
#@NAME: amd-cortexa9thf-neon-common
#@DESCRIPTION: Machine configuration for a common AMD filesystem for devices with cortexa9 (thumb, hard float and neon)

#### Preamble
MACHINEOVERRIDES =. "${@['', 'amd-cortexa9thf-neon-common:']['amd-cortexa9thf-neon-common' != '${MACHINE}']}"
#### Regular settings follow

DEFAULTTUNE = "cortexa9thf-neon"

# These devices are all Zynq based
require conf/machine/zynq-generic.conf

# Clear the machine specifc settings
QB_CMDLINE_IP_SLIRP = ""
QB_CMDLINE_IP_TAP = ""
QB_DEFAULT_KERNEL = ""
QB_DTB = ""
QB_MACHINE = ""
QB_MEM = ""
QB_NETWORK_DEVICE = ""
QB_NO_PNI = ""
QB_OPT_APPEND = ""
QB_ROOTFS_OPT = ""
QB_SERIAL_OPT = ""

MACHINE_FEATURES += "fpga-overlay"

#### No additional settings should be after the Postamble
#### Postamble
PACKAGE_EXTRA_ARCHS:append = "${@['', ' amd_cortexa9thf_neon_common']['amd-cortexa9thf-neon-common' != "${MACHINE}"]}"
```

## meta-xilinx-core/conf/machine/include/arm/armv7r/tune-cortexr5hf.inc
```bitbake
include conf/machine/include/arm/armv7r/tune-cortexr5.inc

AVAILTUNES                            += "cortexr5hf"
ARMPKGARCH:tune-cortexr5hf             = "cortexr5"
TUNE_FEATURES:tune-cortexr5hf          = "${TUNE_FEATURES:tune-cortexr5} callconvention-hard"
PACKAGE_EXTRA_ARCHS:tune-cortexr5hf    = "cortexr5hf-vfpv3d16"
```

## meta-xilinx-core/conf/machine/include/arm/armv8r/tune-cortexr52hf.inc
```bitbake
require conf/machine/include/arm/armv8r/tune-cortexr52.inc

# simd is special, we don't pass this to the -mfpu, it's implied
TUNE_CCARGS_MFLOAT = "${@ bb.utils.contains('TUNE_FEATURES', 'callconvention-hard', 'hard', 'softfp', d) if (d.getVar('TUNE_CCARGS_MFPU') != '' or bb.utils.contains('TUNE_FEATURES', 'simd', True, False, d)) else '' }"

AVAILTUNES                             += "cortexr52hf"
ARMPKGARCH:tune-cortexr52hf             = "cortexr52"
TUNE_FEATURES:tune-cortexr52hf          = "${TUNE_FEATURES:tune-cortexr52} callconvention-hard"
PACKAGE_EXTRA_ARCHS:tune-cortexr52hf    = "cortexr52hf"
```

## meta-xilinx-core/conf/machine/include/machine-xilinx-default.inc
```bitbake
INHERIT += "xilinx-vars"
INHERIT += "xilinx-deprecated"

# Default Xilinx BSP Machine settings

MACHINE_FEATURES_BACKFILL_CONSIDERED += "rtc"

# File System Configuration
IMAGE_FSTYPES ?= "tar.gz cpio cpio.gz cpio.gz.u-boot"

# Kernel Configuration
PREFERRED_PROVIDER_virtual/kernel ??= "linux-xlnx"

# Device tree Configuration
PREFERRED_PROVIDER_virtual/dtb ??= "${@'device-tree' if d.getVar('XILINX_WITH_ESW') else ''}"

# U-Boot Configuration
PREFERRED_PROVIDER_virtual/bootloader ??= "u-boot-xlnx"
PREFERRED_PROVIDER_virtual/boot-bin ??= "xilinx-bootbin"
PREFERRED_PROVIDER_u-boot-tools ??= "u-boot-tools-xlnx"
PREFERRED_PROVIDER_u-boot-tools-native ??= "u-boot-tools-xlnx-native"
PREFERRED_PROVIDER_nativesdk-u-boot-tools ??= "nativesdk-u-boot-tools-xlnx"

# Libmetal and OpenAMP Configuration
PREFERRED_PROVIDER_libmetal ?= "libmetal-xlnx"
PREFERRED_PROVIDER_open-amp ?= "open-amp-xlnx"

UBOOT_SUFFIX ?= "bin"

UBOOT_BINARY ?= "u-boot.${UBOOT_SUFFIX}"
UBOOT_ELF ?= "u-boot.elf"

XSERVER ?= " \
	xserver-xorg \
	xf86-input-evdev \
	xf86-input-mouse \
	xf86-video-fbdev \
	${XSERVER_EXT} \
	"

SYSTEM_DTFILE ??= ""
CONFIG_DTFILE ??= "${SYSTEM_DTFILE}"
FIT_CONF_DEFAULT_DTB ?= "${@os.path.basename(d.getVar('CONFIG_DTFILE')).replace('.dts', '.dtb') if d.getVar('CONFIG_DTFILE') else ''}"

# Define to avoid parsse errors below if undefind elsewhere
INITRAMFS_IMAGE ??= ""

# IMAGE_BOOT_FILES is a whitespace-separated list of entries specifying files to be installed into the boot partition
# entries can change the installed filename by specifying the destination name after a semicolon (e.g. u-boot.img;uboot)
# make sure to use the installed filename when scanning IMAGE_BOOT_FILES
IMAGE_BOOT_FILES_INSTALLED = "${@' '.join([x.split(';')[-1] for x in d.getVar('IMAGE_BOOT_FILES').split()])}"

# Automatically add WKS_FILE_DEPENDS based on the configuration
# Initial value from oe-core/meta/classes-recipe/image_types_wic.bbclass
WKS_FILE_DEPENDS ?= "${WKS_FILE_DEPENDS_DEFAULT} ${WKS_FILE_DEPENDS_BOOTLOADERS}"
WKS_FILE_DEPENDS .= "${@bb.utils.contains('IMAGE_BOOT_FILES_INSTALLED', 'boot.bin',     ' virtual/boot-bin', '', d)}"
WKS_FILE_DEPENDS .= "${@bb.utils.contains('IMAGE_BOOT_FILES_INSTALLED', 'system.dtb',   ' virtual/dtb', '', d)}"
WKS_FILE_DEPENDS .= "${@bb.utils.contains('IMAGE_BOOT_FILES_INSTALLED', 'boot.scr',     ' ${UBOOT_BOOT_SCRIPT}', '', d)}"
WKS_FILE_DEPENDS .= "${@bb.utils.contains('IMAGE_BOOT_FILES_INSTALLED', 'uEnv.txt',     ' u-boot-xlnx-uenv', '', d)}"
WKS_FILE_DEPENDS .= "${@bb.utils.contains('IMAGE_BOOT_FILES_INSTALLED', d.getVar('KERNEL_IMAGETYPE') or 'Image',        ' virtual/kernel', '', d)}"
WKS_FILE_DEPENDS .= "${@bb.utils.contains('IMAGE_BOOT_FILES_INSTALLED', '${INITRAMFS_IMAGE}-${MACHINE}.cpio.gz.u-boot', ' ${INITRAMFS_IMAGE}', '', d)}"

# Automatically add IMAGE_BOOT_FILES to /boot via packages
MACHINE_ESSENTIAL_EXTRA_RDEPENDS .= "${@bb.utils.contains('IMAGE_BOOT_FILES_INSTALLED', 'boot.bin',     ' ${PREFERRED_PROVIDER_virtual/boot-bin}', '', d)}"
MACHINE_ESSENTIAL_EXTRA_RDEPENDS .= "${@bb.utils.contains('IMAGE_BOOT_FILES_INSTALLED', 'system.dtb',   ' ${PREFERRED_PROVIDER_virtual/dtb}', '', d)}"
MACHINE_ESSENTIAL_EXTRA_RDEPENDS .= "${@bb.utils.contains('IMAGE_BOOT_FILES_INSTALLED', 'boot.scr',     ' ${UBOOT_BOOT_SCRIPT}', '', d)}"
MACHINE_ESSENTIAL_EXTRA_RDEPENDS .= "${@bb.utils.contains('IMAGE_BOOT_FILES_INSTALLED', 'uEnv.txt',     ' u-boot-xlnx-uenv', '', d)}"
MACHINE_ESSENTIAL_EXTRA_RDEPENDS .= "${@bb.utils.contains('IMAGE_BOOT_FILES_INSTALLED', d.getVar('KERNEL_IMAGETYPE') or 'Image',        ' kernel-image-' + d.getVar('KERNEL_IMAGETYPE').lower(), '', d)}"
MACHINE_ESSENTIAL_EXTRA_RDEPENDS .= "${@bb.utils.contains('IMAGE_BOOT_FILES_INSTALLED', '${INITRAMFS_IMAGE}-${MACHINE}.cpio.gz.u-boot', ' initramdisk-${INITRAMFS_IMAGE}', '', d)}"

# xilinx-default-sd.wks - u-boot/boot.scr based
# xilinx-default-sd-efi.wks - u-boot/EFI based
WKS_FILE ?= "${@bb.utils.contains('DISTRO_FEATURES', 'efi', 'xilinx-default-sd-efi.wks', 'xilinx-default-sd.wks', d)}"

# Set the EFI_PROVIDER only if EFI is enabled in the distro
EFI_PROVIDER ??= "${@bb.utils.contains('DISTRO_FEATURES', 'efi', bb.utils.contains("DISTRO_FEATURES", "systemd", "systemd-boot", "grub-efi", d), '', d)}"
WICVARS:append = "${@bb.utils.contains('DISTRO_FEATURES', 'efi', ' EFI_PROVIDER', '', d)}"
WICUFSVARS:append = "${@bb.utils.contains('DISTRO_FEATURES', 'efi', ' EFI_PROVIDER', '', d)}"

# Transfer the DEFAULT_HW_BOOT_MODE to HW_BOOT_MODE
# This indirection allows for an image to override it
DEFAULT_HW_BOOT_MODE ??= "5"
HW_BOOT_MODE ?= "${DEFAULT_HW_BOOT_MODE}"
HW_BOOT_MODE[doc] = "The hardware boot mode as defined by the SoC TRM.  This should be set by the machine.conf, but the user or image recipe can override as necessary."

HW_BOOT_MODE_TYPE = "${@get_verbose_boot_mode(d)}"
HW_BOOT_MODE_TYPE[docs] = "Verbose description of the boot mode intended to be used for debugging and log message.  The values should not be relied on as they may change."

BUILDCFG_VARS:append = " HW_BOOT_MODE HW_BOOT_MODE_TYPE SOC_ON_DISK_BOOT_BIN"

def get_verbose_boot_mode(d):
    hw_boot_mode = d.getVar('HW_BOOT_MODE')
    soc_boot_mode_mapping = d.getVar('SOC_BOOT_MODE_MAPPING')
    if not hw_boot_mode or not soc_boot_mode_mapping:
        return ''

    # Parse the mapping string into a dictionary
    mapping = dict(entry.split(":", 1) for entry in soc_boot_mode_mapping.split())

    if hw_boot_mode in mapping:
        return mapping[hw_boot_mode]
    return ''

# Does this configuration require a boot.bin on the image?
SOC_ON_DISK_BOOT_BIN ?= "${@'1' if (d.getVar('HW_BOOT_MODE') or '') in (d.getVar('SOC_DISK_BOOT_MODE_MAPPING') or '').split() and d.getVar('XILINX_WITH_ESW') else ''}"
SOC_ON_DISK_BOOT_BIN[doc] = "When set to 1, the boot.bin should be added to the boot media."

# This is generally distro boot and processed via bootimg-partition
IMAGE_BOOT_FILES ?= "${@'boot.bin ' if d.getVar('SOC_ON_DISK_BOOT_BIN') == '1' else ''}${KERNEL_IMAGETYPE}"

# This is EFI boot bootimg-efi(-amd)
IMAGE_EFI_BOOT_FILES ?= "${@'boot.bin' if d.getVar('SOC_ON_DISK_BOOT_BIN') == '1' else ''}"

# These dependencies are SOC specific, and only apply if building with
# XSCT or SDT modes
SOC_EXTRA_IMAGEDEPENDS[microblaze] = "virtual/bitstream"
SOC_EXTRA_IMAGEDEPENDS[microblaze-v] = ""
SOC_EXTRA_IMAGEDEPENDS[zynq] = "virtual/boot-bin"
SOC_EXTRA_IMAGEDEPENDS[zynqmp] = "virtual/boot-bin"
SOC_EXTRA_IMAGEDEPENDS[versal] = "virtual/boot-bin virtual/cdo"
SOC_EXTRA_IMAGEDEPENDS[versal-net] = "virtual/boot-bin virtual/cdo"
SOC_EXTRA_IMAGEDEPENDS[versal-2ve-2vm] = "virtual/boot-bin virtual/cdo"
SOC_EXTRA_IMAGEDEPENDS = "${@d.getVarFlag('SOC_EXTRA_IMAGEDEPENDS', d.getVar('SOC_FAMILY') or '') or '' if d.getVar('XILINX_WITH_ESW') else ''}"

EXTRA_IMAGEDEPENDS += "${SOC_EXTRA_IMAGEDEPENDS}"

XSERVER_EXT ?= ""

FPGA_MNGR_RECONFIG_ENABLE ?= "1"

# This variable is supported only with SysVinit.
SERIAL_CONSOLES_CHECK = "${@bb.utils.contains('DISTRO_FEATURES', 'sysvinit', '${SERIAL_CONSOLES}', '', d)}"
```

## meta-xilinx-core/conf/machine/include/machine-xilinx-qemu.inc
```bitbake
# This include is used to setup default QEMU and qemuboot config for meta-xilinx
# machines.

PREFERRED_PROVIDER_qemu-native = "qemu-xilinx-native"
PREFERRED_PROVIDER_qemu-system-native = "qemu-xilinx-system-native"
PREFERRED_PROVIDER_nativesdk-qemu = "nativesdk-qemu-xilinx"

# enable the overrides for the context of the conf only
MACHINEOVERRIDES =. "qemuboot-xilinx:"

# depend on qemu-helper-native, which will depend on QEMU
EXTRA_IMAGEDEPENDS += "qemu-devicetrees-native qemu-system-native qemu-helper-native:do_addto_recipe_sysroot"

# Use the xilinx specific version for these users
IMAGE_CLASSES += "qemuboot-xilinx"

# As of Yocto Project nanbield, if a -serial is pass in QB_OPT_APPEND the
# runqemu may add additional null entries or simply skip further setup.
#
# To help us be able to adjust for this behavior add a special
# QEMU_HW_SERIAL that will allow us to define serial ports for qemu
# emulated boards that may not match the standard Linux behavior.
#
QEMU_HW_SERIAL ??= ""
QB_OPT_APPEND += "${QEMU_HW_SERIAL} -nodefaults"
QB_SERIAL_OPT = ""

# We need the flash type to specify other values, the machine is responsible
# for setting this.
QEMU_FLASH_TYPE ??= "undefined"

# Define default flash filename used for QEMU
QEMU_FLASH_FILE ?= "${@'qemu-${QEMU_FLASH_TYPE}' if d.getVar('QEMU_FLASH_TYPE') in [ 'qspi', 'ospi' ] else ''}"

# Build qemu SPI and empty image as necessary
EXTRA_IMAGEDEPENDS += "${@'qemu-image-empty:do_image_complete' if d.getVar('SOC_ON_DISK_BOOT_BIN') == '1' else ''}"
EXTRA_IMAGEDEPENDS += "${@'qemu-${QEMU_FLASH_TYPE}:do_deploy' if d.getVar('QEMU_FLASH_TYPE') in [ 'qspi', 'ospi' ] else ''}"

# Workaround to trigger runqemu to use -dtb to send the APU DTB
# This is done to ensure that we can easily change APU DTB at runtime via
# standard runqemu options.
# The file is not required by the wrapper, but if present is used
# to verify that the used boot.bin is the expected on.
QB_DEFAULT_KERNEL = "BOOT-${MACHINE}.bin"
QB_KERNEL_CMDLINE:microblaze = "none"
QB_KERNEL_CMDLINE:arm = "none"
QB_KERNEL_CMDLINE:aarch64 = "none"
```

## meta-xilinx-core/conf/machine/include/qemuriscv-xilinx.inc
```bitbake
# This include file is a copy of poky/meta/conf/machine/include/riscv/qemuriscv.inc
# with some QB_* params adjusted to boot qemu for qemu-microblaze-v-32 and
# qemu-microblaze-v-64 machines.

# qemuboot options, based on qemuriscv
# Currently microblaze-v is only single thread
#QB_SMP ?= "-smp 4"
QB_KERNEL_CMDLINE_APPEND = "earlycon=sbi"
QB_MACHINE = "-machine virt"
QB_DEFAULT_BIOS = "fw_jump.elf"
QB_TAP_OPT = "-netdev tap,id=net0,ifname=@TAP@,script=no,downscript=no"
QB_NETWORK_DEVICE = "-device virtio-net-device,netdev=net0,mac=@MAC@"
QB_ROOTFS_OPT = "-drive id=disk0,file=@ROOTFS@,if=none,format=raw -device virtio-blk-device,drive=disk0"
QB_SERIAL_OPT = "-device virtio-serial-device -chardev null,id=virtcon -device virtconsole,chardev=virtcon"
QB_TCPSERIAL_OPT = " -device virtio-serial-device -chardev socket,id=virtcon,port=@PORT@,host=127.0.0.1,nodelay=on -device virtconsole,chardev=virtcon"
# Graphics are not supported
#QB_GRAPHICS = "-device bochs-display"

# Default when using wic.qemu-sd
QB_KERNEL_ROOT ??= "/dev/vda2"
```

## meta-xilinx-core/conf/machine/include/soc-microblaze-v.inc
```bitbake
DEFAULTTUNE ?= "microblaze-v"
SOC_FAMILY ?= "microblaze-v"

require conf/machine/include/soc-family.inc
require soc-tune-include.inc

# Linux Configuration
ARCH_DEFAULT_KERNELIMAGETYPE:microblaze-v = "Image"
KEEPUIMAGE = "no"

UBOOT_ELF ?= "u-boot"
```

## meta-xilinx-core/conf/machine/include/soc-microblaze.inc
```bitbake
DEFAULTTUNE ?= "microblaze"
SOC_FAMILY ?= "microblaze"

require conf/machine/include/soc-family.inc
require soc-tune-include.inc

# Linux Configuration
ARCH_DEFAULT_KERNELIMAGETYPE:microblaze = "linux.bin.ub"
```
