## meta-xilinx-bsp/conf/machine/virt-versal.conf
```bitbake
#@TYPE: Machine
#@NAME: virt-versal
#@DESCRIPTION: QEMU machine for versal device

require conf/machine/include/tune-versal.inc
require conf/machine/include/machine-xilinx-overrides.inc
require conf/machine/include/machine-xilinx-default.inc
require conf/machine/include/machine-xilinx-qemu.inc

SOC_VARIANT ?= "virt"

MACHINE_FEATURES = "rtc ext2 ext3 vfat usbhost"

UBOOT_MACHINE = "xilinx_versal_virt_defconfig"

SERIAL_CONSOLE ?= "115200 ttyAMA0"

SERIAL_CONSOLES_CHECK = "${SERIAL_CONSOLES}"

PREFERRED_PROVIDER_virtual/kernel ?= "linux-xlnx"
PREFERRED_PROVIDER_virtual/bootloader ?= "u-boot-xlnx"
PREFERRED_PROVIDER_qemu-helper-native = "qemu-xilinx-helper-native"

EXTRA_IMAGEDEPENDS += " \
               arm-trusted-firmware \
               qemu-devicetrees \
               virtual/bootloader \
               virtual/boot-bin \
               plm-firmware \
               psm-firmware \
               "

IMAGE_BOOT_FILES += "boot.bin system.dtb Image"

# Default SD image build configuration, use qemu-sd to pad
IMAGE_CLASSES += "image-types-xilinx-qemu"
IMAGE_FSTYPES += "wic.qemu-sd"
WKS_FILES ?= "sdimage-bootpart.wks"

# This machine has a QEMU model, runqemu setup:
IMAGE_CLASSES += "qemuboot-xilinx"
QB_MACHINE = "-M arm-generic-fdt"
QB_MEM = "-m 4096"
QB_DEFAULT_KERNEL = "none"
QB_NETWORK_DEVICE = ""
QB_KERNEL_CMDLINE_APPEND ?= ""
QB_NET = "none"
QB_ROOTFS = "none"

# Use the multiarch script instead of launching QEMU directly
# Use booti 80000 6000000 4000000 to launch
QB_SYSTEM_NAME_append = "-multiarch"

QB_OPT_APPEND ?= " -serial null -serial null -serial mon:stdio -display none"

QB_OPT_APPEND_append_qemuboot-xilinx = " \
    -boot mode=1 \
    -drive file=${DEPLOY_DIR_IMAGE}/QEMU_qspi-${MACHINE}.bin,format=raw,if=mtd,index=0 \
    -device loader,file=${DEPLOY_DIR_IMAGE}/Image,addr=0x80000 \
    -device loader,file=${DEPLOY_DIR_IMAGE}/${IMAGE_BASENAME}-${MACHINE}.cpio.gz.u-boot,addr=0x6000000 \
    -device loader,file=${DEPLOY_DIR_IMAGE}/system.dtb,addr=0x4000000 \
    -hw-dtb ${DEPLOY_DIR_IMAGE}/qemu-hw-devicetrees/multiarch/board-versal-ps-virt.dtb \
    -display none \
    -net nic -net user,tftp=${DEPLOY_DIR_IMAGE} \
    "

# PLM instance args
QB_PLM_OPT = " \
    -M microblaze-fdt \
    -device loader,file=${DEPLOY_DIR_IMAGE}/BOOT-${MACHINE}_bh.bin,addr=0xF201E000,force-raw  \
    -device loader,addr=0xf0000000,data=0xba020004,data-len=4 \
    -device loader,addr=0xf0000004,data=0xb800fffc,data-len=4 \
    -device loader,file=${DEPLOY_DIR_IMAGE}/CDO/pmc_cdo.bin,addr=0xf2000000,force-raw \
    -device loader,file=${DEPLOY_DIR_IMAGE}/plm-firmware-${MACHINE}.elf,cpu-num=1 \
    -device loader,addr=0xF1110624,data=0x0,data-len=4 \
    -device loader,addr=0xF1110620,data=0x1,data-len=4 \
    -hw-dtb ${DEPLOY_DIR_IMAGE}/qemu-hw-devicetrees/multiarch/board-versal-pmc-virt.dtb \
    -display none \
    "
QB_OPT_APPEND_append_qemuboot-xilinx = " -plm-args '${QB_PLM_OPT}'"
```

## meta-xilinx-bsp/conf/machine/vmk180-versal.conf
```bitbake
#@TYPE: Machine
#@NAME: vmk180-versal
#@DESCRIPTION: Machine configuration for the VMK180 evaluation board.

#### Preamble
MACHINEOVERRIDES =. "${@['', 'vmk180-versal:']['vmk180-versal' !='${MACHINE}']}"
#### Regular settings follow

# Variables that changes based on hw design or board specific requirement must be
# defined before calling the required inclusion file else pre-expansion value
# defined in versal-generic.conf will be set.

# Yocto device-tree variables
YAML_CONSOLE_DEVICE_CONFIG:pn-device-tree ?= "versal_cips_0_pspmc_0_psv_sbsauart_0"
YAML_DT_BOARD_FLAGS ?= "{BOARD versal-vmk180-reva-x-ebm-01-reva}"

# Yocto arm-trusted-firmware(TF-A) variables
ATF_CONSOLE ?= "pl011"
TFA_BL33_LOAD ?= "0x8000000"

# Yocto PLM variables
YAML_SERIAL_CONSOLE_STDIN:pn-plm-firmware ?= "versal_cips_0_pspmc_0_psv_sbsauart_0"
YAML_SERIAL_CONSOLE_STDOUT:pn-plm-firmware ?= "versal_cips_0_pspmc_0_psv_sbsauart_0"

# Yocto KERNEL Variables
UBOOT_ENTRYPOINT  ?= "0x200000"
UBOOT_LOADADDRESS ?= "0x200000"

# vmk180-versal Serial Console
SERIAL_CONSOLES ?= "115200;ttyAMA0"
YAML_SERIAL_CONSOLE_BAUDRATE ?= "115200"

# Required generic machine inclusion
# VMK180 board uses Versal Prime device hence use soc variant based generic
# machine inclusion
require conf/machine/versal-prime-generic.conf

# This machine conf file uses vmk180-versal xsa as reference input.
# User can override with vmk180 custom xsa using HDF_BASE and HDF_PATH variables
# from local.conf.
HDF_MACHINE = "vmk180-versal"

#### No additional settings should be after the Postamble
#### Postamble
PACKAGE_EXTRA_ARCHS:append = "${@['', ' vmk180_versal']['vmk180-versal' != '${MACHINE}']}"
```

## meta-xilinx-bsp/conf/machine/vpk120-versal.conf
```bitbake
#@TYPE: Machine
#@NAME: vpk120-versal
#@DESCRIPTION: Machine configuration for the VPK120 evaluation board.

#### Preamble
MACHINEOVERRIDES =. "${@['', 'vpk120-versal:']['vpk120-versal' !='${MACHINE}']}"
#### Regular settings follow

# Variables that changes based on hw design or board specific requirement must be
# defined before calling the required inclusion file else pre-expansion value
# defined in versal-generic.conf will be set.

# Yocto device-tree variables
YAML_CONSOLE_DEVICE_CONFIG:pn-device-tree ?= "versal_cips_0_pspmc_0_psv_sbsauart_0"
YAML_DT_BOARD_FLAGS ?= "{BOARD versal-vpk120-reva}"

# Yocto arm-trusted-firmware(TF-A) variables
ATF_CONSOLE_DEFAULT ?= "pl011"
TFA_BL33_LOAD ?= "0x8000000"

# Yocto PLM variables
YAML_SERIAL_CONSOLE_STDIN:pn-plm-firmware ?= "versal_cips_0_pspmc_0_psv_sbsauart_0"
YAML_SERIAL_CONSOLE_STDOUT:pn-plm-firmware ?= "versal_cips_0_pspmc_0_psv_sbsauart_0"

# Yocto KERNEL Variables
UBOOT_ENTRYPOINT  ?= "0x200000"
UBOOT_LOADADDRESS ?= "0x200000"

# vpk120-versal Serial Console
SERIAL_CONSOLES ?= "115200;ttyAMA0"
YAML_SERIAL_CONSOLE_BAUDRATE ?= "115200"

# Required generic machine inclusion
# VPK120 board uses Versal Premium device hence use soc variant based generic
# machine inclusion
require conf/machine/versal-premium-generic.conf

# This machine conf file uses vpk120-versal xsa as reference input.
# User can override with vpk120 custom xsa using HDF_BASE and HDF_PATH variables
# from local.conf.
HDF_MACHINE = "vpk120-versal"

QEMU_HW_DTB_PS =  "${QEMU_HW_DTB_PATH}/board-versal-ps-vpk120.dtb"
QEMU_HW_DTB_PMC = "${QEMU_HW_DTB_PATH}/board-versal-pmc-virt.dtb"

#### No additional settings should be after the Postamble
#### Postamble
PACKAGE_EXTRA_ARCHS:append = "${@['', ' vpk120_versal']['vpk120-versal' != '${MACHINE}']}"
```

## meta-xilinx-bsp/conf/machine/vpk180-versal.conf
```bitbake
#@TYPE: Machine
#@NAME: vpk180-versal
#@DESCRIPTION: Machine configuration for the VPK180 evaluation board.

#### Preamble
MACHINEOVERRIDES =. "${@['', 'vpk180-versal:']['vpk180-versal' !='${MACHINE}']}"
#### Regular settings follow

# Variables that changes based on hw design or board specific requirement must be
# defined before calling the required inclusion file else pre-expansion value
# defined in versal-generic.conf will be set.

# Yocto device-tree variables
YAML_CONSOLE_DEVICE_CONFIG:pn-device-tree ?= "versal_cips_0_pspmc_0_psv_sbsauart_0"
YAML_DT_BOARD_FLAGS ?= "{BOARD versal-vpk180-reva}"

# Yocto arm-trusted-firmware(TF-A) variables
ATF_CONSOLE_DEFAULT ?= "pl011"
TFA_BL33_LOAD ?= "0x8000000"

# Yocto PLM variables
YAML_SERIAL_CONSOLE_STDIN:pn-plm-firmware ?= "versal_cips_0_pspmc_0_psv_sbsauart_0"
YAML_SERIAL_CONSOLE_STDOUT:pn-plm-firmware ?= "versal_cips_0_pspmc_0_psv_sbsauart_0"

# Yocto KERNEL Variables
UBOOT_ENTRYPOINT  ?= "0x200000"
UBOOT_LOADADDRESS ?= "0x200000"

# vpk180-versal Serial Console 
SERIAL_CONSOLES ?= "115200;ttyAMA0"
YAML_SERIAL_CONSOLE_BAUDRATE ?= "115200"

# Required generic machine inclusion
# VPK180 board uses Versal Premium device hence use soc variant based generic
# machine inclusion
require conf/machine/versal-premium-generic.conf

# This machine conf file uses vpk180-versal xsa as reference input.
# User can override with vpk180 custom xsa using HDF_BASE and HDF_PATH variables
# from local.conf.
HDF_MACHINE = "vpk180-versal"

QEMU_HW_DTB_PS =  "${QEMU_HW_DTB_PATH}/board-versal-ps-vpk180.dtb"
QEMU_HW_DTB_PMC = "${QEMU_HW_DTB_PATH}/board-versal-pmc-virt.dtb"

#### No additional settings should be after the Postamble
#### Postamble
PACKAGE_EXTRA_ARCHS:append = "${@['', 'vpk180_versal']['vpk180-versal' != '${MACHINE}']}"
```

## meta-xilinx-bsp/conf/machine/zc1254-zynqmp.conf
```bitbake
#@TYPE: Machine
#@NAME: zc1254-zynqmp
#@DESCRIPTION: Machine support for ZC1254 Evaluation Board.
#

require conf/machine/zynqmp-dr-generic.conf

# Add board compatibility override
MACHINEOVERRIDES .= ":zc1254"

KERNEL_DEVICETREE = "xilinx/zynqmp-zc1254-revA.dtb"
```

## meta-xilinx-bsp/conf/machine/zc1275-zynqmp.conf
```bitbake
#@TYPE: Machine
#@NAME: zc1275-zynqmp
#@DESCRIPTION: Machine support for ZC1275 Evaluation Board.
#

SOC_VARIANT ?= "dr"

require conf/machine/include/tune-zynqmp.inc
require conf/machine/include/machine-xilinx-overrides.inc
require conf/machine/include/machine-xilinx-default.inc
require conf/machine/include/machine-xilinx-board.inc
include conf/machine/include/zynqmp-pmu-config.inc

MACHINE_FEATURES = "rtc ext2 ext3 vfat usbhost"

UBOOT_MACHINE = "xilinx_zynqmp_zc1275_revB_defconfig"

SERIAL_CONSOLE ?= "115200 ttyPS0"

SERIAL_CONSOLES_CHECK = "${SERIAL_CONSOLES}"

KERNEL_DEVICETREE = "xilinx/zynqmp-zc1275-revB.dtb"

PREFERRED_PROVIDER_virtual/kernel ?= "linux-xlnx"
PREFERRED_PROVIDER_virtual/bootloader ?= "u-boot-xlnx"
PREFERRED_PROVIDER_virtual/pmu-firmware ?= "zynqmp-pmu-pmu-firmware"

EXTRA_IMAGEDEPENDS += " \
		u-boot-zynq-uenv \
		arm-trusted-firmware \
		virtual/pmu-firmware \
		virtual/boot-bin \
		"
IMAGE_BOOT_FILES += "uEnv.txt atf-uboot.ub ${KERNEL_IMAGETYPE}-zynqmp-zc1275-revB.dtb"
```

## meta-xilinx-bsp/conf/machine/zc702-zynq7.conf
```bitbake
#@TYPE: Machine
#@NAME: zc702-zynq7
#@DESCRIPTION: Machine support for ZC702 Evaluation Board.
#
# For details on the Evaluation board:
#     http://www.xilinx.com/products/boards-and-kits/EK-Z7-ZC702-G.htm
# For documentation and design files for the ZC702:
#     http://www.xilinx.com/support/index.html/content/xilinx/en/supportNav/boards_and_kits/zynq-7000_soc_boards_and_kits/zynq-7000_soc_zc702_evaluation_kit.html
# For the FSBL 'zynq_fsbl_0.elf' refer to UG873 and the associated design files.
#

require conf/machine/zynq-generic.conf

# Add board compatibility override
MACHINEOVERRIDES .= ":zc702"

KERNEL_DEVICETREE = "zynq-zc702.dtb"

IMAGE_BOOT_FILES += " \
		boot.bin \
		uEnv.txt \
		boot.scr \
		"
```

## meta-xilinx-bsp/conf/machine/zc706-zynq7.conf
```bitbake
#@TYPE: Machine
#@NAME: zc706-zynq7
#@DESCRIPTION: Machine configuration for the ZC706 evaluation boards.

#### Preamble
MACHINEOVERRIDES =. "${@['', 'zc706-zynq7:']['zc706-zynq7' !='${MACHINE}']}"
#### Regular settings follow

# Variables that changes based on hw design or board specific requirement must be
# defined before calling the required inclusion file else pre-expansion value
# defined in zynq-generic.conf will be set.

# Yocto device-tree variables
YAML_CONSOLE_DEVICE_CONFIG:pn-device-tree ?= "ps7_uart_1"
YAML_MAIN_MEMORY_CONFIG:pn-device-tree ?= "PS7_DDR_0"
YAML_DT_BOARD_FLAGS ?= "{BOARD zc706}"

# Yocto FSBL variables
YAML_SERIAL_CONSOLE_STDIN:pn-fsbl-firmware ?= "ps7_uart_1"
YAML_SERIAL_CONSOLE_STDOUT:pn-fsbl-firmware ?= "ps7_uart_1"

# Yocto KERNEL Variables
UBOOT_ENTRYPOINT  ?= "0x200000"
UBOOT_LOADADDRESS ?= "0x200000"

# zc706-zynq7 Serial Console
SERIAL_CONSOLES ?= "115200;ttyPS0"
YAML_SERIAL_CONSOLE_BAUDRATE ?= "115200"

# Required generic machine inclusion
require conf/machine/zynq-generic.conf

# This eval board machine conf file uses zc702-zynq7 xsa as reference input.
# User can override with zc702 custom xsa using HDF_BASE and HDF_PATH variables
# from local.conf.
HDF_MACHINE = "zc706-zynq7"

# KERNEL_DEVICETREE is disabled as we use board device tree from DTG to match
# the xsa. User can enable explicitly if required from local.conf.
# KERNEL_DEVICETREE = "zynq-zc706.dtb"

#### No additional settings should be after the Postamble
#### Postamble
PACKAGE_EXTRA_ARCHS:append = "${@['', ' zc706_zynq7']['zc706-zynq7' != '${MACHINE}']}"
```

## meta-xilinx-bsp/conf/machine/zcu102-zynqmp.conf
```bitbake
#@TYPE: Machine
#@NAME: zcu102-zynqmp
#@DESCRIPTION: Machine configuration for the ZCU102 evaluation board.

#### Preamble
MACHINEOVERRIDES =. "${@['', 'zcu102-zynqmp:']['zcu102-zynqmp' !='${MACHINE}']}"
#### Regular settings follow

# Variables that changes based on hw design or board specific requirement must be
# defined before calling the required inclusion file else pre-expansion value
# defined in zynqmp-generic.conf will be set.

# Yocto device-tree variables
YAML_CONSOLE_DEVICE_CONFIG:pn-device-tree ?= "psu_uart_0"
YAML_MAIN_MEMORY_CONFIG:pn-device-tree ?= "PSU_DDR_0"
YAML_DT_BOARD_FLAGS ?= "{BOARD zcu102-rev1.0}"

# Yocto arm-trusted-firmware(TF-A) variables
ATF_CONSOLE ?= "cadence"
TFA_BL33_LOAD ?= "0x8000000"

# Yocto PMUFW variables
YAML_SERIAL_CONSOLE_STDIN:pn-pmu-firmware ?= "psu_uart_0"
YAML_SERIAL_CONSOLE_STDOUT:pn-pmu-firmware ?= "psu_uart_0"

# Yocto FSBL variables
YAML_SERIAL_CONSOLE_STDIN:pn-fsbl-firmware ?= "psu_uart_0"
YAML_SERIAL_CONSOLE_STDOUT:pn-fsbl-firmware ?= "psu_uart_0"

# Yocto KERNEL Variables
UBOOT_ENTRYPOINT  ?= "0x200000"
UBOOT_LOADADDRESS ?= "0x200000"

# zcu102-zynqmp Serial Console
SERIAL_CONSOLES ?= "115200;ttyPS0"
YAML_SERIAL_CONSOLE_BAUDRATE ?= "115200"

# Required generic machine inclusion
# ZCU102 board uses ZynqMP EG device hence use soc variant based generic machine
# inclusion
require conf/machine/zynqmp-eg-generic.conf

# This eval board machine conf file uses zcu102-zynqmp xsa as reference input.
# User can override with zcu102 custom xsa using HDF_BASE and HDF_PATH variables
# from local.conf.
HDF_MACHINE = "zcu102-zynqmp"

# KERNEL_DEVICETREE is disabled as we use board device tree from DTG to match
# the xsa. User can enable explicitly if required from local.conf.
# KERNEL_DEVICETREE = "xilinx/zynqmp-zcu102-rev1.0.dtb"

#### No additional settings should be after the Postamble
#### Postamble
PACKAGE_EXTRA_ARCHS:append = "${@['', ' zcu102_zynqmp']['zcu102-zynqmp' != '${MACHINE}']}"
```
