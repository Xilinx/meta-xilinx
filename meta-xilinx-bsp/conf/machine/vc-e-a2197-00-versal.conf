## meta-xilinx-bsp/conf/machine/vc-e-a2197-00-versal.conf
```bitbake
#@TYPE: Machine
#@NAME: vc-e-a2197-versal
##@DESCRIPTION: Machine support for vc-e-a2197 versal .

SOC_VARIANT ?= "s80"

require conf/machine/include/tune-versal.inc
require conf/machine/include/machine-xilinx-overrides.inc
require conf/machine/include/machine-xilinx-default.inc

MACHINE_FEATURES = "rtc ext2 ext3 vfat usbhost"

UBOOT_MACHINE ?= "xilinx_versal_virt_defconfig"

SERIAL_CONSOLE = "115200 ttyAMA0"
SERIAL_CONSOLES_CHECK = "${SERIAL_CONSOLES}"

PREFERRED_PROVIDER_virtual/kernel ?= "linux-xlnx"
PREFERRED_PROVIDER_virtual/bootloader ?= "u-boot-xlnx"

EXTRA_IMAGEDEPENDS += " \
   arm-trusted-firmware \
   virtual/boot-bin \
   virtual/bootloader \
   virtual/psm-firmware \
   virtual/plm \
   u-boot-zynq-scr \
"

IMAGE_BOOT_FILES += " \
    boot.bin \
    system.dtb \
    Image \
    boot.scr \
"
```

## meta-xilinx-bsp/conf/machine/vc-p-a2197-00-versal.conf
```bitbake
#@TYPE: Machine
#@NAME: vc-p-a2197-versal
##@DESCRIPTION: Machine support for vc-p-a2197 versal .

SOC_VARIANT = "ai-core"

require conf/machine/versal-generic.conf
```

## meta-xilinx-bsp/conf/machine/vck-sc-zynqmp.conf
```bitbake
#@TYPE: Machine
#@NAME: vck-sc-zynqmp 
##@DESCRIPTION: Machine support for vck190 system controller.

SOC_VARIANT = "eg"

require conf/machine/zynqmp-generic.conf

# Add board compatibility override
MACHINEOVERRIDES .= ":vck-sc"
```

## meta-xilinx-bsp/conf/machine/vck190-versal.conf
```bitbake
#@TYPE: Machine
#@NAME: vck190-versal
#@DESCRIPTION: Machine configuration for the VCK190 evaluation board.

# Compatibility with old BOARD value.
# TODO - Remove these once removed from petalinux bsp
MACHINEOVERRIDES =. "vck190:"

#### Preamble
MACHINEOVERRIDES =. "${@['', 'vck190-versal:']['vck190-versal' !='${MACHINE}']}"
#### Regular settings follow

# Variables that changes based on hw design or board specific requirement must be
# defined before calling the required inclusion file else pre-expansion value
# defined in versal-generic.conf will be set.

# Yocto device-tree variables
YAML_CONSOLE_DEVICE_CONFIG:pn-device-tree ?= "CIPS_0_pspmc_0_psv_sbsauart_0"
YAML_DT_BOARD_FLAGS ?= "{BOARD versal-vck190-reva-x-ebm-01-reva}"

# Yocto arm-trusted-firmware(TF-A) variables
ATF_CONSOLE_DEFAULT ?= "pl011"
TFA_BL33_LOAD ?= "0x8000000"

# Yocto PLM variables
YAML_SERIAL_CONSOLE_STDIN:pn-plm-firmware ?= "CIPS_0_pspmc_0_psv_sbsauart_0"
YAML_SERIAL_CONSOLE_STDOUT:pn-plm-firmware ?= "CIPS_0_pspmc_0_psv_sbsauart_0"

# Yocto KERNEL Variables
UBOOT_ENTRYPOINT  ?= "0x200000"
UBOOT_LOADADDRESS ?= "0x200000"

# vck190-versal Serial Console
SERIAL_CONSOLES ?= "115200;ttyAMA0"
YAML_SERIAL_CONSOLE_BAUDRATE ?= "115200"

# Required generic machine inclusion
# VCK190 board uses Versal AI Core device hence use soc variant based generic
# machine inclusion
require conf/machine/versal-ai-core-generic.conf

# This machine conf file uses vck190-versal xsa as reference input.
# User can override with vck190 custom xsa using HDF_BASE and HDF_PATH variables
# from local.conf.
HDF_MACHINE = "vck190-versal"

#### No additional settings should be after the Postamble
#### Postamble
PACKAGE_EXTRA_ARCHS:append = "${@['', 'vck190_versal']['vck190-versal' != '${MACHINE}']}"
```

## meta-xilinx-bsp/conf/machine/vck5000-versal.conf
```bitbake
#@TYPE: Machine
#@NAME: vck500-versal
#@DESCRIPTION: Machine configuration for the VCK5000 evaluation board.

# Compatibility with old BOARD value.
# TODO - Remove these once removed from petalinux bsp
MACHINEOVERRIDES =. "vck5000:"

#### Preamble
MACHINEOVERRIDES =. "${@['', 'vck5000-versal:']['vck5000-versal' !='${MACHINE}']}"
#### Regular settings follow

# Variables that changes based on hw design or board specific requirement must be
# defined before calling the required inclusion file else pre-expansion value
# defined in versal-generic.conf will be set.

# Yocto device-tree variables
YAML_CONSOLE_DEVICE_CONFIG:pn-device-tree ?= "versal_cips_0_pspmc_0_psv_sbsauart_0"
YAML_DT_BOARD_FLAGS ?= "{BOARD template}"

# Yocto arm-trusted-firmware(TF-A) variables
ATF_CONSOLE_DEFAULT ?= "pl011"
TFA_BL33_LOAD ?= "0x8000000"

# Yocto PLM variables
YAML_SERIAL_CONSOLE_STDIN:pn-plm-firmware ?= "versal_cips_0_pspmc_0_psv_sbsauart_0"
YAML_SERIAL_CONSOLE_STDOUT:pn-plm-firmware ?= "versal_cips_0_pspmc_0_psv_sbsauart_0"

# Yocto KERNEL Variables
UBOOT_ENTRYPOINT  ?= "0x200000"
UBOOT_LOADADDRESS ?= "0x200000"

# vck5000-versal Serial Console
SERIAL_CONSOLES ?= "115200;ttyAMA0"
YAML_SERIAL_CONSOLE_BAUDRATE ?= "115200"

# Required generic machine inclusion
# VCK5000 board uses Versal AI Core device hence use soc variant based generic
# machine inclusion
require conf/machine/versal-ai-core-generic.conf

# This machine conf file uses vck5000-versal xsa as reference input.
# User can override with vck5000 custom xsa using HDF_BASE and HDF_PATH variables
# from local.conf.
HDF_MACHINE = "vck5000-versal"

#### No additional settings should be after the Postamble
#### Postamble
PACKAGE_EXTRA_ARCHS:append = "${@['', 'vck5000_versal']['vck5000-versal' != '${MACHINE}']}"
```

## meta-xilinx-bsp/conf/machine/vcu118-microblazeel.conf
```bitbake
#@TYPE: Machine
#@NAME: vcu118-microblazeel
#@DESCRIPTION: Machine configuration for the VCU118 evaluation board.

#### Preamble
MACHINEOVERRIDES =. "${@['', 'vcu118-microblazeel:']['vcu118-microblazeel' !='${MACHINE}']}"
#### Regular settings follow

# Variables that changes based on hw design or board specific requirement must be
# defined before calling the required inclusion file else pre-expansion value
# defined in microblazeel-generic.conf will be set.

# Yocto VCU118 FS-Boot variables
YAML_SERIAL_CONSOLE_STDIN:pn-fs-boot ?= "axi_uartlite_0"
YAML_SERIAL_CONSOLE_STDOUT:pn-fs-boot ?= "axi_uartlite_0"
YAML_MAIN_MEMORY_CONFIG:pn-fs-boot ?= "DDR4_0"
YAML_FLASH_MEMORY_CONFIG:pn-fs-boot ?= "axi_quad_spi_0"
XSCTH_PROC:pn-fs-boot ?= "microblaze_0"

# Yocto VCU118 device-tree variables
YAML_CONSOLE_DEVICE_CONFIG:pn-device-tree ?= "axi_uartlite_0"
YAML_MAIN_MEMORY_CONFIG:pn-device-tree ?= "DDR4_0"
DT_PADDING_SIZE:pn-device-tree ?= "0x1000"
DTC_FLAGS:pn-device-tree ?= ""
XSCTH_PROC:pn-device-tree ?= "microblaze_0"
YAML_DT_BOARD_FLAGS ?= "{BOARD vcu118-rev2.0}"

# Yocto KERNEL Variables
UBOOT_ENTRYPOINT  ?= "0x80000000"
UBOOT_LOADADDRESS ?= "0x80000000"

# Set DDR Base address for u-boot-xlnx-scr variables
DDR_BASEADDR ?= "0x80000000"
SKIP_APPEND_BASEADDR ?= "0"

# Required generic machine inclusion
require conf/machine/microblaze-generic.conf

# This machine conf file uses vcu118-microblazeel xsa as reference input.
# User can override with vcu118 custom xsa using HDF_BASE and HDF_PATH variables
# from local.conf.
HDF_MACHINE = "vcu118-microblazeel"

#### No additional settings should be after the Postamble
#### Postamble
PACKAGE_EXTRA_ARCHS:append = "${@['', 'vcu118_microblazeel']['vcu118-microblazeel' != '${MACHINE}']}"
```

## meta-xilinx-bsp/conf/machine/vek280-versal.conf
```bitbake
XILINX_DEPRECATED[vek280-versal] = "${@'vek280-versal is not supported in 2023.2' if d.getVar("XILINX_RELEASE_VERSION") == 'v2023.2' else ''}"

#@TYPE: Machine
#@NAME: vek280-versal
#@DESCRIPTION: Machine configuration for the VEK280 evaluation boards.

#### Preamble
MACHINEOVERRIDES =. "${@['', 'vek280-versal:']['vek280-versal' !='${MACHINE}']}"
#### Regular settings follow

# Variables that changes based on hw design or board specific requirement must be
# defined before calling the required inclusion file else pre-expansion value
# defined in versal-generic.conf will be set.

# Yocto device-tree variables
YAML_CONSOLE_DEVICE_CONFIG:pn-device-tree ?= "CIPS_0_pspmc_0_psv_sbsauart_0"
YAML_DT_BOARD_FLAGS ?= "{BOARD versal-vek280-revb}"

# Yocto arm-trusted-firmware(TF-A) variables
ATF_CONSOLE ?= "pl011"
TFA_BL33_LOAD ?= "0x8000000"

# Yocto PLM variables
YAML_SERIAL_CONSOLE_STDIN:pn-plm-firmware ?= "CIPS_0_pspmc_0_psv_sbsauart_0"
YAML_SERIAL_CONSOLE_STDOUT:pn-plm-firmware ?= "CIPS_0_pspmc_0_psv_sbsauart_0"

# Yocto KERNEL Variables
UBOOT_ENTRYPOINT  ?= "0x200000"
UBOOT_LOADADDRESS ?= "0x200000"

# vek280-versal Serial Console
SERIAL_CONSOLES ?= "115200;ttyAMA0"
YAML_SERIAL_CONSOLE_BAUDRATE ?= "115200"

# Required generic machine inclusion
require conf/machine/versal-ai-edge-generic.conf

# This machine conf file uses vek280-versal xsa as reference input.
# User can override with vek280 custom xsa using HDF_BASE and HDF_PATH variables
# from local.conf.
HDF_MACHINE = "vek280-versal"

# VEK280 board has 12GB memory only but default versal-generic has QB_MEM set to
# 8G, Hence we need set 12G in QB_MEM.
QB_MEM = "-m 12G"

QEMU_HW_DTB_PS = "${QEMU_HW_DTB_PATH}/board-versal-ps-vek280.dtb"
QEMU_HW_DTB_PMC = "${QEMU_HW_DTB_PATH}/board-versal-pmc-virt.dtb"

# Yocto MACHINE_FEATURES Variable
MACHINE_FEATURES += "vdu"

#### No additional settings should be after the Postamble
#### Postamble
PACKAGE_EXTRA_ARCHS:append = "${@['', ' vek280_versal']['vek280-versal' != '${MACHINE}']}"
```

## meta-xilinx-bsp/conf/machine/versal-generic.conf
```bitbake
#@TYPE: Machine
#@NAME: Generic versal
#@DESCRIPTION: versal devices

require conf/machine/include/soc-versal.inc
require conf/machine/include/machine-xilinx-default.inc
require conf/machine/include/machine-xilinx-qemu.inc
require conf/machine/include/xilinx-board.inc

MACHINE_FEATURES += "rtc ext2 ext3 vfat usbhost"

EXTRA_IMAGEDEPENDS += "libyaml-native python3-cython-native python3-pyyaml-native"

UBOOT_MACHINE ?= "xilinx_versal_virt_defconfig"

SERIAL_CONSOLES ?= "115200;ttyAMA0"

MACHINE_ESSENTIAL_EXTRA_RDEPENDS += "device-tree"

HDF_MACHINE = "vck190-versal"

# Default SD image build onfiguration, use qemu-sd to pad
IMAGE_CLASSES += "image-types-xilinx-qemu"
IMAGE_FSTYPES += "wic.qemu-sd"
WKS_FILES ?= "sdimage-bootpart.wks"

EXTRA_IMAGEDEPENDS += " \
   arm-trusted-firmware \
   virtual/boot-bin \
   virtual/bootloader \
   virtual/psm-firmware \
   virtual/plm \
   u-boot-zynq-scr \
   qemu-devicetrees \
   virtual/cdo \
"

IMAGE_BOOT_FILES += " \
    boot.bin \
    ${@bb.utils.contains('PREFERRED_PROVIDER_virtual/dtb', 'device-tree', 'system.dtb', '', d)} \
    Image \
    boot.scr \
"


# This machine has a QEMU model, runqemu setup:
QB_MEM = "-m 8G"
QB_DEFAULT_KERNEL = "none"
QB_NETWORK_DEVICE = ""
QB_KERNEL_CMDLINE_APPEND ?= ""
QB_NET = "none"

QB_DEFAULT_FSTYPE_qemuboot-xilinx = "wic.qemu-sd"
QB_OPT_APPEND_append_qemuboot-xilinx = " -boot mode=5"
QB_ROOTFS_OPT_qemuboot-xilinx = " -drive if=sd,index=1,file=@ROOTFS@,format=raw"

# Use booti 80000 6000000 4000000 to launch
QB_OPT_APPEND ?= " -serial null -serial null -serial mon:stdio -display none"

QEMU_HW_DTB_PATH = "${DEPLOY_DIR_IMAGE}/qemu-hw-devicetrees/multiarch"
QEMU_HW_DTB_PS ?="${QEMU_HW_DTB_PATH}/board-versal-ps-vc-p-a2197-00.dtb"
QEMU_HW_DTB_PMC ?="${QEMU_HW_DTB_PATH}/board-versal-pmc-vc-p-a2197-00.dtb"

QEMU_HW_DTB_PS_vp1202-versal = "${QEMU_HW_DTB_PATH}/board-versal-vp1202-ps-virt.dtb"
QEMU_HW_DTB_PMC_vp1202-versal = "${QEMU_HW_DTB_PATH}/board-versal-vp1202-pmc-virt.dtb"

QB_OPT_APPEND_append_qemuboot-xilinx = " \
    -hw-dtb ${QEMU_HW_DTB_PS} \
    -display none \
    -net nic -net user,tftp=${DEPLOY_DIR_IMAGE} \
    "

# PLM instance args
QB_PLM_OPT = " \
    -M microblaze-fdt \
    -device loader,file=${DEPLOY_DIR_IMAGE}/BOOT-${MACHINE}_bh.bin,addr=0xF201E000,force-raw  \
    -device loader,addr=0xf0000000,data=0xba020004,data-len=4 \
    -device loader,addr=0xf0000004,data=0xb800fffc,data-len=4 \
    -device loader,file=${DEPLOY_DIR_IMAGE}/pmc_cdo.bin,addr=0xf2000000,force-raw \
    -device loader,file=${DEPLOY_DIR_IMAGE}/plm-${MACHINE}.elf,cpu-num=1 \
    -device loader,addr=0xF1110624,data=0x0,data-len=4 \
    -device loader,addr=0xF1110620,data=0x1,data-len=4 \
    -hw-dtb ${QEMU_HW_DTB_PMC} \
    -display none \
    "
QB_OPT_APPEND_append_qemuboot-xilinx = " -plm-args '${QB_PLM_OPT}'"
```

## meta-xilinx-bsp/conf/machine/vhk158-versal.conf
```bitbake
#@TYPE: Machine
#@NAME: vhk158-versal
#@DESCRIPTION: Machine configuration for the VHK158 evaluation board.

#### Preamble
MACHINEOVERRIDES =. "${@['', 'vhk158-versal:']['vhk158-versal' !='${MACHINE}']}"
#### Regular settings follow

# Variables that changes based on hw design or board specific requirement must be
# defined before calling the required inclusion file else pre-expansion value
# defined in versal-generic.conf will be set.

# Yocto device-tree variables
YAML_CONSOLE_DEVICE_CONFIG:pn-device-tree ?= "versal_cips_0_pspmc_0_psv_sbsauart_0"
YAML_DT_BOARD_FLAGS ?= "{BOARD versal-vhk158-reva}"

# Yocto arm-trusted-firmware(TF-A) variables
ATF_CONSOLE ?= "pl011"
TFA_BL33_LOAD ?= "0x8000000"

# Yocto PLM variables
YAML_SERIAL_CONSOLE_STDIN:pn-plm-firmware ?= "versal_cips_0_pspmc_0_psv_sbsauart_0"
YAML_SERIAL_CONSOLE_STDOUT:pn-plm-firmware ?= "versal_cips_0_pspmc_0_psv_sbsauart_0"

# Yocto KERNEL Variables
UBOOT_ENTRYPOINT  ?= "0x200000"
UBOOT_LOADADDRESS ?= "0x200000"

# vhk158-versal Serial Console
SERIAL_CONSOLES ?= "115200;ttyAMA0"
YAML_SERIAL_CONSOLE_BAUDRATE ?= "115200"

# Required generic machine inclusion
# VHK158 board uses Versal HBM device hence use soc variant based generic
# machine inclusion
require conf/machine/versal-hbm-generic.conf

# This machine conf file uses vhk158-versal xsa as reference input.
# User can override with vhk158 custom xsa using HDF_BASE and HDF_PATH variables
# from local.conf.
HDF_MACHINE = "vhk158-versal"

# VHK158 has 32GB memory only but default versal-generic has QB_MEM set to 8G,
# Since versal-vhk158-reva.dts has 32GB set, we need set same in QB_MEM
QB_MEM = "-m 32G"

QEMU_HW_DTB_PS =  "${QEMU_HW_DTB_PATH}/board-versal-ps-vhk158.dtb"
QEMU_HW_DTB_PMC = "${QEMU_HW_DTB_PATH}/board-versal-pmc-virt.dtb"

#### No additional settings should be after the Postamble
#### Postamble
PACKAGE_EXTRA_ARCHS:append = "${@['', ' vhk158_versal']['vhk158-versal' != '${MACHINE}']}"
```
