## meta-xilinx-bsp/conf/machine/zcu104-zynqmp.conf
```bitbake
#@TYPE: Machine
#@NAME: zcu104-zynqmp
#@DESCRIPTION: Machine configuration for the ZCU104 evaluation board.

#### Preamble
MACHINEOVERRIDES =. "${@['', 'zcu104-zynqmp:']['zcu104-zynqmp' !='${MACHINE}']}"
#### Regular settings follow

# Variables that changes based on hw design or board specific requirement must be
# defined before calling the required inclusion file else pre-expansion value
# defined in zynqmp-generic.conf will be set.

# Yocto device-tree variables
YAML_CONSOLE_DEVICE_CONFIG:pn-device-tree ?= "psu_uart_0"
YAML_MAIN_MEMORY_CONFIG:pn-device-tree ?= "PSU_DDR_0"
YAML_DT_BOARD_FLAGS ?= "{BOARD zcu104-revc}"

# Yocto arm-trusted-firmware(TF-A) variables
ATF_CONSOLE_DEFAULT ?= "cadence"
TFA_BL33_LOAD ?= "0x8000000"

# Yocto PMUFW variables
YAML_SERIAL_CONSOLE_STDIN:pn-pmu-firmware ?= "psu_uart_0"
YAML_SERIAL_CONSOLE_STDOUT:pn-pmu-firmware ?= "psu_uart_0"

# Yocto FSBL variables
YAML_SERIAL_CONSOLE_STDIN:pn-fsbl-firmware ?= "psu_uart_0"
YAML_SERIAL_CONSOLE_STDOUT:pn-fsbl-firmware ?= "psu_uart_0"

# Yocto KERNEL Variables
UBOOT_ENTRYPOINT  ?= "0x200000"
UBOOT_LOADADDRESS ?= "0x200000"

# zcu104-zynqmp Serial Console
SERIAL_CONSOLES ?= "115200;ttyPS0"
YAML_SERIAL_CONSOLE_BAUDRATE ?= "115200"

# Required generic machine inclusion
# ZCU104 board uses ZynqMP EV device hence use soc variant based generic machine
# inclusion
require conf/machine/zynqmp-ev-generic.conf

# This eval board machine conf file uses zcu104-zynqmp xsa as reference input.
# User can override with zcu104 custom xsa using HDF_BASE and HDF_PATH variables
# from local.conf.
HDF_MACHINE = "zcu104-zynqmp"

# KERNEL_DEVICETREE is disabled as we use board device tree from DTG to match
# the xsa. User can enable explicitly if required from local.conf.
# KERNEL_DEVICETREE = "xilinx/zynqmp-zcu104-revC.dtb"

MACHINE_HWCODECS = "libomxil-xlnx"
IMAGE_FEATURES += "hwcodecs"

#### No additional settings should be after the Postamble
#### Postamble
PACKAGE_EXTRA_ARCHS:append = "${@['', 'zcu104_zynqmp']['zcu104-zynqmp' != '${MACHINE}']}"
```

## meta-xilinx-bsp/conf/machine/zcu106-zynqmp.conf
```bitbake
#@TYPE: Machine
#@NAME: zcu106-zynqmp
#@DESCRIPTION: Machine support for ZCU106 Evaluation Board.

SOC_VARIANT ?= "ev"

require conf/machine/zynqmp-generic.conf

KERNEL_DEVICETREE = "xilinx/zynqmp-zcu106-revA.dtb"

MACHINE_HWCODECS = "libomxil-xlnx"
```

## meta-xilinx-bsp/conf/machine/zcu111-zynqmp.conf
```bitbake
#@TYPE: Machine
#@NAME: zcu111-zynqmp
#@DESCRIPTION: Machine support for ZCU111 Evaluation Board.
#

SOC_VARIANT ?= "dr"

require conf/machine/zynqmp-generic.conf

KERNEL_DEVICETREE = "xilinx/zynqmp-zcu111-revA.dtb"
```

## meta-xilinx-bsp/conf/machine/zcu1275-zynqmp.conf
```bitbake
#@TYPE: Machine
#@NAME: zcu1275-zynqmp
#@DESCRIPTION: Machine support for ZCU1275 Evaluation Board.
#

SOC_VARIANT ?= "dr"

require conf/machine/zynqmp-generic.conf

KERNEL_DEVICETREE = "xilinx/zynqmp-zcu1275-revB.dtb"
```

## meta-xilinx-bsp/conf/machine/zcu1285-zynqmp.conf
```bitbake
#@TYPE: Machine
#@NAME: zcu1285-zynqmp
#@DESCRIPTION: Machine support for ZCU1285 Evaluation Board.
#

SOC_VARIANT ?= "dr"

require conf/machine/zynqmp-generic.conf

KERNEL_DEVICETREE = "xilinx/zynqmp-zcu1285-revA.dtb"
```

## meta-xilinx-bsp/conf/machine/zcu216-zynqmp.conf
```bitbake
#@TYPE: Machine
#@NAME: zcu216-zynqmp
#@DESCRIPTION: Machine support for ZCU216 Evaluation Board.
#

SOC_VARIANT = "dr"

require conf/machine/zynqmp-generic.conf

# Add board compatibility override
MACHINEOVERRIDES .= ":zcu216"
```

## meta-xilinx-bsp/conf/machine/zcu670-zynqmp.conf
```bitbake
#@TYPE: Machine
#@NAME: zcu670-zynqmp
#@DESCRIPTION: Machine configuration for the ZCU670 evaluation board.

#### Preamble
MACHINEOVERRIDES =. "${@['', 'zcu670-zynqmp:']['zcu670-zynqmp' !='${MACHINE}']}"
#### Regular settings follow

# Variables that changes based on hw design or board specific requirement must be
# defined before calling the required inclusion file else pre-expansion value
# defined in zynqmp-generic.conf will be set.

# Yocto device-tree variables
YAML_CONSOLE_DEVICE_CONFIG:pn-device-tree ?= "psu_uart_0"
YAML_MAIN_MEMORY_CONFIG:pn-device-tree ?= "PSU_DDR_0"
YAML_DT_BOARD_FLAGS ?= "{BOARD zcu670-revb}"

# Yocto arm-trusted-firmware(TF-A) variables
ATF_CONSOLE ?= "cadence"
TFA_BL33_LOAD ?= "0x8000000"

# Yocto PMUFW variables
YAML_SERIAL_CONSOLE_STDIN:pn-pmu-firmware ?= "psu_uart_0"
YAML_SERIAL_CONSOLE_STDOUT:pn-pmu-firmware ?= "psu_uart_0"

# Yocto FSBL variables
YAML_SERIAL_CONSOLE_STDIN:pn-fsbl-firmware ?= "psu_uart_0"
YAML_SERIAL_CONSOLE_STDOUT:pn-fsbl-firmware ?= "psu_uart_0"

# Yocto KERNEL Variables
UBOOT_ENTRYPOINT  ?= "0x200000"
UBOOT_LOADADDRESS ?= "0x200000"

# zcu670-zynqmp Serial Console 
SERIAL_CONSOLES ?= "115200;ttyPS0"
YAML_SERIAL_CONSOLE_BAUDRATE ?= "115200"

# Required generic machine inclusion
# ZCU670 board uses ZynqMP DR device hence use soc variant based generic machine
# inclusion
require conf/machine/zynqmp-dr-generic.conf

# This eval board machine conf file uses zcu670-zynqmp xsa as reference input.
# User can override with zcu670 custom xsa using HDF_BASE and HDF_PATH variables
# from local.conf.
HDF_MACHINE = "zcu670-zynqmp"

#### No additional settings should be after the Postamble
#### Postamble
PACKAGE_EXTRA_ARCHS:append = "${@['', 'zcu670_zynqmp']['zcu670-zynqmp' != '${MACHINE}']}"
```
