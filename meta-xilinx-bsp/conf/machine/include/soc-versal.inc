## meta-xilinx-bsp/conf/machine/microblaze-tc.conf
```bitbake
require conf/multilib.conf
require conf/machine/include/microblaze/arch-microblaze.inc
require conf/machine/include/baremetal-tc.conf

# ILP request an alternative machine dictionary
INHERIT += "xlnx-standalone"
PACKAGEQA_EXTRA_MACHDEFFUNCS .= '${@bb.utils.contains("TUNE_FEATURES", "64-bit", " xlnx_mb64_dict", "", d)}'

# GNU hash style not supported
TARGET_LINK_HASH_STYLE = ""

# Define all of the multilibs supproted by this configuration
MULTILIB_GLOBAL_VARIANTS = "${@extend_variants(d,'MULTILIBS','multilib')}"

MULTILIBS += "multilib:libmbbs"
MULTILIBS += "multilib:libmble"
MULTILIBS += "multilib:libmbm"
MULTILIBS += "multilib:libmbmmh"
MULTILIBS += "multilib:libmblem"
MULTILIBS += "multilib:libmblemmh"
MULTILIBS += "multilib:libmbbsle"
MULTILIBS += "multilib:libmbbsm"
MULTILIBS += "multilib:libmbbsmmh"
MULTILIBS += "multilib:libmbbslem"
MULTILIBS += "multilib:libmbbslemmh"
MULTILIBS += "multilib:libmbm64le"
MULTILIBS += "multilib:libmbm64lem"
MULTILIBS += "multilib:libmbm64lemmh"
MULTILIBS += "multilib:libmbm64bsle"
MULTILIBS += "multilib:libmbm64bslem"
MULTILIBS += "multilib:libmbm64bslemmh"


# Base configuration
# CFLAGS:
DEFAULTTUNE = "microblaze"

AVAILTUNES += "microblaze"
BASE_LIB_tune-microblaze = "lib"
TUNE_FEATURES_tune-microblaze = "microblaze bigendian"
PACKAGE_EXTRA_ARCHS_tune-microblaze = "${TUNE_PKGARCH}"


# bs
# CFLAGS: -mxl-barrel-shift
DEFAULTTUNE_virtclass-multilib-libmbbs = "microblazebs"

AVAILTUNES += "microblazebs"
BASE_LIB_tune-microblazebs = "lib/bs"
TUNE_FEATURES_tune-microblazebs = "microblaze bigendian barrel-shift"
PACKAGE_EXTRA_ARCHS_tune-microblazebs = "${TUNE_PKGARCH}"


# le
# CFLAGS: -mlittle-endian
DEFAULTTUNE_virtclass-multilib-libmble = "microblazele"

AVAILTUNES += "microblazele"
BASE_LIB_tune-microblazele = "lib/le"
TUNE_FEATURES_tune-microblazele = "microblaze"
PACKAGE_EXTRA_ARCHS_tune-microblazele = "${TUNE_PKGARCH}"


# m
# CFLAGS: -mno-xl-soft-mul
DEFAULTTUNE_virtclass-multilib-libmbm = "microblazem"

AVAILTUNES += "microblazem"
BASE_LIB_tune-microblazem = "lib/m"
TUNE_FEATURES_tune-microblazem = "microblaze bigendian multiply-low"
PACKAGE_EXTRA_ARCHS_tune-microblazem = "${TUNE_PKGARCH}"


# m/mh
# CFLAGS: -mno-xl-soft-mul -mxl-multiply-high
DEFAULTTUNE_virtclass-multilib-libmbmmh = "microblazemmh"

AVAILTUNES += "microblazemmh"
BASE_LIB_tune-microblazemmh = "lib/m/mh"
TUNE_FEATURES_tune-microblazemmh = "microblaze bigendian multiply-high"
PACKAGE_EXTRA_ARCHS_tune-microblazemmh = "${TUNE_PKGARCH}"


# le/m
# CFLAGS: -mlittle-endian -mno-xl-soft-mul
DEFAULTTUNE_virtclass-multilib-libmblem = "microblazelem"

AVAILTUNES += "microblazelem"
BASE_LIB_tune-microblazelem = "lib/le/m"
TUNE_FEATURES_tune-microblazelem = "microblaze multiply-low"
PACKAGE_EXTRA_ARCHS_tune-microblazelem = "${TUNE_PKGARCH}"


# le/m/mh
# CFLAGS: -mlittle-endian -mno-xl-soft-mul -mxl-multiply-high
DEFAULTTUNE_virtclass-multilib-libmblemmh = "microblazelemmh"

AVAILTUNES += "microblazelemmh"
BASE_LIB_tune-microblazelemmh = "lib/le/m/mh"
TUNE_FEATURES_tune-microblazelemmh = "microblaze multiply-high"
PACKAGE_EXTRA_ARCHS_tune-microblazelemmh = "${TUNE_PKGARCH}"


# bs/le
# CFLAGS: -mxl-barrel-shift -mlittle-endian
DEFAULTTUNE_virtclass-multilib-libmbbsle = "microblazebsle"

AVAILTUNES += "microblazebsle"
BASE_LIB_tune-microblazebsle = "lib/bs/le"
TUNE_FEATURES_tune-microblazebsle = "microblaze barrel-shift"
PACKAGE_EXTRA_ARCHS_tune-microblazebsle = "${TUNE_PKGARCH}"


# bs/m
# CFLAGS: -mxl-barrel-shift -mno-xl-soft-mul
DEFAULTTUNE_virtclass-multilib-libmbbsm = "microblazebsm"

AVAILTUNES += "microblazebsm"
BASE_LIB_tune-microblazebsm = "lib/bs/m"
TUNE_FEATURES_tune-microblazebsm = "microblaze bigendian barrel-shift multiply-low"
PACKAGE_EXTRA_ARCHS_tune-microblazebsm = "${TUNE_PKGARCH}"


# bs/m/mh
# CFLAGS: -mxl-barrel-shift -mno-xl-soft-mul -mxl-multiply-high
DEFAULTTUNE_virtclass-multilib-libmbbsmmh = "microblazebsmmh"

AVAILTUNES += "microblazebsmmh"
BASE_LIB_tune-microblazebsmmh = "lib/bs/m/mh"
TUNE_FEATURES_tune-microblazebsmmh = "microblaze bigendian barrel-shift multiply-high"
PACKAGE_EXTRA_ARCHS_tune-microblazebsmmh = "${TUNE_PKGARCH}"


# bs/le/m
# CFLAGS: -mxl-barrel-shift -mlittle-endian -mno-xl-soft-mul
DEFAULTTUNE_virtclass-multilib-libmbbslem = "microblazebslem"

AVAILTUNES += "microblazebslem"
BASE_LIB_tune-microblazebslem = "lib/bs/le/m"
TUNE_FEATURES_tune-microblazebslem = "microblaze barrel-shift multiply-low"
PACKAGE_EXTRA_ARCHS_tune-microblazebslem = "${TUNE_PKGARCH}"


# bs/le/m/mh
# CFLAGS: -mxl-barrel-shift -mlittle-endian -mno-xl-soft-mul -mxl-multiply-high
DEFAULTTUNE_virtclass-multilib-libmbbslemmh = "microblazebslemmh"

AVAILTUNES += "microblazebslemmh"
BASE_LIB_tune-microblazebslemmh = "lib/bs/le/m/mh"
TUNE_FEATURES_tune-microblazebslemmh = "microblaze barrel-shift multiply-high"
PACKAGE_EXTRA_ARCHS_tune-microblazebslemmh = "${TUNE_PKGARCH}"


# m64/le
# CFLAGS: -m64 -mlittle-endian
DEFAULTTUNE_virtclass-multilib-libmbm64le = "microblaze64le"

AVAILTUNES += "microblaze64le"
BASE_LIB_tune-microblaze64le = "lib/m64/le"
TUNE_FEATURES_tune-microblaze64le = "microblaze 64-bit"
PACKAGE_EXTRA_ARCHS_tune-microblaze64le = "${TUNE_PKGARCH}"


# m64/le/m
# CFLAGS: -m64 -mlittle-endian -mno-xl-soft-mul
DEFAULTTUNE_virtclass-multilib-libmbm64lem = "microblaze64lem"

AVAILTUNES += "microblaze64lem"
BASE_LIB_tune-microblaze64lem = "lib/m64/le/m"
TUNE_FEATURES_tune-microblaze64lem = "microblaze 64-bit multiply-low"
PACKAGE_EXTRA_ARCHS_tune-microblaze64lem = "${TUNE_PKGARCH}"


# m64/le/m/mh
# CFLAGS: -m64 -mlittle-endian -mno-xl-soft-mul -mxl-multiply-high
DEFAULTTUNE_virtclass-multilib-libmbm64lemmh = "microblaze64lemmh"

AVAILTUNES += "microblaze64lemmh"
BASE_LIB_tune-microblaze64lemmh = "lib/m64/le/m/mh"
TUNE_FEATURES_tune-microblaze64lemmh = "microblaze 64-bit multiply-high"
PACKAGE_EXTRA_ARCHS_tune-microblaze64lemmh = "${TUNE_PKGARCH}"


# m64/bs/le
# CFLAGS: -m64 -mxl-barrel-shift -mlittle-endian
DEFAULTTUNE_virtclass-multilib-libmbm64bsle = "microblaze64bsle"

AVAILTUNES += "microblaze64bsle"
BASE_LIB_tune-microblaze64bsle = "lib/m64/bs/le"
TUNE_FEATURES_tune-microblaze64bsle = "microblaze 64-bit barrel-shift"
PACKAGE_EXTRA_ARCHS_tune-microblaze64bsle = "${TUNE_PKGARCH}"


# m64/bs/le/m
# CFLAGS: -m64 -mxl-barrel-shift -mlittle-endian -mno-xl-soft-mul
DEFAULTTUNE_virtclass-multilib-libmbm64bslem = "microblaze64bslem"

AVAILTUNES += "microblaze64bslem"
BASE_LIB_tune-microblaze64bslem = "lib/m64/bs/le/m"
TUNE_FEATURES_tune-microblaze64bslem = "microblaze 64-bit barrel-shift multiply-low"
PACKAGE_EXTRA_ARCHS_tune-microblaze64bslem = "${TUNE_PKGARCH}"


# m64/bs/le/m/mh
# CFLAGS: -m64 -mxl-barrel-shift -mlittle-endian -mno-xl-soft-mul -mxl-multiply-high
DEFAULTTUNE_virtclass-multilib-libmbm64bslemmh = "microblaze64bslemmh"

AVAILTUNES += "microblaze64bslemmh"
BASE_LIB_tune-microblaze64bslemmh = "lib/m64/bs/le/m/mh"
TUNE_FEATURES_tune-microblaze64bslemmh = "microblaze 64-bit barrel-shift multiply-high"
PACKAGE_EXTRA_ARCHS_tune-microblaze64bslemmh = "${TUNE_PKGARCH}"
```

## meta-xilinx-bsp/conf/machine/microblazeel-v11.0-bs-cmp-mh-div-generic.conf
```bitbake
#@TYPE: Machine
#@NAME: microblazeel-v11.0-bs-cmp-mh-div-generic
#@DESCRIPTION: microblazeel-v11.0-bs-cmp-mh-div

TUNE_FEATURES:tune-microblaze ?= "microblaze v11.0 barrel-shift pattern-compare reorder divide-hard multiply-high"

require conf/machine/microblaze-generic.conf
```

## meta-xilinx-bsp/conf/machine/microblazeel-v11.0-bs-cmp-ml-generic.conf
```bitbake
#@TYPE: Machine
#@NAME: microblazeel-v11.0-bs-cmp-ml-generic
#@DESCRIPTION: microblazeel-v11.0-bs-cmp-ml

require conf/machine/include/microblaze-generic.conf

TUNE_FEATURES:tune-microblaze = "microblaze v11.0 barrel-shift reorder pattern-compare multiply-low"
```

## meta-xilinx-bsp/conf/machine/microzed-zynq7.conf
```bitbake
#@TYPE: Machine
#@NAME: microzed-zynq7
#@DESCRIPTION: Machine support for microZed. (http://www.microzed.org/)

require conf/machine/zynq-generic.conf

# u-boot configuration
PREFERRED_PROVIDER_virtual/bootloader = "u-boot"

SPL_BINARY ?= "spl/boot.bin"
UBOOT_ELF = "u-boot"

EXTRA_IMAGEDEPENDS += " \
		u-boot-zynq-uenv \
		virtual/boot-bin \
		virtual/bootloader \
		u-boot-zynq-scr \
		"

KERNEL_DEVICETREE = "zynq-microzed.dtb"

IMAGE_BOOT_FILES += " \
		boot.bin \
		uEnv.txt \
		"
```

## meta-xilinx-bsp/conf/machine/qemu-zynq7.conf
```bitbake
#@TYPE: Machine
#@NAME: qemu-zynq7
#@DESCRIPTION: Zynq QEMU machine support ('xilinx-zynq-a9' model)

require conf/machine/zynq-generic.conf

# Use the networking setup from qemuarm
MACHINEOVERRIDES:prepend:pn-init-ifupdown = "qemuall:"
FILESOVERRIDES:append:pn-init-ifupdown = ":qemuarm"
```

## meta-xilinx-bsp/conf/machine/qemu-zynqmp-cg.conf
```bitbake
#@TYPE: Machine
#@NAME: QEMU ZynqMP CG machine
#@DESCRIPTION: Machine configuration for running a ZynqMP CG system on QEMU w/ testimage

# This machine is NOT designed to be inherited by other machines or used as an
# example of how to create a machine.  It is only useful for running testimage
# with runqemu.

#### Preamble
MACHINEOVERRIDES =. "${@['', 'qemu-zynqmp-cg:']['qemu-zynqmp-cg' !='${MACHINE}']}"
#### Regular settings follow

# The following is from conf/machine/include/qemu.inc, but we can not use it
# as it changes other values that need to come from the distro and the
# AMD machine settings
XSERVER ?= "xserver-xorg \
            ${@bb.utils.contains('DISTRO_FEATURES', 'opengl', 'mesa-driver-swrast xserver-xorg-extension-glx', '', d)} \
            xf86-video-fbdev \
            xf86-video-modesetting \
            "

MACHINE_FEATURES = "alsa bluetooth usbgadget screen vfat"

MACHINEOVERRIDES =. "qemuall:"

IMAGE_FSTYPES += "tar.bz2 ext4"

# Don't include kernels in standard images
RDEPENDS:${KERNEL_PACKAGE_NAME}-base = ""

# Provide the nfs server kernel module for all qemu images
KERNEL_FEATURES:append:pn-linux-yocto = " features/nfsd/nfsd-enable.scc"
KERNEL_FEATURES:append:pn-linux-yocto-rt = " features/nfsd/nfsd-enable.scc"
KERNEL_FEATURES:append:pn-linux-xlnx = " features/nfsd/nfsd-enable.scc"


# Now include the generic machine which already supports QEMU booting
require conf/machine/zynqmp-cg-generic.conf

#### No additional settings should be after the Postamble
#### Postamble
PACKAGE_EXTRA_ARCHS:append = "${@['', ' qemu_zynqmp_cg']['qemu-zynqmp-cg' != '${MACHINE}']}"
```

## meta-xilinx-bsp/conf/machine/qemu-zynqmp-dr.conf
```bitbake
#@TYPE: Machine
#@NAME: QEMU ZynqMP DR machine
#@DESCRIPTION: Machine configuration for running a ZynqMP DR system on QEMU w/ testimage

# This machine is NOT designed to be inherited by other machines or used as an
# example of how to create a machine.  It is only useful for running testimage
# with runqemu.

#### Preamble
MACHINEOVERRIDES =. "${@['', 'qemu-zynqmp-dr:']['qemu-zynqmp-dr' !='${MACHINE}']}"
#### Regular settings follow

# The following is from conf/machine/include/qemu.inc, but we can not use it
# as it changes other values that need to come from the distro and the
# AMD machine settings
XSERVER ?= "xserver-xorg \
            ${@bb.utils.contains('DISTRO_FEATURES', 'opengl', 'mesa-driver-swrast xserver-xorg-extension-glx', '', d)} \
            xf86-video-fbdev \
            xf86-video-modesetting \
            "

MACHINE_FEATURES = "alsa bluetooth usbgadget screen vfat"

MACHINEOVERRIDES =. "qemuall:"

IMAGE_FSTYPES += "tar.bz2 ext4"

# Don't include kernels in standard images
RDEPENDS:${KERNEL_PACKAGE_NAME}-base = ""

# Provide the nfs server kernel module for all qemu images
KERNEL_FEATURES:append:pn-linux-yocto = " features/nfsd/nfsd-enable.scc"
KERNEL_FEATURES:append:pn-linux-yocto-rt = " features/nfsd/nfsd-enable.scc"
KERNEL_FEATURES:append:pn-linux-xlnx = " features/nfsd/nfsd-enable.scc"


# Now include the generic machine which already supports QEMU booting
require conf/machine/zynqmp-dr-generic.conf

#### No additional settings should be after the Postamble
#### Postamble
PACKAGE_EXTRA_ARCHS:append = "${@['', ' qemu_zynqmp_dr']['qemu-zynqmp-dr' != '${MACHINE}']}"
```

## meta-xilinx-bsp/conf/machine/qemu-zynqmp-eg.conf
```bitbake
#@TYPE: Machine
#@NAME: QEMU ZynqMP EG machine
#@DESCRIPTION: Machine configuration for running a ZynqMP EG system on QEMU w/ testimage

# This machine is NOT designed to be inherited by other machines or used as an
# example of how to create a machine.  It is only useful for running testimage
# with runqemu.

#### Preamble
MACHINEOVERRIDES =. "${@['', 'qemu-zynqmp-eg:']['qemu-zynqmp-eg' !='${MACHINE}']}"
#### Regular settings follow

# The following is from conf/machine/include/qemu.inc, but we can not use it
# as it changes other values that need to come from the distro and the
# AMD machine settings
XSERVER ?= "xserver-xorg \
            ${@bb.utils.contains('DISTRO_FEATURES', 'opengl', 'mesa-driver-swrast xserver-xorg-extension-glx', '', d)} \
            xf86-video-fbdev \
            xf86-video-modesetting \
            "

MACHINE_FEATURES = "alsa bluetooth usbgadget screen vfat"

MACHINEOVERRIDES =. "qemuall:"

IMAGE_FSTYPES += "tar.bz2 ext4"

# Don't include kernels in standard images
RDEPENDS:${KERNEL_PACKAGE_NAME}-base = ""

# Provide the nfs server kernel module for all qemu images
KERNEL_FEATURES:append:pn-linux-yocto = " features/nfsd/nfsd-enable.scc"
KERNEL_FEATURES:append:pn-linux-yocto-rt = " features/nfsd/nfsd-enable.scc"
KERNEL_FEATURES:append:pn-linux-xlnx = " features/nfsd/nfsd-enable.scc"


# Now include the generic machine which already supports QEMU booting
require conf/machine/zynqmp-eg-generic.conf

#### No additional settings should be after the Postamble
#### Postamble
PACKAGE_EXTRA_ARCHS:append = "${@['', ' qemu_zynqmp_eg']['qemu-zynqmp-eg' != '${MACHINE}']}"
```

## meta-xilinx-bsp/conf/machine/s3adsp1800-qemu-microblazeeb.conf
```bitbake
#@TYPE: Machine
#@NAME: s3adsp1800-qemu-microblazeeb
#@DESCRIPTION: MicroBlaze QEMU machine support ('petalogix-s3adsp1800' model)

TUNE_FEATURES:tune-microblaze ?= "microblaze v8.00 bigendian barrel-shift pattern-compare multiply-low"

require conf/machine/microblaze-generic.conf

MACHINE_FEATURES = ""

USE_VT = ""
SERIAL_CONSOLES ?= "115200;ttyUL0"

KERNEL_IMAGETYPE ?= "linux.bin.ub"

# This machine is a targeting a QEMU model, runqemu setup:
QB_MEM = "-m 256"
QB_MACHINE = "-machine petalogix-s3adsp1800"
QB_OPT_APPEND = "-nographic -serial mon:stdio"
QB_NETWORK_DEVICE = "-net nic,netdev=net0,macaddr=@MAC@"
```
