## meta-xilinx-bsp/conf/machine/include/soc-versal.inc
```bitbake
DEFAULTTUNE ?= "cortexa72-cortexa53"
SOC_FAMILY ?= "versal"

# Available SOC_VARIANT's for versal:
# "prime"    - Versal deafult Prime Devices
# "ai-core"  - Versal AI-core Devices
# "premium"  - Versal Premium Devices

SOC_VARIANT ?= "prime"

require xilinx-soc-family.inc
require soc-tune-include.inc

# Linux Configuration
KERNEL_IMAGETYPE ?= "Image"

WIC_DEPENDS ?= "virtual/kernel virtual/bootloader virtual/boot-bin virtual/arm-trusted-firmware"

UBOOT_ELF ?= "u-boot.elf"

# Default, if multiconfig is off, call plm/psm-firmware directly, otherwise call the versal-fw multiconfig version
# The Linux compatible plm/psm-firmware though requires meta-xilinx-tools
PLM_DEPENDS ?= "${@bb.utils.contains('BBMULTICONFIG', 'versal-fw', '', 'plm-firmware:do_deploy', d)}"
PLM_MCDEPENDS ?= "${@bb.utils.contains('BBMULTICONFIG', 'versal-fw', 'mc::versal-fw:plm-firmware:do_deploy', '', d)}"
PLM_DEPLOY_DIR ?= "${@bb.utils.contains('BBMULTICONFIG', 'versal-fw', '${TOPDIR}/tmp-microblaze-versal-fw/deploy/images/${MACHINE}', '${DEPLOY_DIR_IMAGE}', d)}"
PLM_DEPLOY_DIR[vardepsexclude] += "TOPDIR"
PLM_IMAGE_NAME ?= "${@bb.utils.contains('BBMULTICONFIG', 'versal-fw', 'plm-versal-mb', 'plm-${MACHINE}', d)}"

PSM_DEPENDS ?= "${@bb.utils.contains('BBMULTICONFIG', 'versal-fw', '', 'psm-firmware:do_deploy', d)}"
PSM_MCDEPENDS ?= "${@bb.utils.contains('BBMULTICONFIG', 'versal-fw', 'mc::versal-fw:psm-firmware:do_deploy', '', d)}"
PSM_FIRMWARE_DEPLOY_DIR ?= "${@bb.utils.contains('BBMULTICONFIG', 'versal-fw', '${TOPDIR}/tmp-microblaze-versal-fw/deploy/images/${MACHINE}', '${DEPLOY_DIR_IMAGE}', d)}"
PSM_DEPLOY_DIR[vardepsexclude] += "TOPDIR"
PSM_FIRMWARE_IMAGE_NAME ?= "${@bb.utils.contains('BBMULTICONFIG', 'versal-fw', 'psm-firmware-versal-mb', 'psm-firmware-${MACHINE}', d)}"
```

## meta-xilinx-bsp/conf/machine/include/soc-zynq.inc
```bitbake
DEFAULTTUNE ?= "cortexa9thf-neon"
SOC_FAMILY ?= "zynq"

# Available SOC_VARIANT's for zynq:
# 7zs - Zynq-7000 Single A9 Core
# 7z  - Zynq-7000 Dual A9 Core

SOC_VARIANT ?= "7z"

require xilinx-soc-family.inc
require soc-tune-include.inc

# Linux Configuration
KERNEL_IMAGETYPE ?= "uImage"
KERNEL_IMAGETYPES += "zImage"

# Set default load address.
# Override with KERNEL_EXTRA_ARGS_<board> += "..." in machine file if required
KERNEL_EXTRA_ARGS_zynq += "UIMAGE_LOADADDR=0x8000"

# WIC Specific dependencies
WIC_DEPENDS ?= "virtual/kernel virtual/bootloader virtual/boot-bin"

UBOOT_ELF ?= "u-boot.elf"

# Default, if multiconfig is off, the fsbl is in the regular deploydir, otherwise
# it is located under a multiconfig specific deploydir
FSBL_DEPENDS ?= "${@bb.utils.contains('BBMULTICONFIG', 'fsbl-fw', '', 'fsbl-firmware:do_deploy', d)}"
FSBL_MCDEPENDS ?= "${@bb.utils.contains('BBMULTICONFIG', 'fsbl-fw', 'mc::fsbl-fw:fsbl-firmware:do_deploy', '', d)}"
FSBL_DEPLOY_DIR ?= "${@bb.utils.contains('BBMULTICONFIG', 'fsbl-fw', '${TOPDIR}/tmp-fsbl-fw/deploy/images/${MACHINE}', '${DEPLOY_DIR_IMAGE}', d)}"
FSBL_DEPLOY_DIR[vardepsexclude] += "TOPDIR"
FSBL_IMAGE_NAME ?= "fsbl-${MACHINE}"
```

## meta-xilinx-bsp/conf/machine/include/soc-zynqmp.inc
```bitbake
DEFAULTTUNE ?= "cortexa72-cortexa53"
SOC_FAMILY ?= "zynqmp"

# Available SOC_VARIANT's for zynqmp:
# "cg" - Zynq UltraScale+  CG Devices
# "eg" - Zynq UltraScale+  EG Devices
# "ev" - Zynq UltraScale+  EV Devices
# "dr" - Zynq UltraScale+  DR Devices

SOC_VARIANT ?= "eg"

require xilinx-soc-family.inc

GRAPHICSOVERRIDES = ""
GRAPHICSOVERRIDES_zynqmp-eg = "mali400:"
GRAPHICSOVERRIDES_zynqmp-ev = "mali400:vcu:"

MACHINEOVERRIDES =. "${GRAPHICSOVERRIDES}"

require soc-tune-include.inc

# Linux Configuration
KERNEL_IMAGETYPE ?= "Image"

# Support multilib on zynqmp
DEFAULTTUNE_virtclass-multilib-lib32 ?= "armv7vethf-neon-vfpv4"

WIC_DEPENDS ?= "virtual/kernel virtual/bootloader virtual/boot-bin virtual/arm-trusted-firmware"

UBOOT_SUFFIX ?= "bin"

XSERVER_EXT_zynqmp ?= "xf86-video-armsoc"

# Default PMU ROM
PMU_ROM ?= "${DEPLOY_DIR_IMAGE}/pmu-rom.elf"

# Default, if multiconfig is off, call pmu-firmware directly, otherwise call the zynqmp-pmufw multiconfig version
# The Linux compatible pmu-firmware though requires meta-xilinx-tools
PMU_DEPENDS ?= "${@bb.utils.contains('BBMULTICONFIG', 'zynqmp-pmufw', '', 'pmu-firmware:do_deploy', d)}"
PMU_MCDEPENDS ?= "${@bb.utils.contains('BBMULTICONFIG', 'zynqmp-pmufw', 'mc::zynqmp-pmufw:pmu-firmware:do_deploy', '', d)}"
PMU_FIRMWARE_DEPLOY_DIR ?= "${@bb.utils.contains('BBMULTICONFIG', 'zynqmp-pmufw', '${TOPDIR}/tmp-microblaze-zynqmp-pmufw/deploy/images/${MACHINE}', '${DEPLOY_DIR_IMAGE}', d)}"
PMU_FIRMWARE_DEPLOY_DIR[vardepsexclude] += "TOPDIR"
PMU_FIRMWARE_IMAGE_NAME ?= "${@bb.utils.contains('BBMULTICONFIG', 'zynqmp-pmufw', 'pmu-firmware-zynqmp-pmu', 'pmu-firmware-${MACHINE}', d)}"

# Default, if multiconfig is off, the fsbl is in the regular deploydir, otherwise
# it is located under a multiconfig specific deploydir
FSBL_DEPENDS ?= "${@bb.utils.contains('BBMULTICONFIG', 'fsbl-fw', '', 'fsbl-firmware:do_deploy', d)}"
FSBL_MCDEPENDS ?= "${@bb.utils.contains('BBMULTICONFIG', 'fsbl-fw', 'mc::fsbl-fw:fsbl-firmware:do_deploy', '', d)}"
FSBL_DEPLOY_DIR ?= "${@bb.utils.contains('BBMULTICONFIG', 'fsbl-fw', '${TOPDIR}/tmp-fsbl-fw/deploy/images/${MACHINE}', '${DEPLOY_DIR_IMAGE}', d)}"
FSBL_DEPLOY_DIR[vardepsexclude] += "TOPDIR"
FSBL_IMAGE_NAME ?= "fsbl-${MACHINE}"
```

## meta-xilinx-bsp/conf/machine/include/tune-cortexrm.inc
```bitbake
DEFAULTTUNE ?= "cortexr5"

require conf/machine/include/arm/arch-armv8a.inc

TUNEVALID[armrm] = "Enable ARM Cortex-R/M Family"
MACHINEOVERRIDES =. "${@bb.utils.contains('TUNE_FEATURES', 'armrm', 'armrm:', '' ,d)}"

TUNEVALID[cortexr5] = "Enable Cortex-r5 specific processor optimizations"
TUNE_CCARGS .= "${@bb.utils.contains('TUNE_FEATURES', 'cortexr5', ' -mcpu=cortex-r5', '', d)}"

AVAILTUNES += "cortexr5"
ARMPKGARCH:tune-cortexr5 = "cortexr5"

TUNE_FEATURES:tune-cortexr5 = "armrm cortexr5"
PACKAGE_EXTRA_ARCHS:tune-cortexr5 = "${TUNE_PKGARCH}"

AVAILTUNES += "cortexr5f"
ARMPKGARCH:tune-cortexr5f = "cortexr5f"

TUNE_FEATURES:tune-cortexr5f = "armrm cortexr5 vfpv3d16 callconvention-hard"
PACKAGE_EXTRA_ARCHS:tune-cortexr5f = "${TUNE_PKGARCH}"
```

## meta-xilinx-bsp/conf/machine/include/tune-microblaze.inc
```bitbake
DEFAULTTUNE ?= "microblaze"

require conf/machine/include/microblaze/arch-microblaze.inc

AVAILTUNES += "microblaze"
TUNE_FEATURES_tune-microblaze = "microblaze"
PACKAGE_EXTRA_ARCHS_tune-microblaze = "${TUNE_PKGARCH}"

# Linux Configuration
KERNEL_IMAGETYPE ?= "linux.bin.ub"
KERNEL_IMAGETYPES += "simpleImage.mb"

# U-Boot Configuration
UBOOT_MACHINE ?= "microblaze-generic_config"

# default to use the gdb 7.7.1
PREFERRED_VERSION_gdb ?= "7.7.1"
PREFERRED_VERSION_gdb-cross ?= "7.7.1"
PREFERRED_VERSION_gdb-cross-canadian ?= "7.7.1"
```

## meta-xilinx-bsp/conf/machine/include/tune-versal.inc
```bitbake
DEFAULTTUNE ?= "cortexa72-cortexa53"
SOC_FAMILY ?= "versal"

# Available SOC_VARIANT's for versal:
# virt

SOC_VARIANT ?= "s80"

require conf/machine/include/tune-cortexa72-cortexa53.inc
require conf/machine/include/soc-family.inc

# Linux Configuration
KERNEL_IMAGETYPE ?= "Image"
```

## meta-xilinx-bsp/conf/machine/include/tune-zynqmp.inc
```bitbake
DEFAULTTUNE ?= "cortexa72-cortexa53"
SOC_FAMILY ?= "zynqmp"

# Available SOC_VARIANT's for zynqmp:
# "cg" - Zynq UltraScale+  CG Devices
# "eg" - Zynq UltraScale+  EG Devices
# "ev" - Zynq UltraScale+  EV Devices

SOC_VARIANT ?= "eg"

require conf/machine/include/tune-cortexa72-cortexa53.inc
require conf/machine/include/soc-family.inc

# Linux Configuration
KERNEL_IMAGETYPE ?= "Image"

# Support multilib on zynqmp
DEFAULTTUNE_virtclass-multilib-lib32 ?= "armv7vethf-neon-vfpv4"
```

## meta-xilinx-bsp/conf/machine/include/xilinx-board.inc
```bitbake
BOARD ??= ""
BOARD_VARIANT ??= ""

MACHINEOVERRIDES .= "${@['', ':${BOARD}']['${BOARD}' != '']}"
MACHINEOVERRIDES .= "${@['', ':${BOARD}-${BOARD_VARIANT}']['${BOARD_VARIANT}' != '']}"


BOARD_ARCH ?= "${@['${BOARD}', '${MACHINE_ARCH}'][d.getVar('BOARD')=='']}"
BOARDVARIANT_ARCH ?= "${@['${BOARD}-${BOARD_VARIANT}','${BOARD_ARCH}'][d.getVar('BOARD_VARIANT')=='']}"

PACKAGE_EXTRA_ARCHS_append = "${@['', ' ${BOARD_ARCH}'][d.getVar('BOARDVARIANT_ARCH') != d.getVar('MACHINE_ARCH')]}"
PACKAGE_EXTRA_ARCHS_append = "${@['', ' ${BOARDVARIANT_ARCH}'][d.getVar('BOARDVARIANT_ARCH') != d.getVar('BOARD_ARCH')]}"
```

## meta-xilinx-bsp/conf/machine/include/xilinx-microblaze.inc
```bitbake
# To avoid the require overriding previous defaults we use the override to make this the default
TUNE_FEATURES_save := "${TUNE_FEATURES:tune-microblaze}"

require conf/machine/include/microblaze/tune-microblaze.inc

# Reset the default value back to what it was previously set to...
TUNE_FEATURES:tune-microblaze := "${TUNE_FEATURES_save}"
```

## meta-xilinx-bsp/conf/machine/include/xilinx-soc-family.inc
```bitbake
SOC_VARIANT ??= ""
MACHINEOVERRIDES =. "${@['', '${SOC_FAMILY}-${SOC_VARIANT}:']['${SOC_VARIANT}' != '']}"

require conf/machine/include/soc-family.inc

SOC_FAMILY_ARCH ?= "${SOC_FAMILY}"
SOC_VARIANT_ARCH ?= "${@['${SOC_FAMILY}-${SOC_VARIANT}','${SOC_FAMILY}'][d.getVar('SOC_VARIANT')=='']}"

PACKAGE_EXTRA_ARCHS_append = " ${SOC_FAMILY_ARCH}"
PACKAGE_EXTRA_ARCHS_append = "${@['', ' ${SOC_VARIANT_ARCH}'][d.getVar('SOC_VARIANT_ARCH') != d.getVar('SOC_FAMILY_ARCH')]}"
```

## meta-xilinx-bsp/conf/machine/kc705-microblazeel.conf
```bitbake
#@TYPE: Machine
#@NAME: kc705-microblazeel
#@DESCRIPTION: Machine configuration for the KC705 evaluation board.

#### Preamble
MACHINEOVERRIDES =. "${@['', 'kc705-microblazeel:']['kc705-microblazeel' !='${MACHINE}']}"
#### Regular settings follow

# Variables that changes based on hw design or board specific requirement must be
# defined before calling the required inclusion file else pre-expansion value
# defined in microblazeel-generic.conf will be set.

# Yocto device-tree variables
YAML_CONSOLE_DEVICE_CONFIG:pn-device-tree ?= "axi_uartlite_0"
YAML_MAIN_MEMORY_CONFIG:pn-device-tree ?= "MIG_7SERIES_0"
DT_PADDING_SIZE:pn-device-tree ?= "0x1000"
DTC_FLAGS:pn-device-tree ?= ""
XSCTH_PROC:microblaze:pn-device-tree ?= "microblaze_0"
YAML_DT_BOARD_FLAGS ?= "{BOARD kc705-full}"

# Yocto FS-Boot variables
YAML_SERIAL_CONSOLE_STDIN:pn-fs-boot ?= "axi_uartlite_0"
YAML_SERIAL_CONSOLE_STDOUT:pn-fs-boot ?= "axi_uartlite_0"
YAML_MAIN_MEMORY_CONFIG:pn-fs-boot ?= "MIG_7SERIES_0"
YAML_FLASH_MEMORY_CONFIG:pn-fs-boot ?= "axi_emc_0"
XSCTH_PROC:pn-fs-boot ?= "microblaze_0"

# Yocto KERNEL Variables
UBOOT_ENTRYPOINT  ?= "0x80000000"
UBOOT_LOADADDRESS ?= "0x80000000"

# Set DDR Base address for u-boot-xlnx-scr variables
DDR_BASEADDR ?= "0x80000000"
SKIP_APPEND_BASEADDR ?= "0"

# kc705-microblazeel Serial Console
SERIAL_CONSOLES ?= "115200;ttyUL0"
YAML_SERIAL_CONSOLE_BAUDRATE ?= "115200"

# Required generic machine inclusion
require conf/machine/microblaze-generic.conf

# This machine conf file uses kc705-microblazeel xsa as reference input.
# User can override with kc705 custom xsa using HDF_BASE and HDF_PATH variables
# from local.conf.
HDF_MACHINE = "kc705-microblazeel"

#### No additional settings should be after the Postamble
#### Postamble
PACKAGE_EXTRA_ARCHS:append = "${@['', 'kc705_microblazeel']['kc705-microblazeel' != '${MACHINE}']}"
```

## meta-xilinx-bsp/conf/machine/kcu105-microblazeel.conf
```bitbake
#@TYPE: Machine
#@NAME: kcu105-microblazeel
#@DESCRIPTION: Machine configuration for the KCU105 evaluation board.

#### Preamble
MACHINEOVERRIDES =. "${@['', 'kcu105-microblazeel:']['kcu105-microblazeel' !='${MACHINE}']}"
#### Regular settings follow

# Variables that changes based on hw design or board specific requirement must be
# defined before calling the required inclusion file else pre-expansion value
# defined in microblazeel-generic.conf will be set.

# Yocto KCU105 device-tree variables
YAML_CONSOLE_DEVICE_CONFIG:pn-device-tree ?= "axi_uartlite_0"
YAML_MAIN_MEMORY_CONFIG:pn-device-tree ?= "DDR4_0"
DT_PADDING_SIZE:pn-device-tree ?= "0x1000"
DTC_FLAGS:pn-device-tree ?= ""
XSCTH_PROC:pn-device-tree ?= "microblaze_0"
YAML_DT_BOARD_FLAGS ?= "{BOARD kcu105}"

# Yocto FS-Boot variables
YAML_SERIAL_CONSOLE_STDIN:pn-fs-boot ?= "axi_uartlite_0"
YAML_SERIAL_CONSOLE_STDOUT:pn-fs-boot ?= "axi_uartlite_0"
YAML_MAIN_MEMORY_CONFIG:pn-fs-boot ?= "DDR4_0"
YAML_FLASH_MEMORY_CONFIG:pn-fs-boot ?= "axi_quad_spi_0"
XSCTH_PROC:pn-fs-boot ?= "microblaze_0"

# Yocto KERNEL Variables
UBOOT_ENTRYPOINT  ?= "0x80000000"
UBOOT_LOADADDRESS ?= "0x80000000"

# kcu105-microblazeel Serial Console
SERIAL_CONSOLES ?= "115200;ttyUL0"
YAML_SERIAL_CONSOLE_BAUDRATE ?= "115200"

# Set DDR Base address for u-boot-xlnx-scr variables
DDR_BASEADDR ?= "0x80000000"
SKIP_APPEND_BASEADDR ?= "0"

# Required generic machine inclusion
require conf/machine/microblaze-generic.conf

# This machine conf file uses kcu105-microblazeel xsa as reference input.
# User can override with kcu105 custom xsa using HDF_BASE and HDF_PATH variables
# from local.conf.
HDF_MACHINE = "kcu105-microblazeel"

#### No additional settings should be after the Postamble
#### Postamble
PACKAGE_EXTRA_ARCHS:append = "${@['', ' kcu105_microblazeel']['kcu105-microblazeel' != '${MACHINE}']}"
```

## meta-xilinx-bsp/conf/machine/microblaze-generic.conf
```bitbake
#@TYPE: Machine
#@NAME: microblaze-generic
#@DESCRIPTION: Generic microblaze defaults to little-endian v11.0 barrel-shift pattern-compare reorder divide-hard multiple-high support

require conf/machine/include/microblaze/tune-microblaze.inc
require conf/machine/include/machine-xilinx-default.inc
require conf/machine/include/xilinx-board.inc

TUNE_FEATURES:tune-microblaze = "microblaze v11.0 barrel-shift pattern-compare reorder divide-hard multiply-high"

MACHINE_FEATURES = ""

KERNEL_IMAGETYPE = "linux.bin.ub"
KERNEL_IMAGETYPES = ""

SERIAL_CONSOLES ?= "115200;ttyS0"

EXTRA_IMAGEDEPENDS += "libyaml-native python3-cython-native python3-pyyaml-native"

UBOOT_MACHINE ?= "microblaze-generic_defconfig"
UBOOT_INITIAL_ENV = ""
```
