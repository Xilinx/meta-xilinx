## meta-xilinx-bsp/conf/machine/sp701-microblazeel.conf
```bitbake
#@TYPE: Machine
#@NAME: sp701-microblazeel
#@DESCRIPTION: Machine configuration for the SP701 boards.

#### Preamble
MACHINEOVERRIDES =. "${@['', 'sp701-microblazeel:']['sp701-microblazeel' !='${MACHINE}']}"
#### Regular settings follow

# Variables that changes based on hw design or board specific requirement must be
# defined before calling the required inclusion file else pre-expansion value
# defined in microblazeel-generic.conf will be set.

# Yocto device-tree variables
YAML_CONSOLE_DEVICE_CONFIG:pn-device-tree ?= "axi_uartlite_0"
YAML_MAIN_MEMORY_CONFIG:pn-device-tree ?= "MIG_7SERIES_0"
DT_PADDING_SIZE:pn-device-tree ?= "0x1000"
DTC_FLAGS:pn-device-tree ?= ""
XSCTH_PROC:pn-device-tree ?= "microblaze_0"
YAML_DT_BOARD_FLAGS ?= "{BOARD sp701-rev1.0}"

# Yocto u-boot-xlnx variables

# Yocto FS-Boot variables
YAML_SERIAL_CONSOLE_STDIN:pn-fs-boot ?= "axi_uartlite_0"
YAML_SERIAL_CONSOLE_STDOUT:pn-fs-boot ?= "axi_uartlite_0"
YAML_MAIN_MEMORY_CONFIG:pn-fs-boot ?= "MIG_7SERIES_0"
YAML_FLASH_MEMORY_CONFIG:pn-fs-boot ?= "axi_quad_spi_0"
XSCTH_PROC:pn-fs-boot ?= "microblaze_0"

# Yocto KERNEL Variables
UBOOT_ENTRYPOINT  ?= "0x80000000"
UBOOT_LOADADDRESS ?= "0x80000000"

# xilinx-sp701 Serial Console
SERIAL_CONSOLES ?= "115200;ttyUL0"
YAML_SERIAL_CONSOLE_BAUDRATE ?= "115200"

# Set DDR Base address for u-boot-xlnx-scr variables
DDR_BASEADDR ?= "0x80000000"
SKIP_APPEND_BASEADDR ?= "0"

# Required generic machine inclusion
require conf/machine/microblaze-generic.conf

# This machine conf file uses sp701-microblazeel xsa as reference input.
# User can override with kc705 custom xsa using HDF_BASE and HDF_PATH variables
# from local.conf.
HDF_MACHINE = "sp701-microblazeel"

#### No additional settings should be after the Postamble
#### Postamble
PACKAGE_EXTRA_ARCHS:append = "${@['', ' sp701_microblazeel']['sp701-microblazeel' != '${MACHINE}']}"
```

## meta-xilinx-bsp/conf/machine/ultra96-zynqmp.conf
```bitbake
#@TYPE: Machine
#@NAME: ultra96-zynqmp
#@DESCRIPTION: Machine support for Ultra96 Evaluation Board.
#

MACHINE = "zynqmp-generic"
BOARD = "ultra96"
SOC_VARIANT = 'eg'

require conf/machine/zynqmp-generic.conf
```

## meta-xilinx-bsp/conf/machine/v350-versal.conf
```bitbake
#@TYPE: Machine
#@NAME: v350-versal
##@DESCRIPTION: Machine support for v350 versal.

require conf/machine/versal-generic.conf

EXTRA_IMAGEDEPENDS += " \
   arm-trusted-firmware \
   virtual/boot-bin \
   virtual/bootloader \
   virtual/psm-firmware \
   virtual/plm \
   u-boot-zynq-scr \
"
```
