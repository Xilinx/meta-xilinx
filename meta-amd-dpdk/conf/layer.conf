## meta-amd-dpdk/conf/layer.conf
```bitbake
# We have a conf directory, add to BBPATH
BBPATH .= ":${LAYERDIR}"

# We have recipes-* directories, add to BBFILES
BBFILES += "${LAYERDIR}/recipes-*/*/*.bb \
            ${LAYERDIR}/recipes-*/*/*.bbappend"

BBFILE_COLLECTIONS += "amd-dpdk"
BBFILE_PATTERN_amd-dpdk = "^${LAYERDIR}/"
BBFILE_PRIORITY_amd-dpdk = "6"

LAYERSUMMARY_amd-dpdk = "AMD DPDK enablement"
LAYERDESCRIPTION_amd-dpdk = "AMD additions to the upstream DPDK layer, \
carrying the core patches and build options required by the AMD poll \
mode drivers so that meta-dpdk remains a pristine upstream fork."

LAYERDEPENDS_amd-dpdk = "\
    core \
    dpdk \
    "

LAYERSERIES_COMPAT_amd-dpdk = "wrynose"
```

## meta-xilinx-multimedia/conf/layer.conf
```bitbake
# We have a conf and classes directory, add to BBPATH
BBPATH .= ":${LAYERDIR}"

# We have a packages directory, add to BBFILES
BBFILES += "${LAYERDIR}/recipes-*/*/*.bb"
BBFILES += "${LAYERDIR}/recipes-*/*/*.bbappend"

BBFILE_COLLECTIONS += "xilinx-multimedia"
BBFILE_PATTERN_xilinx-multimedia = "^${LAYERDIR}/"
BBFILE_PRIORITY_xilinx-multimedia = "5"

LAYERSUMMARY_xilinx-multimedia = "AMD Xilinx multimedia recipes (VCU, \
OMX, GStreamer)"
LAYERDESCRIPTION_xilinx-multimedia = "Multimedia recipe layer \
providing video codec unit (VCU) drivers, OpenMAX IL components, \
GStreamer plug-ins, and related libraries for AMD Xilinx multimedia \
hardware."

# set layer path for this layer only
LAYER_PATH_xilinx-multimedia = "${LAYERDIR}"

LAYERDEPENDS_xilinx-multimedia = "core xilinx openembedded-layer"

LAYERSERIES_COMPAT_xilinx-multimedia = "wrynose"

# Define dynamic layers
BBFILES_DYNAMIC += " \
jupyter-layer:${LAYERDIR}/dynamic-layers/meta-jupyter/recipes-*/*/*.bb \
jupyter-layer:${LAYERDIR}/dynamic-layers/meta-jupyter/recipes-*/*/*.bbappend \
"

# Prefer the AMD/Xilinx-local +amd gstreamer 1.28.2 recipes over any
# other versions provided by other layers (e.g. openembedded-core)
PREFERRED_VERSION_gst-devtools = "1.28.2+amd+git"
PREFERRED_VERSION_gst-examples = "1.28.2+amd+git"
PREFERRED_VERSION_gstreamer1.0 = "1.28.2+amd+git"
PREFERRED_VERSION_gstreamer1.0-libav = "1.28.2+amd+git"
PREFERRED_VERSION_gstreamer1.0-omx = "1.28.2+amd+git"
PREFERRED_VERSION_gstreamer1.0-plugins-bad = "1.28.2+amd+git"
PREFERRED_VERSION_gstreamer1.0-plugins-base = "1.28.2+amd+git"
PREFERRED_VERSION_gstreamer1.0-plugins-good = "1.28.2+amd+git"
PREFERRED_VERSION_gstreamer1.0-plugins-ugly = "1.28.2+amd+git"
PREFERRED_VERSION_gstreamer1.0-python = "1.28.2+amd+git"
PREFERRED_VERSION_gstreamer1.0-rtsp-server = "1.28.2+amd+git"
```
