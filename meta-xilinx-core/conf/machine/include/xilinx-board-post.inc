## meta-xilinx-core/conf/machine/include/xilinx-board-post.inc
```bitbake
BOARD_ARCH ?= "${@['${BOARD}', '${MACHINE_ARCH}'][d.getVar('BOARD')=='']}"
BOARDVARIANT_ARCH ?= "${@['${BOARD}_${BOARD_VARIANT}','${BOARD_ARCH}'][d.getVar('BOARD_VARIANT')=='']}"

PACKAGE_EXTRA_ARCHS:append = "${@['', ' ${BOARD_ARCH}']['${BOARD}' != '' and '${BOARD_ARCH}' != '${MACHINE_ARCH}']}"
# We don't add BOARDVARIANT_ARCH as that will be automatic via MACHINE
#PACKAGE_EXTRA_ARCHS:append = "${@['', ' ${BOARDVARIANT_ARCH}']['${BOARD_VARIANT}' != '' and '${BOARDVARIANT_ARCH}' != '${MACHINE_ARCH}']}"
```

## meta-xilinx-core/conf/machine/include/xilinx-board-pre.inc
```bitbake
BOARD ??= ""
BOARD_VARIANT ??= ""

# Change the MACHINE to the BOARD-VARIANT (or BOARD)
ORIG_MACHINE := "${MACHINE}"
MACHINE := "${@['${BOARD}-${BOARD_VARIANT}', '${BOARD}' or '${ORIG_MACHINE}']['${BOARD_VARIANT}' == '']}"

# Add the BOARD and BOARD_VARIANT to the overrides
MACHINEOVERRIDES =. "${@['', '${BOARD}:']['${BOARD}' != '' and '${MACHINE}' != '${BOARD}']}"
# We don't add BOARD-BOARD_VARIANT as that will be automatic via MACHINE
#MACHINEOVERRIDES =. "${@['', '${BOARD}-${BOARD_VARIANT}:']['${BOARD_VARIANT}' != '' and '${MACHINE}' != '${BOARD_VARIANT}']}"

include conf/machine/include/${BOARD}.inc
include conf/machine/include/${BOARD}-${BOARD_VARIANT}.inc
```

## meta-xilinx-core/conf/machine/include/xilinx-microblaze-v.inc
```bitbake
# Verify meta-microblaze is part of the config!
INHERIT += "xilinx-microblaze"

# It is expected that the machine will define
# DEFAULTTUNE = "microblaze-v"
# TUNE_FEATURES:tune-microblaze-v = "${@bv.tune.riscv_isa_to_tune("<ISA>")}"

require conf/machine/include/mbv/arch-riscv.inc

AVAILTUNES += "microblaze-v"
PACKAGE_EXTRA_ARCHS:tune-microblaze-v = "${TUNE_RISCV_PKGARCH}"
```

## meta-xilinx-core/conf/machine/include/xilinx-microblaze.inc
```bitbake
# Verify meta-microblaze is part of the config!
INHERIT += "xilinx-microblaze"

# To avoid the require overriding previous defaults we use the override to make this the default
TUNE_FEATURES_save := "${TUNE_FEATURES:tune-microblaze}"

require conf/machine/include/microblaze/tune-microblaze.inc

# Reset the default value back to what it was previously set to...
TUNE_FEATURES:tune-microblaze := "${TUNE_FEATURES_save}"

# Various microblaze architecture defaults

# microblaze does not get on with pie for reasons not looked into as yet
GCCPIE:microblaze = ""
GLIBCPIE:microblaze = ""
SECURITY_CFLAGS:microblaze = ""
SECURITY_LDFLAGS:microblaze = ""
# Microblaze does not support gnu hash style
LINKER_HASH_STYLE:microblaze = "sysv"
```

## meta-xilinx-core/conf/machine/microblaze-generic.conf
```bitbake
#@TYPE: Machine
#@NAME: microblaze-generic
#@DESCRIPTION: Machine configuration for the microblaze-generic devices

#### Preamble
MACHINEOVERRIDES =. "${@['', 'microblaze-generic:']['microblaze-generic' != '${MACHINE}']}"
#### Regular settings follow

# Set the default for a modern full feature microblaze...
TUNE_FEATURES:tune-microblaze ?= "microblaze v11.0 pattern-compare barrel-shift divide-hard multiply-high fpu-hard reorder"
DEFAULTTUNE ?= "microblaze"

# Variables that changes based on hw design or board specific requirement must be
# defined before calling the required inclusion file else pre-expansion value
# defined in local.conf without machine override will not be reflected.

# Yocto Microblaze u-boot-xlnx variables
UBOOT_MACHINE ?= "microblaze-generic_defconfig"
UBOOT_INITIAL_ENV = ""
BOOTMODE ?= "generic.root"

# Yocto Microblaze KERNEL Variables
UBOOT_ENTRYPOINT  ?= "0x80000000"
UBOOT_LOADADDRESS ?= "0x80000000"
KERNEL_EXTRA_ARGS += "UIMAGE_LOADADDR=${UBOOT_ENTRYPOINT}"

# Microblaze Serial Console settings
SERIAL_CONSOLES ?= "115200;ttyUL0"

require conf/machine/include/soc-tune-include.inc
require conf/machine/include/machine-xilinx-default.inc
require conf/machine/include/machine-xilinx-qemu.inc

# The default MACHINE_ARCH is dynmic for microblaze, since the architecture is not fixed
# Based on core bitbake.conf
DEF_MACHINE_ARCH = "${@[d.getVar('TUNE_PKGARCH'), d.getVar('MACHINE')][bool(d.getVar('MACHINE'))].replace('-', '_')}"
# Enable a dynamic machine_arch
MB_MACHINE_ARCH = "${@[d.getVar('TUNE_PKGARCH'), d.getVar('TUNE_PKGARCH') + '-generic'][bool(d.getVar('MACHINE'))].replace('-', '_')}"

MACHINE_ARCH = "${@['${MB_MACHINE_ARCH}', '${DEF_MACHINE_ARCH}']['microblaze-generic' != "${MACHINE}"]}"

MACHINE_FEATURES = ""

KERNEL_IMAGETYPE ?= "linux.bin.ub"
KERNEL_IMAGETYPES = ""

EXTRA_IMAGEDEPENDS += " \
    virtual/bootloader \
    virtual/elfrealloc \
    u-boot-xlnx-scr \
    "

IMAGE_FSTYPES += "cpio.gz"

# Microblaze QEMU Configurations
QB_MEM ?= "-m 2G"
QB_KERNEL_CMDLINE_APPEND ?= "console=ttyUL0,115200 root=/dev/ram0 rw"
QB_NETWORK_DEVICE ?= "-net nic,netdev=net0,macaddr=@MAC@"

# This will work with the default runqemu, as the first serial port is the
# correct console
#
# One total serial port defined in this model (according to the generated dts)
#
# hw serial0 axi_uartlite_0 (40600000) - linux serial0 (ttyUL0)
QB_XILINX_SERIAL ?= ""

#### No additional settings should be after the Postamble
#### Postamble
PACKAGE_EXTRA_ARCHS:append = "${@['', ' ${MB_MACHINE_ARCH}']['microblaze-generic' != "${MACHINE}"]}"
```

## meta-xilinx-core/conf/machine/microblaze-v-generic.conf
```bitbake
#@TYPE: Machine
#@NAME: microblaze-v-generic
#@DESCRIPTION: Generic machine configuration for the AMD MicroBlaze-V (RISC-V) soft processor. Required by board-specific MicroBlaze-V machines; not intended to be built standalone.

#### Preamble
MACHINEOVERRIDES =. "${@['', 'microblaze-v-generic:']['microblaze-v-generic' != '${MACHINE}']}"
#### Regular settings follow

# Set the default for a modern full feature (32-bit) microblaze-v...
# Note, glibc does not support 'f' without 'd'
TUNE_FEATURES:tune-microblaze-v ?= "${@mbv.tune.riscv_isa_to_tune("rv32imac_zicbom_zicsr_zifencei_zba_zbb_zbs")}"

# Variables that changes based on hw design or board specific requirement must be
# defined before calling the required inclusion file else pre-expansion value
# defined in local.conf without machine override will not be reflected.

PREFERRED_VERSION_openocd-native = "riscv"
PREFERRED_VERSION_openocd = "riscv"

XVISOR_PLAT:riscv32 = "riscv/virt32"
XVISOR_PLAT:riscv64 = "riscv/virt64"

UBOOT_BOOT_SCRIPT ??= ""

require conf/machine/include/soc-microblaze-v.inc
require conf/machine/include/machine-xilinx-default.inc
require conf/machine/include/machine-xilinx-qemu.inc

DEFAULT_UBOOT_MACHINE:riscv32 ?= "xilinx_mbv32_smode_defconfig xilinx_mbv_spi.config"
DEFAULT_UBOOT_MACHINE:riscv64 ?= "xilinx_mbv64_smode_defconfig xilinx_mbv_spi.config"
UBOOT_MACHINE ?= "${DEFAULT_UBOOT_MACHINE}"

MACHINE_FEATURES += "keyboard ext2 ext3 serial"

SERIAL_CONSOLES ?= "115200;ttyS0 115200;hvc0"

IMAGE_CLASSES += "image-types-xilinx-qemu"
# Add wic.qemu-sd only if initramfs_image not set due to circular dependecies
IMAGE_FSTYPES += "${@'wic.qemu-sd' if (d.getVar('INITRAMFS_IMAGE') or '') == '' else 'cpio.gz'}"

MACHINE_EXTRA_RRECOMMENDS += " kernel-modules"

# Define UBOOT_BOOT_SCRIPT in distro layer or local.conf since it requires files
# that are not in the core layer.
UBOOT_BOOT_SCRIPT ?= ""
EXTRA_IMAGEDEPENDS += " \
    opensbi \
    virtual/bootloader \
    ${UBOOT_BOOT_SCRIPT} \
    "

RISCV_SBI_PLAT ?= "generic"
RISCV_SBI_PAYLOAD ?= "${KERNEL_IMAGETYPE}-${MACHINE}.bin"

UBOOT_ENTRYPOINT:riscv32 = "0x80400000"
UBOOT_ENTRYPOINT:riscv64 = "0x80200000"

# The default MACHINE_ARCH is dynamic for microblaze-v, since the architecture is not fixed
MACHINE_ARCH_ORIG := "${MACHINE_ARCH}"
MACHINE_ARCH_DYN := "microblaze_${TUNE_RISCV_PKGARCH}_generic"

MACHINE_ARCH = "${@['${MACHINE_ARCH_DYN}', '${MACHINE_ARCH_ORIG}']['microblaze-v-generic' != "${MACHINE}"]}"

QB_OPT_APPEND = "${RV_QEMU_ISA} -device qemu-xhci -device usb-tablet -device usb-kbd"
QB_OPT_APPEND:riscv32 = "${RV_QEMU_ISA} -device virtio-tablet-pci -device virtio-keyboard-pci"

RV_QEMU_ISA = "-cpu "
# Choose rv32 or rv64
RV_QEMU_ISA .= "${@bb.utils.contains("TUNE_FEATURES", "rv 32", "rv32", "", d)}"
RV_QEMU_ISA .= "${@bb.utils.contains("TUNE_FEATURES", "rv 64", "rv64", "", d)}"
# Disable all of the default extensions we don't want
RV_QEMU_ISA .= ",zihintntl=false,zihintpause=false,zawrs=false,zfa=false,svadu=false,zicntr=false,zihpm=false,zicboz=false,sstc=false,h=false"
# Dynamically enable the extensions based on TUNE_FEATURES
RV_QEMU_ISA .= "${@bb.utils.contains    ("TUNE_FEATURES", "m",         ",m=true",        ",m=false",        d)}"
RV_QEMU_ISA .= "${@bb.utils.contains    ("TUNE_FEATURES", "a",         ",a=true",        ",a=false",        d)}"
RV_QEMU_ISA .= "${@bb.utils.contains_any("TUNE_FEATURES", "f d",       ",f=true",        ",f=false",        d)}"
RV_QEMU_ISA .= "${@bb.utils.contains    ("TUNE_FEATURES", "d",         ",d=true",        ",d=false",        d)}"
RV_QEMU_ISA .= "${@bb.utils.contains    ("TUNE_FEATURES", "c",         ",c=true",        ",c=false",        d)}"
RV_QEMU_ISA .= "${@bb.utils.contains    ("TUNE_FEATURES", "v",         ",v=true",        ",v=false",        d)}"
RV_QEMU_ISA .= "${@bb.utils.contains    ("TUNE_FEATURES", "zicbom",    ",zicbom=true",   ",zicbom=false",   d)}"
RV_QEMU_ISA .= "${@bb.utils.contains_any("TUNE_FEATURES", "zicsr f d", ",zicsr=true",    ",zicsr=false",    d)}"
RV_QEMU_ISA .= "${@bb.utils.contains    ("TUNE_FEATURES", "zifencei",  ",zifencei=true", ",zifencei=false", d)}"
RV_QEMU_ISA .= "${@bb.utils.contains_any("TUNE_FEATURES", "b zba",     ",zba=true",      ",zba=false",      d)}"
RV_QEMU_ISA .= "${@bb.utils.contains_any("TUNE_FEATURES", "b zbb",     ",zbb=true",      ",zbb=false",      d)}"
RV_QEMU_ISA .= "${@bb.utils.contains    ("TUNE_FEATURES", "zbc",       ",zbc=true",      ",zbc=false",      d)}"
RV_QEMU_ISA .= "${@bb.utils.contains_any("TUNE_FEATURES", "b zbs",     ",zbs=true",      ",zbs=false",      d)}"

#### No additional settings should be after the Postamble
#### Postamble
PACKAGE_EXTRA_ARCHS:append = "${@['', ' microblaze_v_generic']['microblaze-v-generic' != "${MACHINE}"]}"
```

## meta-xilinx-core/conf/machine/versal-2ve-2vm-generic.conf
```bitbake
#@TYPE: Machine
#@NAME: versal-2ve-2vm-generic
#@DESCRIPTION: Machine configuration for the versal-2ve-2vm-generic boards.

#### Preamble
MACHINEOVERRIDES =. "${@['', 'versal-2ve-2vm-generic:']['versal-2ve-2vm-generic' !='${MACHINE}']}"
#### Regular settings follow

# Variables that changes based on hw design or board specific requirement must be
# defined before calling the required inclusion file else pre-expansion value
# defined in local.conf without machine override will not be reflected.

# Yocto Versal_2ve_2vm u-boot-xlnx variables
DEFAULT_UBOOT_MACHINE ?= "amd_versal2_virt_defconfig"
UBOOT_MACHINE ?= "${DEFAULT_UBOOT_MACHINE}"
BOOTMODE ?= "generic.root"

# Enable SCMI server support for this platform
TFA_SCMI_SERVER = "1"

# Yocto Versal_2ve_2vm arm-trusted-firmware(TF-A) variables
TFA_BL33_LOAD ?= "0x8000000"

# Yocto Versal_2ve_2vm KERNEL Variables
UBOOT_ENTRYPOINT  ?= "0x200000"
UBOOT_LOADADDRESS ?= "0x200000"

# Versal_2ve_2vm Serial Console Settings
SERIAL_CONSOLES ?= "115200;ttyAMA0"

require conf/machine/include/soc-versal-2ve-2vm.inc
require conf/machine/include/machine-xilinx-default.inc
require conf/machine/include/machine-xilinx-qemu.inc

MACHINE_FEATURES += "rtc ext2 ext3 vfat usbhost"

# Default SD image build onfiguration, use qemu-sd to pad
IMAGE_CLASSES += "image-types-xilinx-qemu"
# Add wic.qemu-sd only if initramfs_image not set due to circular dependencies
IMAGE_FSTYPES += "${@'wic.qemu-sd' if (d.getVar('INITRAMFS_IMAGE') or '') == '' else 'cpio.gz.u-boot.qemu-sd-fatimg'}"

# Enable custom wic UFS (4k) image
IMAGE_CLASSES += "image_types_ufs"
IMAGE_FSTYPES += "wic.ufs wic.ufs.xz wic.ufs.bmap"

UBOOT_BOOT_SCRIPT ?= "u-boot-xlnx-scr"

IMAGE_BOOT_FILES += " \
    ${KERNEL_IMAGETYPE} \
    boot.scr \
    "

# Versal_2ve_2vm QEMU Configuration
# This machine has a QEMU model, runqemu setup:
QB_MACHINE ?= "-machine arm-generic-fdt"

QB_MEM ?= "-m 8G"

QEMU_HW_SD_DRIVE_INDEX ?= "0"

# Iteration appears to be eth0 then eth1
QB_NETWORK_DEVICE ?= "-net nic,netdev=net0,macaddr=@MAC@ -net nic"
QB_KERNEL_CMDLINE_APPEND ?= ""

QEMU_HW_DTB_PATH ?= "qemu-hw-devicetrees/multiarch"
QEMU_HW_DTB_PS ?= "${QEMU_HW_DTB_PATH}/board-versal2-xc2ve3858-psxc-virt.dtb"
QEMU_HW_DTB_PMC ?= "${QEMU_HW_DTB_PATH}/board-versal2-pmxc-virt.dtb"
QEMU_HW_DTB_ASU ?= "${QEMU_HW_DTB_PATH}/board-versal2-asu-virt.dtb"

# Four total serial ports defined in this model (according to the dts)
#
# hw serial0 xps-uartlite (0xf0110000) -
# hw serial1 xps-uartlite (0xf0310000) -
# hw serial2 pl011 (0xf1920000)        - linux serial0 (ttyAMA0)
# hw serial3 pl011 (0xf1930000)        - linux serial1 (ttyAMA1)
QEMU_HW_SERIAL ?= "-serial null -serial null -serial mon:stdio -serial null"

QB_DTB = "${QEMU_HW_DTB_PS}"

QB_OPT_APPEND += "-boot arch=versal2ve2vm -boot mode=${QEMU_HW_BOOT_MODE}"

# PLM instance args
QEMU_HW_PLM_OPT = " \
    -M microblaze-fdt \
    -hw-dtb @DEPLOY_DIR_IMAGE@/${QEMU_HW_DTB_PMC} \
    -display none \
    "

QB_OPT_APPEND += " -plm-args '${QEMU_HW_PLM_OPT}'"

# ASU instance args
QEMU_HW_ASU_OPT = " \
    -M riscv-fdt \
    -hw-dtb @DEPLOY_DIR_IMAGE@/${QEMU_HW_DTB_ASU} \
    -display none \
    "

QB_OPT_APPEND += " -asu-args '${QEMU_HW_ASU_OPT}'"

#### No additional settings should be after the Postamble
#### Postamble
PACKAGE_EXTRA_ARCHS:append = "${@['', ' versal_2ve_2vm_generic']['versal-2ve-2vm-generic' != '${MACHINE}']}"
```

## meta-xilinx-core/conf/machine/versal-ai-core-generic.conf
```bitbake
#### Preamble
MACHINEOVERRIDES =. "${@['', 'versal-ai-core-generic:']['versal-ai-core-generic' != '${MACHINE}']}"
#### Regular settings follow

require conf/machine/versal-generic.conf

MACHINE_FEATURES += "aie vdu"

#### No additional settings should be after the Postamble
#### Postamble
PACKAGE_EXTRA_ARCHS:append = "${@['', ' versal_ai_core_generic']['versal-ai-core-generic' != "${MACHINE}"]}"
```

## meta-xilinx-core/conf/machine/versal-ai-edge-generic.conf
```bitbake
#### Preamble
MACHINEOVERRIDES =. "${@['', 'versal-ai-edge-generic:']['versal-ai-edge-generic' != '${MACHINE}']}"
#### Regular settings follow

require conf/machine/versal-generic.conf

MACHINE_FEATURES += "aie vdu"

# VEK280 board has 12GB memory only but default versal-generic has QB_MEM set to
# 8G, Hence we need set 12G in QB_MEM.
QB_MEM ?= "-m 12G"

QEMU_HW_DTB_PS ?= "${QEMU_HW_DTB_PATH}/board-versal-ps-vek280.dtb"

#### No additional settings should be after the Postamble
#### Postamble
PACKAGE_EXTRA_ARCHS:append = "${@['', ' versal_ai_edge_generic']['versal-ai-edge-generic' != "${MACHINE}"]}"
```

## meta-xilinx-core/conf/machine/versal-common.conf
```bitbake
#@TYPE: Machine
#@NAME: versal-common
#@DESCRIPTION: Machine configuration for a common Versal filesystem devices

#### Preamble
MACHINEOVERRIDES =. "${@['', 'versal-common:']['versal-common' != '${MACHINE}']}"
#### Regular settings follow

DEFAULTTUNE = "cortexa72-cortexa53"

require conf/machine/versal-generic.conf

# Clear the machine specifc settings
QB_CMDLINE_IP_SLIRP = ""
QB_CMDLINE_IP_TAP = ""
QB_DEFAULT_KERNEL = ""
QB_DTB = ""
QB_MACHINE = ""
QB_MEM = ""
QB_NETWORK_DEVICE = ""
QB_NO_PNI = ""
QB_OPT_APPEND = ""
QB_ROOTFS_OPT = ""
QB_SERIAL_OPT = ""

MACHINE_FEATURES += "aie vdu fpga-overlay"

#### No additional settings should be after the Postamble
#### Postamble
PACKAGE_EXTRA_ARCHS:append = "${@['', ' versal_common']['versal-common' != "${MACHINE}"]}"
```
