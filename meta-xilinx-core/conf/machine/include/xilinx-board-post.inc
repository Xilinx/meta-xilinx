## meta-xilinx-core/conf/machine/versal-generic.conf
```bitbake
#@TYPE: Machine
#@NAME: versal-generic
#@DESCRIPTION: Machine configuration for the versal-generic devices

#### Preamble
MACHINEOVERRIDES =. "${@['', 'versal-generic:']['versal-generic' != '${MACHINE}']}"
#### Regular settings follow

# Variables that changes based on hw design or board specific requirement must be
# defined before calling the required inclusion file else pre-expansion value
# defined in local.conf without machine override will not be reflected.

# Yocto Versal u-boot-xlnx variables
UBOOT_MACHINE ?= "xilinx_versal_virt_defconfig"
BOOTMODE ?= "generic.root"

# Yocto Versal arm-trusted-firmware(TF-A) variables
TFA_BL33_LOAD ?= "0x8000000"

# Yocto Versal KERNEL Variables
UBOOT_ENTRYPOINT  ?= "0x200000"
UBOOT_LOADADDRESS ?= "0x200000"

# Versal Serial Console
SERIAL_CONSOLES ?= "115200;ttyAMA0"

require conf/machine/include/soc-versal.inc
require conf/machine/include/machine-xilinx-default.inc
require conf/machine/include/machine-xilinx-qemu.inc

MACHINE_FEATURES += "rtc ext2 ext3 vfat usbhost"

# Default SD image build onfiguration, use qemu-sd to pad
IMAGE_CLASSES += "image-types-xilinx-qemu"
# Add wic.qemu-sd only if initramfs_image not set due to circular dependecies
IMAGE_FSTYPES += "${@'wic.qemu-sd' if (d.getVar('INITRAMFS_IMAGE') or '') == '' else 'cpio.gz.u-boot.qemu-sd-fatimg'}"

EXTRA_IMAGEDEPENDS += " \
    u-boot-xlnx-scr \
    "

IMAGE_BOOT_FILES += " \
    Image \
    boot.scr \
    "

# Versal QEMU Configurations
# This machine has a QEMU model, runqemu setup:
QB_MEM ?= "-m 8G"
QB_DEFAULT_KERNEL ?= "none"
# Iteration appears to be eth0 then eth1
QB_NETWORK_DEVICE ?= "-net nic,netdev=net0,macaddr=@MAC@ -net nic"
QB_KERNEL_CMDLINE_APPEND ?= ""

QEMU_HW_DTB_PATH ?= "${DEPLOY_DIR_IMAGE}/qemu-hw-devicetrees/multiarch"
QEMU_HW_DTB_PS ?= "${QEMU_HW_DTB_PATH}/board-versal-ps-vck190.dtb"
QEMU_HW_DTB_PMC ?= "${QEMU_HW_DTB_PATH}/board-versal-pmc-virt.dtb"

# Four total serial ports defined in this model (according to the dts)
#
# hw serial0 xps-uartlite (f0110000)       - 
# hw serial1 ddrmc/xps-uartlite (f0310000) - 
# hw serial2 pl011 (ff000000)              - linux serial0 (ttyAMA0)
# hw serial3 pl011 (ff010000)              - linux serial1 (ttyAMA1) (disabled)
# ? dcc ?                                  - linux serial2 (????)
QB_XILINX_SERIAL ?= "-serial null -serial null -serial mon:stdio -serial null"

QB_OSPI_FILE ??= ""

QB_OPT_APPEND += " \
    -hw-dtb ${QEMU_HW_DTB_PS} \
    ${@qemu_add_extra_args(d)} \
    ${@'-bootbin ${QB_OSPI_FILE}' if d.getVar('QB_OSPI_FILE') != '' else ''} \
    "

# PLM instance args
QB_PLM_OPT = " \
    -M microblaze-fdt \
    -device loader,addr=0xf0000000,data=0xba020004,data-len=4 \
    -device loader,addr=0xf0000004,data=0xb800fffc,data-len=4 \
    -device loader,addr=0xF1110624,data=0x0,data-len=4 \
    -device loader,addr=0xF1110620,data=0x1,data-len=4 \
    -hw-dtb ${QEMU_HW_DTB_PMC} \
    -display none \
    "

QB_FW_FILES = " \
    -device loader,file=${DEPLOY_DIR_IMAGE}/BOOT-${MACHINE}_bh.bin,addr=0xF201E000,force-raw \
    -device loader,file=${DEPLOY_DIR_IMAGE}/CDO/pmc_cdo.bin,addr=0xf2000000,force-raw \
    -device loader,file=${DEPLOY_DIR_IMAGE}/plm-${MACHINE}.elf,cpu-num=1 \
"
QB_PLM_OPT += "${@d.getVar('QB_FW_FILES') if d.getVar('QB_OSPI_FILE') == '' else ''}"

QB_OPT_APPEND += " -plm-args '${QB_PLM_OPT}'"

#### No additional settings should be after the Postamble
#### Postamble
PACKAGE_EXTRA_ARCHS:append = "${@['', ' versal_generic']['versal-generic' != "${MACHINE}"]}"
```

## meta-xilinx-core/conf/machine/versal-hbm-generic.conf
```bitbake
#### Preamble
MACHINEOVERRIDES =. "${@['', 'versal-hbm-generic:']['versal-hbm-generic' != '${MACHINE}']}"
#### Regular settings follow

require conf/machine/versal-generic.conf

# VHK158 has 32GB memory only but default versal-generic has QB_MEM set to 8G,
# Since versal-vhk158-reva.dts has 32GB set, we need set same in QB_MEM
QB_MEM ?= "-m 32G"

QEMU_HW_DTB_PS ?=  "${QEMU_HW_DTB_PATH}/board-versal-ps-vhk158.dtb"

#### No additional settings should be after the Postamble
#### Postamble
PACKAGE_EXTRA_ARCHS:append = "${@['', ' versal_hbm_generic']['versal-hbm-generic' != "${MACHINE}"]}"
```

## meta-xilinx-core/conf/machine/versal-net-common.conf
```bitbake
#@TYPE: Machine
#@NAME: versal-net-common
#@DESCRIPTION: Machine configuration for a common versal-net filesystem devices

#### Preamble
MACHINEOVERRIDES =. "${@['', 'versal-net-common:']['versal-net-common' != '${MACHINE}']}"
#### Regular settings follow

DEFAULTTUNE = "cortexa72-cortexa53"

require conf/machine/versal-net-generic.conf

# Clear the machine specifc settings
QB_CMDLINE_IP_SLIRP = ""
QB_CMDLINE_IP_TAP = ""
QB_DEFAULT_KERNEL = ""
QB_DTB = ""
QB_MACHINE = ""
QB_MEM = ""
QB_NETWORK_DEVICE = ""
QB_NO_PNI = ""
QB_OPT_APPEND = ""
QB_ROOTFS_OPT = ""
QB_SERIAL_OPT = ""

MACHINE_FEATURES += "fpga-overlay"

#### No additional settings should be after the Postamble
#### Postamble
PACKAGE_EXTRA_ARCHS:append = "${@['', ' versal_net_common']['versal-net-common' != "${MACHINE}"]}"
```

## meta-xilinx-core/conf/machine/versal-net-generic.conf
```bitbake
#@TYPE: Machine
#@NAME: versal-net-generic
#@DESCRIPTION: Machine configuration for the versal-net-generic devices

#### Preamble
MACHINEOVERRIDES =. "${@['', 'versal-net-generic:']['versal-net-generic' != '${MACHINE}']}"
#### Regular settings follow

# Variables that changes based on hw design or board specific requirement must be
# defined before calling the required inclusion file else pre-expansion value
# defined in local.conf without machine override will not be reflected.

# Yocto Versal u-boot-xlnx variables
DEFAULT_UBOOT_MACHINE ?= "xilinx_versal_net_virt_defconfig"
UBOOT_MACHINE ?= "${DEFAULT_UBOOT_MACHINE}"
BOOTMODE ?= "generic.root"

# Yocto Versal arm-trusted-firmware(TF-A) variables
TFA_BL33_LOAD ?= "0x8000000"

# Yocto Versal KERNEL Variables
UBOOT_ENTRYPOINT  ?= "0x200000"
UBOOT_LOADADDRESS ?= "0x200000"

# Versal Serial Console
SERIAL_CONSOLES ?= "115200;ttyAMA0 115200;ttyAMA1"

require conf/machine/include/soc-versal-net.inc
require conf/machine/include/machine-xilinx-default.inc
require conf/machine/include/machine-xilinx-qemu.inc

MACHINE_FEATURES += "rtc ext2 ext3 vfat usbhost"

# Default SD image build onfiguration, use qemu-sd to pad
IMAGE_CLASSES += "image-types-xilinx-qemu"
# Add wic.qemu-sd only if initramfs_image not set due to circular dependecies
IMAGE_FSTYPES += "${@'wic.qemu-sd' if (d.getVar('INITRAMFS_IMAGE') or '') == '' else 'cpio.gz.u-boot.qemu-sd-fatimg'}"

UBOOT_BOOT_SCRIPT ?= "u-boot-xlnx-scr"

IMAGE_BOOT_FILES += " \
    ${KERNEL_IMAGETYPE} \
    boot.scr \
    "

# Versal QEMU Configurations
# This machine has a QEMU model, runqemu setup:
QB_MACHINE ?= "-machine arm-generic-fdt"

QB_MEM ?= "-m 8G"
# Iteration appears to be eth0 then eth1
QB_NETWORK_DEVICE ?= "-net nic,netdev=net0,macaddr=@MAC@ -net nic"
QB_KERNEL_CMDLINE_APPEND ?= ""

QEMU_HW_DTB_PATH ?= "qemu-hw-devicetrees/multiarch"
QEMU_HW_DTB_PS ?=  "${QEMU_HW_DTB_PATH}/board-versal-net-psx-spp-1.4.dtb"
QEMU_HW_DTB_PMC ?= "${QEMU_HW_DTB_PATH}/board-versal-pmx-virt.dtb"

# Four total serial ports defined in this model (according to the dts)
#
# hw serial0 xps-uartlite (0xf0110000) -
# hw serial1 xps-uartlite (0xf0310000) - 
# hw serial2 pl011 (0xf1920000)        - linux serial0 (ttyAMA0)
# hw serial3 pl011 (0xf1930000)        - linux serial1 (ttyAMA1)
QEMU_HW_SERIAL ?= "-serial null -serial null -serial mon:stdio -serial null"

QB_DTB = "${QEMU_HW_DTB_PS}"

QB_OPT_APPEND += "-boot arch=versal -boot mode=${QEMU_HW_BOOT_MODE}"

# PLM instance args
QEMU_HW_PLM_OPT = " \
    -M microblaze-fdt \
    -hw-dtb @DEPLOY_DIR_IMAGE@/${QEMU_HW_DTB_PMC} \
    -display none \
    "

QB_OPT_APPEND += " -plm-args '${QEMU_HW_PLM_OPT}'"

#### No additional settings should be after the Postamble
#### Postamble
PACKAGE_EXTRA_ARCHS:append = "${@['', ' versal_net_generic']['versal-net-generic' != "${MACHINE}"]}"
```

## meta-xilinx-core/conf/machine/versal-premium-generic.conf
```bitbake
#@TYPE: Machine
#@NAME: versal-premium-generic
#@DESCRIPTION: Generic machine configuration for the AMD Versal Premium series (Versal SoC with AI Engine, targeting high-bandwidth networking and compute). Obsolete use versal-generic instead.

#### Preamble
MACHINEOVERRIDES =. "${@['', 'versal-premium-generic:']['versal-premium-generic' != '${MACHINE}']}"
#### Regular settings follow

require conf/machine/versal-generic.conf

MACHINE_FEATURES += "aie"

#### No additional settings should be after the Postamble
#### Postamble
PACKAGE_EXTRA_ARCHS:append = "${@['', ' versal_premium_generic']['versal-premium-generic' != "${MACHINE}"]}"
```

## meta-xilinx-core/conf/machine/versal-prime-generic.conf
```bitbake
#### Preamble
MACHINEOVERRIDES =. "${@['', 'versal-prime-generic:']['versal-prime-generic' != '${MACHINE}']}"
#### Regular settings follow

require conf/machine/versal-generic.conf

QEMU_HW_DTB_PS = "${QEMU_HW_DTB_PATH}/board-versal-ps-vmk180.dtb"

#### No additional settings should be after the Postamble
#### Postamble
PACKAGE_EXTRA_ARCHS:append = "${@['', ' versal_prime_generic']['versal-prime-generic' != "${MACHINE}"]}"
```

## meta-xilinx-core/conf/machine/zynq-common.conf
```bitbake
#@TYPE: Machine
#@NAME: zynq-common
#@DESCRIPTION: Machine configuration for a common Zynq7 filesystem devices

#### Preamble
MACHINEOVERRIDES =. "${@['', 'zynq-common:']['zynq-common' != '${MACHINE}']}"
#### Regular settings follow

DEFAULTTUNE = "cortexa9thf-neon"

require conf/machine/zynq-generic.conf

# Clear the machine specifc settings
QB_CMDLINE_IP_SLIRP = ""
QB_CMDLINE_IP_TAP = ""
QB_DEFAULT_KERNEL = ""
QB_DTB = ""
QB_MACHINE = ""
QB_MEM = ""
QB_NETWORK_DEVICE = ""
QB_NO_PNI = ""
QB_OPT_APPEND = ""
QB_ROOTFS_OPT = ""
QB_SERIAL_OPT = ""

MACHINE_FEATURES += "fpga-overlay"

#### No additional settings should be after the Postamble
#### Postamble
PACKAGE_EXTRA_ARCHS:append = "${@['', ' zynq_common']['zynq-common' != "${MACHINE}"]}"
```

## meta-xilinx-core/conf/machine/zynq-generic.conf
```bitbake
#@TYPE: Machine
#@NAME: zynq-generic
#@DESCRIPTION: Generic machine configuration for the AMD Zynq-7000 SoC family (dual-core Cortex-A9 with FPGA fabric). Required by board-specific Zynq-7000 machines.

#### Preamble
MACHINEOVERRIDES =. "${@['', 'zynq-generic:']['zynq-generic' != '${MACHINE}']}"
#### Regular settings follow

# Variables that changes based on hw design or board specific requirement must be
# defined before calling the required inclusion file else pre-expansion value
# defined in local.conf without machine override will not be reflected.

# Yocto Zynq-7000 u-boot-xlnx variables
DEFAULT_UBOOT_MACHINE ?= "xilinx_zynq_virt_defconfig"
UBOOT_MACHINE ?= "${DEFAULT_UBOOT_MACHINE}"
BOOTMODE ?= "generic.root"

# Yocto KERNEL Variables
UBOOT_ENTRYPOINT  ?= "0x200000"
UBOOT_LOADADDRESS ?= "0x200000"
KERNEL_EXTRA_ARGS += "UIMAGE_LOADADDR=${UBOOT_ENTRYPOINT}"

# Zynq-7000 Serial Console settings
SERIAL_CONSOLES ?= "115200;ttyPS0"

require conf/machine/include/soc-zynq.inc
require conf/machine/include/machine-xilinx-default.inc
require conf/machine/include/machine-xilinx-qemu.inc

MACHINE_FEATURES += "rtc ext2 ext3 vfat usbhost usbgadget"

UBOOT_BOOT_SCRIPT ?= "u-boot-xlnx-scr"

IMAGE_BOOT_FILES += " \
    ${KERNEL_IMAGETYPE} \
    boot.scr \
    "

IMAGE_CLASSES += "image-types-xilinx-qemu"
# Add wic.qemu-sd only if initramfs_image not set due to circular dependecies
IMAGE_FSTYPES += "${@'wic.qemu-sd' if (d.getVar('INITRAMFS_IMAGE') or '') == '' else 'cpio.gz'}"

# Zynq-7000 QEMU Configurations
# This machine has a QEMU model, runqemu setup:
QB_MACHINE ?= "-M arm-generic-fdt-7series"

QB_MEM ?= "-m 1024"
QB_NETWORK_DEVICE ?= "-net nic,netdev=net0,macaddr=@MAC@"

QB_KERNEL_ROOT ?= "/dev/mmcblk0p2"

# Side effect of not-enabled serial port is we have to lock
# the second (console) to mon:stdio.
#
# Two total serial ports defined in this model (according to the generated dts)
#
# hw uart0 xuartps (e0000000) -
# hw uart1 xuartps (e0001000) - linux serial0 (ttyPS0)
QEMU_HW_SERIAL ?= "-serial null -serial mon:stdio"

# Replicate BootROM like behaviour, having loaded SPL and PMU(ROM+FW)
QB_OPT_APPEND += " -boot arch=zynq -boot mode=${QEMU_HW_BOOT_MODE}"

#### No additional settings should be after the Postamble
#### Postamble
PACKAGE_EXTRA_ARCHS:append = "${@['', ' zynq_generic']['zynq-generic' != "${MACHINE}"]}"
```

## meta-xilinx-core/conf/machine/zynqmp-cg-generic.conf
```bitbake
#@TYPE: Machine
#@NAME: zynqmp-cg-generic
#@DESCRIPTION: Generic machine configuration for the dual-core (CG) variant of the AMD Zynq UltraScale+ MPSoC family (no GPU, no Video Codec Unit). Obsolete use zynqmp-generic instead.

#### Preamble
MACHINEOVERRIDES =. "${@['', 'zynqmp-cg-generic:']['zynqmp-cg-generic' != '${MACHINE}']}"
#### Regular settings follow

require conf/machine/zynqmp-generic.conf

#### No additional settings should be after the Postamble
#### Postamble
PACKAGE_EXTRA_ARCHS:append = "${@['', ' zynqmp_cg_generic']['zynqmp-cg-generic' != "${MACHINE}"]}"
```

## meta-xilinx-core/conf/machine/zynqmp-common.conf
```bitbake
#@TYPE: Machine
#@NAME: zynqmp-common
#@DESCRIPTION: Machine configuration for a common ZynqMP (MPSOC) filesystem devices w/o mali400

#### Preamble
MACHINEOVERRIDES =. "${@['', 'zynqmp-common:']['zynqmp-common' != '${MACHINE}']}"
#### Regular settings follow

DEFAULTTUNE = "cortexa53"

require conf/machine/zynqmp-generic.conf

MACHINE_FEATURES += "vcu rfsoc"

#### No additional settings should be after the Postamble
#### Postamble
PACKAGE_EXTRA_ARCHS:append = "${@['', ' zynqmp_common']['zynqmp-common' != "${MACHINE}"]}"
```

## meta-xilinx-core/conf/machine/zynqmp-dr-generic.conf
```bitbake
#@TYPE: Machine
#@NAME: zynqmp-dr-generic
#@DESCRIPTION: Generic machine configuration for the AMD Zynq UltraScale+ RFSoC (DR) variant (MPSoC plus integrated RF data converters). Obsolete use zynqmp-generic instead.

#### Preamble
MACHINEOVERRIDES =. "${@['', 'zynqmp-dr-generic:']['zynqmp-dr-generic' != '${MACHINE}']}"
#### Regular settings follow

require conf/machine/zynqmp-generic.conf

MACHINE_FEATURES += "rfsoc"

#### No additional settings should be after the Postamble
#### Postamble
PACKAGE_EXTRA_ARCHS:append = "${@['', ' zynqmp_dr_generic']['zynqmp-dr-generic' != "${MACHINE}"]}"
```

## meta-xilinx-core/conf/machine/zynqmp-eg-generic.conf
```bitbake
#@TYPE: Machine
#@NAME: zynqmp-eg-generic
#@DESCRIPTION: Generic machine configuration for the quad-core (EG) variant of the AMD Zynq UltraScale+ MPSoC family (with Mali-400 GPU). Obsolete use zynqmp-generic instead.

#### Preamble
MACHINEOVERRIDES =. "${@['', 'zynqmp-eg-generic:']['zynqmp-eg-generic' != '${MACHINE}']}"
#### Regular settings follow

require conf/machine/zynqmp-generic.conf

MACHINE_FEATURES += "mali400"

#### No additional settings should be after the Postamble
#### Postamble
PACKAGE_EXTRA_ARCHS:append = "${@['', ' zynqmp_eg_generic']['zynqmp-eg-generic' != "${MACHINE}"]}"
```

## meta-xilinx-core/conf/machine/zynqmp-ev-generic.conf
```bitbake
#@TYPE: Machine
#@NAME: zynqmp-ev-generic
#@DESCRIPTION: Generic machine configuration for the quad-core (EV) variant of the AMD Zynq UltraScale+ MPSoC family (with Mali-400 GPU and H.264/H.265 Video Codec Unit). Obsolete use zynqmp-generic instead.

#### Preamble
MACHINEOVERRIDES =. "${@['', 'zynqmp-ev-generic:']['zynqmp-ev-generic' != '${MACHINE}']}"
#### Regular settings follow

require conf/machine/zynqmp-generic.conf

MACHINE_FEATURES += "mali400 vcu"

#### No additional settings should be after the Postamble
#### Postamble
PACKAGE_EXTRA_ARCHS:append = "${@['', ' zynqmp_ev_generic']['zynqmp-ev-generic' != "${MACHINE}"]}"
```
