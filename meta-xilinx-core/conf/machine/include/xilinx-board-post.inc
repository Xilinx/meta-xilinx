## meta-xilinx-core/conf/machine/zynqmp-generic.conf
```bitbake
#@TYPE: Machine
#@NAME: zynqmp-generic
#@DESCRIPTION: Machine configuration for the zynqmp-generic devices

#### Preamble
MACHINEOVERRIDES =. "${@['', 'zynqmp-generic:']['zynqmp-generic' != '${MACHINE}']}"
#### Regular settings follow

# Variables that changes based on hw design or board specific requirement must be
# defined before calling the required inclusion file else pre-expansion value
# defined in local.conf without machine override will not be reflected.

# Yocto ZynqMP u-boot-xlnx variables
DEFAULT_UBOOT_MACHINE ?= "xilinx_zynqmp_virt_defconfig"
UBOOT_MACHINE ?= "${DEFAULT_UBOOT_MACHINE}"
BOOTMODE ?= "generic.root"

# By default U-boot SPL boot is disabled
SPL_BINARY ?= ""

# If user needs U-boot SPL boot, then enable SPL from local.conf as shown below.
# SPL_BINARY = "spl/boot.bin"

# Yocto ZynqMP arm-trusted-firmware(TF-A) variables
TFA_BL33_LOAD ?= "0x8000000"

# Yocto ZynqMP KERNEL Variables
UBOOT_ENTRYPOINT  ?= "0x200000"
UBOOT_LOADADDRESS ?= "0x200000"

# ZynqMP Serial Console
SERIAL_CONSOLES ?= "115200;ttyPS0 115200;ttyPS1"

require conf/machine/include/soc-zynqmp.inc
require conf/machine/include/machine-xilinx-default.inc
require conf/machine/include/machine-xilinx-qemu.inc

# Machine features must result in a superset
# Basic features:
MACHINE_FEATURES += "rtc ext2 ext3 vfat usbhost usbgadget wifi bluetooth"

# Default SD image build onfiguration, use qemu-sd to pad
IMAGE_CLASSES += "image-types-xilinx-qemu"
# Add wic.qemu-sd only if initramfs_image not set due to circular dependecies
IMAGE_FSTYPES += "${@'wic.qemu-sd' if (d.getVar('INITRAMFS_IMAGE') or '') == '' else 'cpio.gz.u-boot'}"

UBOOT_BOOT_SCRIPT ?= "u-boot-xlnx-scr"

IMAGE_BOOT_FILES += " \
    ${KERNEL_IMAGETYPE} \
    boot.scr \
    "

# ZynqMP QEMU Configurations
# This machine has a QEMU model, runqemu setup:
QB_MACHINE ?= "-machine arm-generic-fdt"

QB_MEM ?= "-m 4096"
# Iteration appears to be eth3, eth2, eth1, eth0
QB_NETWORK_DEVICE ?= "-net nic -net nic -net nic -net nic,netdev=net0,macaddr=@MAC@"

# Set variables for QEMU DTB PATH, PS DTB and PMU DTB for zynqmp_generic, this
# allows user to use different QEMU HW DTB to match their board.
QEMU_HW_DTB_PATH ?= "qemu-hw-devicetrees/multiarch"
QEMU_HW_DTB_PS ?= "${QEMU_HW_DTB_PATH}/zcu102-arm.dtb"
QEMU_HW_DTB_PMU ?= "${QEMU_HW_DTB_PATH}/zynqmp-pmu.dtb"

# Two total serial ports defined in this model (according to the dts)
#
# hw ps7_uart_0 (0xFF000000) - linux serial1 (ttyPS1)
# hw ps7_uart_1 (0xFF010000) - linux serial0 (ttyPS0)
#
# Default configuration will evaluate to:
#QEMU_HW_SERIAL = "-serial mon:stdio -serial null"

QB_DTB = "${QEMU_HW_DTB_PS}"

QB_OPT_APPEND += "-boot arch=zynqmp -boot mode=${QEMU_HW_BOOT_MODE}"

QEMU_HW_PMU_OPT = " \
    -M microblaze-fdt \
    -display none \
    -hw-dtb @DEPLOY_DIR_IMAGE@/${QEMU_HW_DTB_PMU} \
    -kernel @DEPLOY_DIR_IMAGE@/${PMU_ROM} \
    "

QB_OPT_APPEND += " -pmu-args '${QEMU_HW_PMU_OPT}'"

#### No additional settings should be after the Postamble
#### Postamble
PACKAGE_EXTRA_ARCHS:append = "${@['', ' zynqmp_generic']['zynqmp-generic' != "${MACHINE}"]}"
```

## meta-xilinx-core/conf/machine/zynqmp-mali-common.conf
```bitbake
#@TYPE: Machine
#@NAME: zynqmp-mali-common
#@DESCRIPTION: Machine configuration for a common ZynqMP (MPSOC) filesystem devices w/ mali400

#### Preamble
MACHINEOVERRIDES =. "${@['', 'zynqmp-mali-common:']['zynqmp-mali-common' != '${MACHINE}']}"
#### Regular settings follow

DEFAULTTUNE = "cortexa72-cortexa53"

require conf/machine/zynqmp-generic.conf

# Clear the machine specifc settings
QB_CMDLINE_IP_SLIRP = ""
QB_CMDLINE_IP_TAP = ""
QB_DEFAULT_KERNEL = ""
QB_DTB = ""
QB_MACHINE = ""
QB_MEM = ""
QB_NETWORK_DEVICE = ""
QB_NO_PNI = ""
QB_OPT_APPEND = ""
QB_ROOTFS_OPT = ""
QB_SERIAL_OPT = ""

MACHINE_FEATURES += "mali400 vcu fpga-overlay"

#### No additional settings should be after the Postamble
#### Postamble
PACKAGE_EXTRA_ARCHS:append = "${@['', ' zynqmp_mali_common']['zynqmp-mali-common' != "${MACHINE}"]}"
```
