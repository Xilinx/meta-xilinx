## meta-xilinx-standalone-sdt/conf/distro/include/meta-xilinx-standalone-sdt-default-versions.inc
```bitbake
# Aid debugging, show where the device trees are we are using
BUILDCFG_VARS:append = " SYSTEM_DTFILE CONFIG_DTFILE"

# These are the recipes-library items, they should all be from the same ESW version
PREFERRED_VERSION_freertos10-xilinx  ??= "${PREFERRED_VERSION_esw}%"
PREFERRED_VERSION_libxil             ??= "${PREFERRED_VERSION_esw}%"
PREFERRED_VERSION_lwip               ??= "${PREFERRED_VERSION_esw}%"
PREFERRED_VERSION_xilffs             ??= "${PREFERRED_VERSION_esw}%"
PREFERRED_VERSION_xilffs-example     ??= "${PREFERRED_VERSION_esw}%"
PREFERRED_VERSION_xilfpga            ??= "${PREFERRED_VERSION_esw}%"
PREFERRED_VERSION_xilfpga-example    ??= "${PREFERRED_VERSION_esw}%"
PREFERRED_VERSION_xilloader          ??= "${PREFERRED_VERSION_esw}%"
PREFERRED_VERSION_xilmailbox         ??= "${PREFERRED_VERSION_esw}%"
PREFERRED_VERSION_xilmailbox-example ??= "${PREFERRED_VERSION_esw}%"
PREFERRED_VERSION_xilnvm             ??= "${PREFERRED_VERSION_esw}%"
PREFERRED_VERSION_xilnvm-example     ??= "${PREFERRED_VERSION_esw}%"
PREFERRED_VERSION_xilpdi             ??= "${PREFERRED_VERSION_esw}%"
PREFERRED_VERSION_xilplmi            ??= "${PREFERRED_VERSION_esw}%"
PREFERRED_VERSION_xilpm              ??= "${PREFERRED_VERSION_esw}%"
PREFERRED_VERSION_xilpuf             ??= "${PREFERRED_VERSION_esw}%"
PREFERRED_VERSION_xilpuf-example     ??= "${PREFERRED_VERSION_esw}%"
PREFERRED_VERSION_xilsecure          ??= "${PREFERRED_VERSION_esw}%"
PREFERRED_VERSION_xilsecure-example  ??= "${PREFERRED_VERSION_esw}%"
PREFERRED_VERSION_xilsem             ??= "${PREFERRED_VERSION_esw}%"
PREFERRED_VERSION_xilskey            ??= "${PREFERRED_VERSION_esw}%"
PREFERRED_VERSION_xilskey-example    ??= "${PREFERRED_VERSION_esw}%"
PREFERRED_VERSION_xilstandalone      ??= "${PREFERRED_VERSION_esw}%"
PREFERRED_VERSION_xiltimer           ??= "${PREFERRED_VERSION_esw}%"

# The following are the recipes-drivers used by the library items above
# they should come from the same ESW version as the library.
PREFERRED_VERSION_avbuf               ??= "${PREFERRED_VERSION_esw}%"
PREFERRED_VERSION_axicdma             ??= "${PREFERRED_VERSION_esw}%"
PREFERRED_VERSION_axicdma-example     ??= "${PREFERRED_VERSION_esw}%"
PREFERRED_VERSION_axidma              ??= "${PREFERRED_VERSION_esw}%"
PREFERRED_VERSION_axidma-example      ??= "${PREFERRED_VERSION_esw}%"
PREFERRED_VERSION_axiethernet         ??= "${PREFERRED_VERSION_esw}%"
PREFERRED_VERSION_axiethernet-example ??= "${PREFERRED_VERSION_esw}%"
PREFERRED_VERSION_axipmon             ??= "${PREFERRED_VERSION_esw}%"
PREFERRED_VERSION_axipmon-example     ??= "${PREFERRED_VERSION_esw}%"
PREFERRED_VERSION_axis-switch         ??= "${PREFERRED_VERSION_esw}%"
PREFERRED_VERSION_axivdma             ??= "${PREFERRED_VERSION_esw}%"
PREFERRED_VERSION_axivdma-example     ??= "${PREFERRED_VERSION_esw}%"
PREFERRED_VERSION_bram                ??= "${PREFERRED_VERSION_esw}%"
PREFERRED_VERSION_bram-example        ??= "${PREFERRED_VERSION_esw}%"
PREFERRED_VERSION_can                 ??= "${PREFERRED_VERSION_esw}%"
PREFERRED_VERSION_can-example         ??= "${PREFERRED_VERSION_esw}%"
PREFERRED_VERSION_canfd               ??= "${PREFERRED_VERSION_esw}%"
PREFERRED_VERSION_canfd-example       ??= "${PREFERRED_VERSION_esw}%"
PREFERRED_VERSION_canps               ??= "${PREFERRED_VERSION_esw}%"
PREFERRED_VERSION_canps-example       ??= "${PREFERRED_VERSION_esw}%"
PREFERRED_VERSION_cframe              ??= "${PREFERRED_VERSION_esw}%"
PREFERRED_VERSION_cfupmc              ??= "${PREFERRED_VERSION_esw}%"
PREFERRED_VERSION_clk-wiz             ??= "${PREFERRED_VERSION_esw}%"
PREFERRED_VERSION_clk-wiz-example     ??= "${PREFERRED_VERSION_esw}%"
PREFERRED_VERSION_clockps             ??= "${PREFERRED_VERSION_esw}%"
PREFERRED_VERSION_clockps-example     ??= "${PREFERRED_VERSION_esw}%"
PREFERRED_VERSION_common              ??= "${PREFERRED_VERSION_esw}%"
PREFERRED_VERSION_coresightps-dcc     ??= "${PREFERRED_VERSION_esw}%"
PREFERRED_VERSION_csudma              ??= "${PREFERRED_VERSION_esw}%"
PREFERRED_VERSION_csudma-example      ??= "${PREFERRED_VERSION_esw}%"
PREFERRED_VERSION_ddrcpsu             ??= "${PREFERRED_VERSION_esw}%"
PREFERRED_VERSION_devcfg              ??= "${PREFERRED_VERSION_esw}%"
PREFERRED_VERSION_devcfg-example      ??= "${PREFERRED_VERSION_esw}%"
PREFERRED_VERSION_dfeccf              ??= "${PREFERRED_VERSION_esw}%"
PREFERRED_VERSION_dfeccf-example      ??= "${PREFERRED_VERSION_esw}%"
PREFERRED_VERSION_dfeequ              ??= "${PREFERRED_VERSION_esw}%"
PREFERRED_VERSION_dfeequ-example      ??= "${PREFERRED_VERSION_esw}%"
PREFERRED_VERSION_dfemix              ??= "${PREFERRED_VERSION_esw}%"
PREFERRED_VERSION_dfemix-example      ??= "${PREFERRED_VERSION_esw}%"
PREFERRED_VERSION_dfeofdm             ??= "${PREFERRED_VERSION_esw}%"
PREFERRED_VERSION_dfeofdm-example     ??= "${PREFERRED_VERSION_esw}%"
PREFERRED_VERSION_dfeprach            ??= "${PREFERRED_VERSION_esw}%"
PREFERRED_VERSION_dfeprach-example    ??= "${PREFERRED_VERSION_esw}%"
PREFERRED_VERSION_dfxasm              ??= "${PREFERRED_VERSION_esw}%"
PREFERRED_VERSION_dfxasm-example      ??= "${PREFERRED_VERSION_esw}%"
PREFERRED_VERSION_dmaps               ??= "${PREFERRED_VERSION_esw}%"
PREFERRED_VERSION_dmaps-example       ??= "${PREFERRED_VERSION_esw}%"
PREFERRED_VERSION_dp14                ??= "${PREFERRED_VERSION_esw}%"
PREFERRED_VERSION_dp14rxss            ??= "${PREFERRED_VERSION_esw}%"
PREFERRED_VERSION_dpdma               ??= "${PREFERRED_VERSION_esw}%"
PREFERRED_VERSION_dppsu               ??= "${PREFERRED_VERSION_esw}%"
PREFERRED_VERSION_emaclite            ??= "${PREFERRED_VERSION_esw}%"
PREFERRED_VERSION_emaclite-example    ??= "${PREFERRED_VERSION_esw}%"
PREFERRED_VERSION_emacps              ??= "${PREFERRED_VERSION_esw}%"
PREFERRED_VERSION_emacps-example      ??= "${PREFERRED_VERSION_esw}%"
PREFERRED_VERSION_emc                 ??= "${PREFERRED_VERSION_esw}%"
PREFERRED_VERSION_gpio                ??= "${PREFERRED_VERSION_esw}%"
PREFERRED_VERSION_gpio-example        ??= "${PREFERRED_VERSION_esw}%"
PREFERRED_VERSION_gpiops              ??= "${PREFERRED_VERSION_esw}%"
PREFERRED_VERSION_gpiops-example      ??= "${PREFERRED_VERSION_esw}%"
PREFERRED_VERSION_hwicap              ??= "${PREFERRED_VERSION_esw}%"
PREFERRED_VERSION_i2srx               ??= "${PREFERRED_VERSION_esw}%"
PREFERRED_VERSION_i2stx               ??= "${PREFERRED_VERSION_esw}%"
PREFERRED_VERSION_i3cpsx              ??= "${PREFERRED_VERSION_esw}%"
PREFERRED_VERSION_i3cpsx-example      ??= "${PREFERRED_VERSION_esw}%"
PREFERRED_VERSION_iic                 ??= "${PREFERRED_VERSION_esw}%"
PREFERRED_VERSION_iic-example         ??= "${PREFERRED_VERSION_esw}%"
PREFERRED_VERSION_iicps               ??= "${PREFERRED_VERSION_esw}%"
PREFERRED_VERSION_iicps-example       ??= "${PREFERRED_VERSION_esw}%"
PREFERRED_VERSION_intc                ??= "${PREFERRED_VERSION_esw}%"
PREFERRED_VERSION_intc-example        ??= "${PREFERRED_VERSION_esw}%"
PREFERRED_VERSION_iomodule            ??= "${PREFERRED_VERSION_esw}%"
PREFERRED_VERSION_ipipsu              ??= "${PREFERRED_VERSION_esw}%"
PREFERRED_VERSION_ipipsu-example      ??= "${PREFERRED_VERSION_esw}%"
PREFERRED_VERSION_llfifo              ??= "${PREFERRED_VERSION_esw}%"
PREFERRED_VERSION_llfifo-example      ??= "${PREFERRED_VERSION_esw}%"
PREFERRED_VERSION_mbox                ??= "${PREFERRED_VERSION_esw}%"
PREFERRED_VERSION_mbox-example        ??= "${PREFERRED_VERSION_esw}%"
PREFERRED_VERSION_mcdma               ??= "${PREFERRED_VERSION_esw}%"
PREFERRED_VERSION_mcdma-example       ??= "${PREFERRED_VERSION_esw}%"
PREFERRED_VERSION_mutex               ??= "${PREFERRED_VERSION_esw}%"
PREFERRED_VERSION_mutex-example       ??= "${PREFERRED_VERSION_esw}%"
PREFERRED_VERSION_nandps              ??= "${PREFERRED_VERSION_esw}%"
PREFERRED_VERSION_nandpsu             ??= "${PREFERRED_VERSION_esw}%"
PREFERRED_VERSION_nandpsu-example     ??= "${PREFERRED_VERSION_esw}%"
PREFERRED_VERSION_ospipsv             ??= "${PREFERRED_VERSION_esw}%"
PREFERRED_VERSION_ospipsv-example     ??= "${PREFERRED_VERSION_esw}%"
PREFERRED_VERSION_pciepsu             ??= "${PREFERRED_VERSION_esw}%"
PREFERRED_VERSION_pciepsu-example     ??= "${PREFERRED_VERSION_esw}%"
PREFERRED_VERSION_prc                 ??= "${PREFERRED_VERSION_esw}%"
PREFERRED_VERSION_prd                 ??= "${PREFERRED_VERSION_esw}%"
PREFERRED_VERSION_qspips              ??= "${PREFERRED_VERSION_esw}%"
PREFERRED_VERSION_qspips-example      ??= "${PREFERRED_VERSION_esw}%"
PREFERRED_VERSION_qspipsu             ??= "${PREFERRED_VERSION_esw}%"
PREFERRED_VERSION_qspipsu-example     ??= "${PREFERRED_VERSION_esw}%"
PREFERRED_VERSION_resetps             ??= "${PREFERRED_VERSION_esw}%"
PREFERRED_VERSION_resetps-example     ??= "${PREFERRED_VERSION_esw}%"
PREFERRED_VERSION_rfdc                ??= "${PREFERRED_VERSION_esw}%"
PREFERRED_VERSION_rfdc-example        ??= "${PREFERRED_VERSION_esw}%"
PREFERRED_VERSION_rtcpsu              ??= "${PREFERRED_VERSION_esw}%"
PREFERRED_VERSION_rtcpsu-example      ??= "${PREFERRED_VERSION_esw}%"
PREFERRED_VERSION_scugic              ??= "${PREFERRED_VERSION_esw}%"
PREFERRED_VERSION_scugic-example      ??= "${PREFERRED_VERSION_esw}%"
PREFERRED_VERSION_scutimer            ??= "${PREFERRED_VERSION_esw}%"
PREFERRED_VERSION_scuwdt              ??= "${PREFERRED_VERSION_esw}%"
PREFERRED_VERSION_sd-fec              ??= "${PREFERRED_VERSION_esw}%"
PREFERRED_VERSION_sdps                ??= "${PREFERRED_VERSION_esw}%"
PREFERRED_VERSION_sdps-example        ??= "${PREFERRED_VERSION_esw}%"
PREFERRED_VERSION_spi                 ??= "${PREFERRED_VERSION_esw}%"
PREFERRED_VERSION_spips               ??= "${PREFERRED_VERSION_esw}%"
PREFERRED_VERSION_spips-example       ??= "${PREFERRED_VERSION_esw}%"
PREFERRED_VERSION_sysmon              ??= "${PREFERRED_VERSION_esw}%"
PREFERRED_VERSION_sysmon-example      ??= "${PREFERRED_VERSION_esw}%"
PREFERRED_VERSION_sysmonpsu           ??= "${PREFERRED_VERSION_esw}%"
PREFERRED_VERSION_sysmonpsu-example   ??= "${PREFERRED_VERSION_esw}%"
PREFERRED_VERSION_sysmonpsv           ??= "${PREFERRED_VERSION_esw}%"
PREFERRED_VERSION_sysmonpsv-example   ??= "${PREFERRED_VERSION_esw}%"
PREFERRED_VERSION_tft                 ??= "${PREFERRED_VERSION_esw}%"
PREFERRED_VERSION_tmrctr              ??= "${PREFERRED_VERSION_esw}%"
PREFERRED_VERSION_tmrctr-example      ??= "${PREFERRED_VERSION_esw}%"
PREFERRED_VERSION_tmr-inject          ??= "${PREFERRED_VERSION_esw}%"
PREFERRED_VERSION_tmr-manager         ??= "${PREFERRED_VERSION_esw}%"
PREFERRED_VERSION_trafgen             ??= "${PREFERRED_VERSION_esw}%"
PREFERRED_VERSION_trafgen-example     ??= "${PREFERRED_VERSION_esw}%"
PREFERRED_VERSION_trngpsv             ??= "${PREFERRED_VERSION_esw}%"
PREFERRED_VERSION_trngpsx             ??= "${PREFERRED_VERSION_esw}%"
PREFERRED_VERSION_ttcps               ??= "${PREFERRED_VERSION_esw}%"
PREFERRED_VERSION_ttcps-example       ??= "${PREFERRED_VERSION_esw}%"
PREFERRED_VERSION_uartlite            ??= "${PREFERRED_VERSION_esw}%"
PREFERRED_VERSION_uartlite-example    ??= "${PREFERRED_VERSION_esw}%"
PREFERRED_VERSION_uartns550           ??= "${PREFERRED_VERSION_esw}%"
PREFERRED_VERSION_uartns550-example   ??= "${PREFERRED_VERSION_esw}%"
PREFERRED_VERSION_uartps              ??= "${PREFERRED_VERSION_esw}%"
PREFERRED_VERSION_uartps-example      ??= "${PREFERRED_VERSION_esw}%"
PREFERRED_VERSION_uartpsv             ??= "${PREFERRED_VERSION_esw}%"
PREFERRED_VERSION_uartpsv-example     ??= "${PREFERRED_VERSION_esw}%"
PREFERRED_VERSION_usb                 ??= "${PREFERRED_VERSION_esw}%"
PREFERRED_VERSION_usb-example         ??= "${PREFERRED_VERSION_esw}%"
PREFERRED_VERSION_usbps               ??= "${PREFERRED_VERSION_esw}%"
PREFERRED_VERSION_usbpsu              ??= "${PREFERRED_VERSION_esw}%"
PREFERRED_VERSION_usbpsu-example      ??= "${PREFERRED_VERSION_esw}%"
PREFERRED_VERSION_v-csc               ??= "${PREFERRED_VERSION_esw}%"
PREFERRED_VERSION_v-deinterlacer      ??= "${PREFERRED_VERSION_esw}%"
PREFERRED_VERSION_v-demosaic          ??= "${PREFERRED_VERSION_esw}%"
PREFERRED_VERSION_v-demosaic-example  ??= "${PREFERRED_VERSION_esw}%"
PREFERRED_VERSION_v-frmbuf-rd         ??= "${PREFERRED_VERSION_esw}%"
PREFERRED_VERSION_v-frmbuf-rd-example ??= "${PREFERRED_VERSION_esw}%"
PREFERRED_VERSION_v-frmbuf-wr         ??= "${PREFERRED_VERSION_esw}%"
PREFERRED_VERSION_v-frmbuf-wr-example ??= "${PREFERRED_VERSION_esw}%"
PREFERRED_VERSION_v-gamma-lut         ??= "${PREFERRED_VERSION_esw}%"
PREFERRED_VERSION_v-gamma-lut-example ??= "${PREFERRED_VERSION_esw}%"
PREFERRED_VERSION_v-hcresampler       ??= "${PREFERRED_VERSION_esw}%"
PREFERRED_VERSION_v-hdmi-common       ??= "${PREFERRED_VERSION_esw}%"
PREFERRED_VERSION_v-hdmiphy1          ??= "${PREFERRED_VERSION_esw}%"
PREFERRED_VERSION_v-hdmirx1           ??= "${PREFERRED_VERSION_esw}%"
PREFERRED_VERSION_v-hdmirxss1         ??= "${PREFERRED_VERSION_esw}%"
PREFERRED_VERSION_v-hdmitx1           ??= "${PREFERRED_VERSION_esw}%"
PREFERRED_VERSION_v-hdmitxss1         ??= "${PREFERRED_VERSION_esw}%"
PREFERRED_VERSION_v-hscaler           ??= "${PREFERRED_VERSION_esw}%"
PREFERRED_VERSION_video-common        ??= "${PREFERRED_VERSION_esw}%"
PREFERRED_VERSION_v-letterbox         ??= "${PREFERRED_VERSION_esw}%"
PREFERRED_VERSION_v-mix               ??= "${PREFERRED_VERSION_esw}%"
PREFERRED_VERSION_v-mix-example       ??= "${PREFERRED_VERSION_esw}%"
PREFERRED_VERSION_v-multi-scaler      ??= "${PREFERRED_VERSION_esw}%"
PREFERRED_VERSION_v-multi-scaler-example ??= "${PREFERRED_VERSION_esw}%"
PREFERRED_VERSION_vphy                ??= "${PREFERRED_VERSION_esw}%"
PREFERRED_VERSION_vprocss             ??= "${PREFERRED_VERSION_esw}%"
PREFERRED_VERSION_vprocss-example     ??= "${PREFERRED_VERSION_esw}%"
PREFERRED_VERSION_v-scenechange       ??= "${PREFERRED_VERSION_esw}%"
PREFERRED_VERSION_v-scenechange-example ??= "${PREFERRED_VERSION_esw}%"
PREFERRED_VERSION_vtc                 ??= "${PREFERRED_VERSION_esw}%"
PREFERRED_VERSION_v-tpg               ??= "${PREFERRED_VERSION_esw}%"
PREFERRED_VERSION_v-vcresampler       ??= "${PREFERRED_VERSION_esw}%"
PREFERRED_VERSION_v-vscaler           ??= "${PREFERRED_VERSION_esw}%"
PREFERRED_VERSION_v-warp-filter       ??= "${PREFERRED_VERSION_esw}%"
PREFERRED_VERSION_v-warp-init         ??= "${PREFERRED_VERSION_esw}%"
PREFERRED_VERSION_wdtps               ??= "${PREFERRED_VERSION_esw}%"
PREFERRED_VERSION_wdtps-example       ??= "${PREFERRED_VERSION_esw}%"
PREFERRED_VERSION_wdttb               ??= "${PREFERRED_VERSION_esw}%"
PREFERRED_VERSION_wdttb-example       ??= "${PREFERRED_VERSION_esw}%"
PREFERRED_VERSION_xadcps              ??= "${PREFERRED_VERSION_esw}%"
PREFERRED_VERSION_xadcps-example      ??= "${PREFERRED_VERSION_esw}%"
PREFERRED_VERSION_xdmapcie            ??= "${PREFERRED_VERSION_esw}%"
PREFERRED_VERSION_xdmapcie-example    ??= "${PREFERRED_VERSION_esw}%"
PREFERRED_VERSION_xxvethernet         ??= "${PREFERRED_VERSION_esw}%"
PREFERRED_VERSION_xxvethernet-example ??= "${PREFERRED_VERSION_esw}%"
PREFERRED_VERSION_zdma                ??= "${PREFERRED_VERSION_esw}%"
PREFERRED_VERSION_zdma-example        ??= "${PREFERRED_VERSION_esw}%"

# The following are applications that use the libraries and drivers
PREFERRED_VERSION_ddr-self-refresh              ??= "${PREFERRED_VERSION_esw}%"
PREFERRED_VERSION_empty-application             ??= "${PREFERRED_VERSION_esw}%"
PREFERRED_VERSION_freertos-hello-world          ??= "${PREFERRED_VERSION_esw}%"
PREFERRED_VERSION_freertos-lwip-echo-server     ??= "${PREFERRED_VERSION_esw}%"
PREFERRED_VERSION_freertos-lwip-tcp-perf-client ??= "${PREFERRED_VERSION_esw}%"
PREFERRED_VERSION_freertos-lwip-tcp-perf-server ??= "${PREFERRED_VERSION_esw}%"
PREFERRED_VERSION_freertos-lwip-udp-perf-client ??= "${PREFERRED_VERSION_esw}%"
PREFERRED_VERSION_freertos-lwip-udp-perf-server ??= "${PREFERRED_VERSION_esw}%"
PREFERRED_VERSION_hello-world                   ??= "${PREFERRED_VERSION_esw}%"
PREFERRED_VERSION_lwip-echo-server              ??= "${PREFERRED_VERSION_esw}%"
PREFERRED_VERSION_lwip-tcp-perf-client          ??= "${PREFERRED_VERSION_esw}%"
PREFERRED_VERSION_lwip-tcp-perf-server          ??= "${PREFERRED_VERSION_esw}%"
PREFERRED_VERSION_lwip-udp-perf-client          ??= "${PREFERRED_VERSION_esw}%"
PREFERRED_VERSION_lwip-udp-perf-server          ??= "${PREFERRED_VERSION_esw}%"
PREFERRED_VERSION_memory-tests                  ??= "${PREFERRED_VERSION_esw}%"
PREFERRED_VERSION_openamp-fw-echo-testd.bb      ??= "${PREFERRED_VERSION_esw}%"
PREFERRED_VERSION_openamp-fw-mat-muld.bb        ??= "${PREFERRED_VERSION_esw}%"
PREFERRED_VERSION_openamp-fw-rpc-demo.bb        ??= "${PREFERRED_VERSION_esw}%"
PREFERRED_VERSION_peripheral-tests              ??= "${PREFERRED_VERSION_esw}%"
PREFERRED_VERSION_sample-fw-package.bb          ??= "${PREFERRED_VERSION_esw}%"
PREFERRED_VERSION_srec-bootloader               ??= "${PREFERRED_VERSION_esw}%"
PREFERRED_VERSION_srec-spi-bootloader           ??= "${PREFERRED_VERSION_esw}%"
PREFERRED_VERSION_zynq-dram-test                ??= "${PREFERRED_VERSION_esw}%"
PREFERRED_VERSION_zynqmp-dram-test              ??= "${PREFERRED_VERSION_esw}%"
```
