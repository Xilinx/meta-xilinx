## meta-xilinx-standalone/conf/machine/aarch64-tc.conf
```bitbake
require conf/multilib.conf
require conf/machine/include/arm/armv8a/tune-cortexa72-cortexa53.inc
require conf/machine/include/baremetal-tc.conf

# Define ilp32 variant (not in tune files)
TUNEVALID[ilp32] = "ilp32 ABI"

TUNE_CCARGS .= '${@bb.utils.contains("TUNE_FEATURES", "ilp32", " -mabi=ilp32", "", d)}'

# ILP request an alternative machine dictionary
INHERIT += "xlnx-standalone"
PACKAGEQA_EXTRA_MACHDEFFUNCS .= '${@bb.utils.contains("TUNE_FEATURES", "ilp32", " xlnx_ilp32_dict", "", d)}'

# Define all of the multilibs supported by this configuration
MULTILIB_GLOBAL_VARIANTS = "${@extend_variants(d,'MULTILIBS','multilib')}"
MULTILIBS = "multilib:libilp32"

# Base configuration
# CFLAGS:
DEFAULTTUNE = "cortexa72-cortexa53"

# CFLAGS: -mabi=ilp32
DEFAULTTUNE:virtclass-multilib-libilp32 = "cortexa72-cortexa53-ilp32"

AVAILTUNES += "cortexa72-cortexa53-ilp32"
ARMPKGARCH:tune-cortexa72-cortexa53-ilp32 = "${ARMPKGARCH:tune-cortexa72-cortexa53}-ilp32"
TUNE_FEATURES:tune-cortexa72-cortexa53-ilp32 = "${TUNE_FEATURES:tune-cortexa72-cortexa53} ilp32"
PACKAGE_EXTRA_ARCHS:tune-cortexa72-cortexa53-ilp32 = "${PACKAGE_EXTRA_ARCHS:tune-cortexa72-cortexa53} cortexa72-cortexa53-ilp32"
BASE_LIB:tune-cortexa72-cortexa53-ilp32 = "lib/ilp32"
```

## meta-xilinx-standalone/conf/machine/cortexa53.conf
```bitbake
DEFAULTTUNE ?= "cortexa53"

require conf/machine/include/arm/arch-armv8.inc

TUNEVALID[cortexa53] = "Enable Cortex-a53 specific processor optimizations"
TUNE_CCARGS .= "${@bb.utils.contains('TUNE_FEATURES', 'cortexa53', ' -mcpu=cortex-a53', '', d)}"

AVAILTUNES += "cortexa53"

ARMPKGARCH_tune-cortexa53 = "cortexa53"

TUNE_FEATURES_tune-cortexa53 = "${TUNE_FEATURES_tune-aarch64} cortexa53"
PACKAGE_EXTRA_ARCHS_tune-cortexa53 = "${PACKAGE_EXTRA_ARCHS_tune-aarch64}"

#LANGUAGES_append = ",lto"

GCC_CONFIGURE_A53 ?= " \
        --disable-bootstrap \
        --disable-multiarch \
        --disable-threads \
        --enable-c99 \
        --enable-checking=yes \
        --enable-fix-cortex-a53-835769 \
        --enable-fix-cortex-a53-843419 \
        --enable-linker-build-id \
        --enable-long-long \
        --enable-lto \
        --enable-plugins \
        --enable-shared \
        --with-arch=armv8-a \
        --with-cloog=no \
        --with-gnu-as \
        --with-gnu-ld \
        --with-isl=no \
        --with-ppl=no \
"

EXTRA_OECONF_pn-gcc-cross-${TARGET_ARCH}_append_xilinx-standalone = " \
        ${GCC_CONFIGURE_A53} \
"

BINUTILS_CONFIGURE_A53 ?= " \
	--disable-gprof \
	--disable-libdecnumber \
	--disable-readline \
	--disable-shared \
	--enable-lto \
	--enable-static \
"

EXTRA_OECONF_pn-binutils-cross-${TARGET_ARCH}_append_xilinx-standalone = " \
        ${BINUTILS_CONFIGURE_A53} \
"
```
