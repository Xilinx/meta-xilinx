## meta-xilinx-core/conf/machine/zynqmp-qemu.conf
```bitbake
#@TYPE: Machine
#@NAME: QEMU zynqmp
#@DESCRIPTION: zynqmp qemu device

#### Preamble
MACHINEOVERRIDES =. "${@['', 'zynqmp-qemu:']['zynqmp-qemu' != '${MACHINE}']}"
#### Regular settings follow

require conf/machine/zynqmp-generic.conf
require conf/machine/include/machine-xilinx-qemu.inc

# Qemu Xilinx Native when targeting ZynqMP generic requries the pmu rom
DEPENDS:append:pn-qemu-xilinx-native = " pmu-rom-native"

# Default SD image build onfiguration, use qemu-sd to pad
IMAGE_CLASSES += "image-types-xilinx-qemu"
IMAGE_FSTYPES += "wic.qemu-sd"
WKS_FILES ?= "sdimage-bootpart.wks"

# We need a generic one that works with QEMU...
HDF_MACHINE = "zcu102-zynqmp"

EXTRA_IMAGEDEPENDS += " \
		qemu-devicetrees \
		"

# This machine has a QEMU model, runqemu setup:
QB_MEM = "-m 4096"
QB_OPT_APPEND ?= "-nographic -serial mon:stdio -serial null"
QB_NETWORK_DEVICE = "-net nic -net nic -net nic -net nic,netdev=net0,macaddr=@MAC@"

# Replicate BootROM like behaviour, having loaded SPL and PMU(ROM+FW)
QB_OPT_APPEND:append:qemuboot-xilinx = " \
		-hw-dtb ${DEPLOY_DIR_IMAGE}/qemu-hw-devicetrees/multiarch/zcu102-arm.dtb \
		${@qemu_zynqmp_unhalt(d, True)} \
		-device loader,file=${DEPLOY_DIR_IMAGE}/arm-trusted-firmware.elf,cpu-num=0 \
		-device loader,file=${DEPLOY_DIR_IMAGE}/u-boot.elf \
		-device loader,file=${DEPLOY_DIR_IMAGE}/system.dtb,addr=0x100000 \
		"

# Attach the rootfs disk image to the second SD interface of QEMU (which is SD0)
QB_DEFAULT_FSTYPE:qemuboot-xilinx = "wic.qemu-sd"
QB_OPT_APPEND:append:qemuboot-xilinx = " -boot mode=5"
QB_ROOTFS_OPT:qemuboot-xilinx = " -drive if=sd,index=1,file=@ROOTFS@,format=raw"

QB_PMU_OPT = " \
		-M microblaze-fdt \
		-display none \
		-hw-dtb ${DEPLOY_DIR_IMAGE}/qemu-hw-devicetrees/multiarch/zynqmp-pmu.dtb \
		-kernel ${PMU_ROM} \
		-device loader,file=${PMU_FIRMWARE_DEPLOY_DIR}/${PMU_FIRMWARE_IMAGE_NAME}.elf \
		-device loader,addr=0xfd1a0074,data=0x1011003,data-len=4 \
		-device loader,addr=0xfd1a007C,data=0x1010f03,data-len=4 \
		"
QB_OPT_APPEND:append:qemuboot-xilinx = " -pmu-args '${QB_PMU_OPT}'"

do_write_qemuboot_conf[depends] += "u-boot-zynq-uenv:do_deploy"

#### No additional settings should be after the Postamble
#### Postamble
PACKAGE_EXTRA_ARCHS:append = "${@['', ' zynqmp_qemu']['zynqmp-qemu' != "${MACHINE}"]}"
```

## meta-xilinx-core/files/wic/xilinx-default-sd.wks
```
# Description: Creates a partitioned SD card image. Boot files
# are located in the first vfat partition. Rootfs will be in second ext4 partition.

# This wks uses a fixed-size /boot parition.  512MiB was selected as it should be large enough
# for most reference systems and their included bitstreams, while allowing additional space
# for user data or on-target upgrades.  To adjust the size of the /boot parition change the
# value of --fixed-size below.  See the Yocto Project WIC documentation for more information.
part  /boot  --source rootfs --change-directory=boot  --fixed-size=512M  --fstype=vfat  --use-label  --label boot  --active  --align 4
part  /      --source rootfs --exclude-path=boot/                        --fstype=ext4  --use-label  --label root            --align 4
```

## meta-xilinx-core/wic/xilinx-default-sd-efi.wks
```
# Description: Creates a partitioned SD card image. Boot files
# are located in the first vfat partition. Rootfs will be in second ext4 partition.

# This wks uses a fixed-size /boot parition.  512MiB was selected as it should be large enough
# for most reference systems and their included bitstreams, while allowing additional space
# for user data or on-target upgrades.  To adjust the size of the /boot parition change the
# value of --fixed-size below.  See the Yocto Project WIC documentation for more information.
part  /efi   --source bootimg-efi --sourceparams="loader=${EFI_PROVIDER}" --fixed-size=1G  --align 16 --fstype=vfat  --use-label  --label esp  --active  --mbr  --use-uuid   --part-name="ESP"
part  /      --source rootfs  --fstype=ext4  --use-label  --label root            --align 4 --use-uuid

bootloader --ptable gpt-hybrid --timeout=5 --append="rootfstype=ext4 ip=dhcp"
```

## meta-xilinx-core/wic/xilinx-empty-sd.wks
```
# Description: Creates a partitioned SD card image. Boot files
# are located in the first vfat partition.

part  --source bootimg-partition  --fstype=vfat  --use-label  --label boot  --active  --align 4

bootloader --ptable msdos
```

## meta-xilinx-demos/conf/layer.conf
```bitbake
# We have a conf and classes directory, add to BBPATH
BBPATH .= ":${LAYERDIR}"

# We have a packages directory, add to BBFILES
BBFILES += "${LAYERDIR}/recipes-*/*/*.bb"
BBFILES += "${LAYERDIR}/recipes-*/*/*.bbappend"

BBFILE_COLLECTIONS += "xilinx-demos"
BBFILE_PATTERN_xilinx-demos = "^${LAYERDIR}/"
BBFILE_PRIORITY_xilinx-demos = "13"

LAYERSUMMARY_xilinx-demos = "AMD Xilinx demo and reference application \
recipes"
LAYERDESCRIPTION_xilinx-demos = "Recipe layer with demo and reference \
applications used to showcase AMD Xilinx hardware features in the \
meta-xilinx reference images."

LAYERDEPENDS_xilinx-demos = "core"
LAYERRECOMMENDS_xilinx-demos = "\
    openembedded-layer \
    jupyter-layer \
    openamp-layer \
    ros-common-layer \
    ros2-layer \
    ros2-jazzy-layer \
    qt5-layer \
    amd-adaptive-socs-bsp \
    "

LAYERSERIES_COMPAT_xilinx-demos = "scarthgap"

# Define dynamic layers
BBFILES_DYNAMIC += " \
    jupyter-layer:${LAYERDIR}/dynamic-layers/meta-jupyter/recipes-*/*/*.bb \
    jupyter-layer:${LAYERDIR}/dynamic-layers/meta-jupyter/recipes-*/*/*.bbappend \
    openamp-layer:${LAYERDIR}/dynamic-layers/meta-openamp/recipes-*/*/*.bb \
    openamp-layer:${LAYERDIR}/dynamic-layers/meta-openamp/recipes-*/*/*.bbappend \
    ros-common-layer:${LAYERDIR}/dynamic-layers/meta-ros/meta-ros-common/recipes-*/*/*.bb \
    ros-common-layer:${LAYERDIR}/dynamic-layers/meta-ros/meta-ros-common/recipes-*/*/*.bbappend \
    ros2-jazzy-layer:${LAYERDIR}/dynamic-layers/meta-ros/meta-ros2-jazzy/recipes-*/*/*.bb \
    ros2-jazzy-layer:${LAYERDIR}/dynamic-layers/meta-ros/meta-ros2-jazzy/recipes-*/*/*.bbappend \
    qt5-layer:${LAYERDIR}/dynamic-layers/meta-qt5/recipes-*/*/*.bb \
    qt5-layer:${LAYERDIR}/dynamic-layers/meta-qt5/recipes-*/*/*.bbappend \
    "
```

## meta-xilinx-gpu-malig78ae/conf/distro/include/meta-xilinx-gpu-malig78ae-default-versions.inc
```bitbake
# libmali is selected by DISTRO_FEATURE of libmali & MACHINE_FEATURES of mali400
# lima is selected by DISTRO_FEATURE != libmali & MACHINE_FEATURES of mali400
# default mesa because otherwise
def xlnx_is_libmalig78ae_enabled(d):
    if bb.utils.contains('MACHINE_FEATURES', 'malig78ae', '1', '', d) == '1':
        if bb.utils.contains('DISTRO_FEATURES', 'libmali', '1', '', d) == '1':
            return True
    return False

# libmali requires certain preferred providers to be selected 
PREFERRED_PROVIDER_virtual/egl = "${@'libmali-xlnx' if xlnx_is_libmalig78ae_enabled(d) else 'mesa'}"
PREFERRED_PROVIDER_virtual/libgl = "${@'mesa-gl' if xlnx_is_libmalig78ae_enabled(d) else 'mesa'}"
PREFERRED_PROVIDER_virtual/libgles1 = "${@'libmali-xlnx' if xlnx_is_libmalig78ae_enabled(d) else 'mesa'}"
PREFERRED_PROVIDER_virtual/libgles2 = "${@'libmali-xlnx' if xlnx_is_libmalig78ae_enabled(d) else 'mesa'}"
PREFERRED_PROVIDER_virtual/libgles3 = "${@'libmali-xlnx' if xlnx_is_libmalig78ae_enabled(d) else 'mesa'}"
PREFERRED_PROVIDER_virtual/libgbm = "${@'libmali-xlnx' if xlnx_is_libmalig78ae_enabled(d) else 'mesa'}"
PREFERRED_PROVIDER_virtual/mesa = "${@'mesa-gl' if xlnx_is_libmalig78ae_enabled(d) else 'mesa'}"
PREFERRED_PROVIDER_virtual/opencl-icd = "${@'libmali-xlnx' if xlnx_is_libmalig78ae_enabled(d) else 'opencl-icd-loader'}"
PREFERRED_RPROVIDER_virtual-opencl-icd = "${@'libmali-xlnx' if xlnx_is_libmalig78ae_enabled(d) else 'opencl-icd-loader'}"
```

## meta-xilinx-gpu-malig78ae/conf/layer.conf
```bitbake
# We have a conf and classes directory, add to BBPATH
BBPATH .= ":${LAYERDIR}"

# We have a packages directory, add to BBFILES
BBFILES += " \
    ${LAYERDIR}/recipes-*/*/*.bb \
    ${LAYERDIR}/recipes-*/*/*.bbappend \
    "

BBFILE_COLLECTIONS += "xilinx-gpu-malig78ae"
BBFILE_PATTERN_xilinx-gpu-malig78ae = "^${LAYERDIR}/"
BBFILE_PRIORITY_xilinx-gpu-malig78ae = "5"

# We use the mali400 layer to fill in some libmali-xlnx dependencies
LAYERDEPENDS_xilinx-gpu-malig78ae = " \
    core \
    xilinx \
    xilinx-mali400 \
    "

LAYERSERIES_COMPAT_xilinx-gpu-malig78ae = "scarthgap"

INHERIT += "sanity-meta-xilinx-gpu-malig78ae"

META_XILINX_MALIG78AE_CONFIG_PATH = "${LAYERDIR}/conf/distro/include/meta-xilinx-gpu-malig78ae-default-versions.inc"

USER_CLASSES:append = " meta-xilinx-gpu-malig78ae-cfg"
```

## meta-xilinx-imgrcvry/conf/distro/xilinx-image-recovery.conf
```bitbake
# AMD Xilinx Image Recovery distribution.
# Builds the small recovery rootfs / image used by the field-update
# and golden-image flows on supported AMD Xilinx boards.  Not a
# general-purpose Linux distribution.

require conf/distro/amd-edf-small.conf

DISTRO = "xilinx-image-recovery"
DISTRO_NAME = "AMD Xilinx Image Recovery distribution"

DISTRO_VERSION = "1.1"

DISTROOVERRIDES .= ":imgrcvry"

SDK_VENDOR = "-imgrcvrysdk"

MAINTAINER = "AMD AECG <meta-xilinx@yoctoproject.org>"

TARGET_VENDOR = "-imgrcvry"

PREFERRED_PROVIDER_virtual/bootloader = "u-boot-xlnx-imgrcvry"

MACHINE_FEATURES:remove = "optee"
```

## meta-xilinx-imgrcvry/conf/layer.conf
```bitbake
# We have a conf and classes directory, add to BBPATH
BBPATH .= ":${LAYERDIR}"

# We have recipes-* directories, add to BBFILES
BBFILES += "${LAYERDIR}/recipes-*/*/*.bb \
            ${LAYERDIR}/recipes-*/*/*.bbappend"

BBFILE_COLLECTIONS += "meta-xilinx-imgrcry"
BBFILE_PATTERN_meta-xilinx-imgrcry = "^${LAYERDIR}/"
BBFILE_PRIORITY_meta-xilinx-imgrcry = "10"

LAYERSUMMARY_meta-xilinx-imgrcry = "AMD Xilinx image recovery distro \
and tooling"
LAYERDESCRIPTION_meta-xilinx-imgrcry = "Distribution layer providing \
the xilinx-image-recovery distro and the supporting recovery image \
recipes used during AMD Xilinx field-update / golden-image flows."

LAYERDEPENDS_meta-xilinx-imgrcry = " \
	core \
    	xilinx \
	xilinx-standalone \
	xilinx-standalone-sdt \
	"

LAYERRECOMMENDS_meta-xilinx-imgrcry = " \
	amd-adaptive-socs-core \
	amd-adaptive-socs-bsp \
	"

LAYERSERIES_COMPAT_meta-xilinx-imgrcry = "scarthgap"
```

## meta-xilinx-imgrcvry/recipes-bsp/u-boot/u-boot-xlnx-imgrcvry/imgrcvry_versal_2ve_2vm_defconfig
```kconfig
CONFIG_ARM=y
CONFIG_COUNTER_FREQUENCY=100000000
CONFIG_POSITION_INDEPENDENT=y
CONFIG_SYS_INIT_SP_BSS_OFFSET=0x200000
# CONFIG_ARM64_SUPPORT_AARCH32 is not set
CONFIG_ARCH_VERSAL2=y
CONFIG_TEXT_BASE=0x40000000
CONFIG_SYS_MALLOC_LEN=0x4000000
CONFIG_SYS_MALLOC_F_LEN=0x180000
CONFIG_NR_DRAM_BANKS=36
CONFIG_DEFAULT_DEVICE_TREE="amd-versal2-virt"
CONFIG_OF_LIBFDT_OVERLAY=y
CONFIG_DM_RESET=y
CONFIG_SYS_BOOTM_LEN=0x6400000
CONFIG_SYS_LOAD_ADDR=0x8000000
CONFIG_XILINX_OF_BOARD_DTB_ADDR=0x1000000
CONFIG_ENV_VARS_UBOOT_CONFIG=y
CONFIG_REMAKE_ELF=y
# CONFIG_EFI_LOADER is not set
CONFIG_FIT=y
CONFIG_FIT_VERBOSE=y
# CONFIG_BOOTSTD is not set
CONFIG_LEGACY_IMAGE_FORMAT=y
CONFIG_SUPPORT_RAW_INITRD=y
CONFIG_BOOTDELAY=5
# CONFIG_ARCH_FIXUP_FDT_MEMORY is not set
CONFIG_USE_BOOTCOMMAND=y
CONFIG_BOOTCOMMAND="run distro_bootcmd"
CONFIG_USE_PREBOOT=y
CONFIG_SYS_PBSIZE=2073
# CONFIG_DISPLAY_CPUINFO is not set
# CONFIG_DISPLAY_BOARDINFO is not set
CONFIG_BOARD_EARLY_INIT_R=y
CONFIG_CLOCKS=y
CONFIG_LAST_STAGE_INIT=y
CONFIG_HUSH_PARSER=y
CONFIG_SYS_PROMPT="versal2> "
# CONFIG_SYS_XTRACE is not set
# CONFIG_CMD_CONSOLE is not set
# CONFIG_CMD_BOOTD is not set
CONFIG_CMD_BOOTM=y
# CONFIG_CMD_ELF is not set
# CONFIG_CMD_GO is not set
# CONFIG_CMD_IMI is not set
# CONFIG_CMD_XIMG is not set
# CONFIG_CMD_EXPORTENV is not set
# CONFIG_CMD_IMPORTENV is not set
# CONFIG_CMD_SAVEENV is not set
# CONFIG_CMD_CRC32 is not set
# CONFIG_CMD_LZMADEC is not set
# CONFIG_CMD_UNLZ4 is not set
# CONFIG_CMD_UNZIP is not set
# CONFIG_CMD_FPGA is not set
# CONFIG_CMD_LOADB is not set
# CONFIG_CMD_LOADS is not set
# CONFIG_CMD_VIRTIO is not set
# CONFIG_CMD_ITEST is not set
# CONFIG_CMD_SOURCE is not set
# CONFIG_CMD_SETEXPR is not set
# CONFIG_CMD_SLEEP is not set
CONFIG_CMD_SYSBOOT=y
CONFIG_OF_BOARD=y
# CONFIG_OF_TAG_MIGRATE is not set
CONFIG_NO_NET=y
# CONFIG_DM_DEVICE_REMOVE is not set
# CONFIG_BLOCK_CACHE is not set
CONFIG_CLK_CCF=y
CONFIG_CLK_VERSAL=y
CONFIG_FPGA_XILINX=y
CONFIG_FPGA_VERSALPL=y
# CONFIG_GPIO is not set
# CONFIG_I2C is not set
# CONFIG_INPUT is not set
CONFIG_DM_MAILBOX=y
CONFIG_ZYNQMP_IPI=y
CONFIG_MISC=y
# CONFIG_MMC is not set
# CONFIG_POWER is not set
CONFIG_RESET_ZYNQMP=y
# CONFIG_DM_RNG is not set
CONFIG_PL01X_SERIAL=y
CONFIG_SOC_DEVICE=y
CONFIG_SOC_AMD_VERSAL2=y
CONFIG_SYSRESET=y
CONFIG_SYSRESET_PSCI=y
CONFIG_VIRTIO_MMIO=y
CONFIG_VIRTIO_BLK=y
CONFIG_TPM=y
CONFIG_SHA384=y
CONFIG_LZMA=y
CONFIG_ZLIB_UNCOMPRESS=y
# CONFIG_TOOLS_LIBCRYPTO is not set
# CONFIG_TOOLS_KWBIMAGE is not set
CONFIG_ENV_IS_NOWHERE=y
# CONFIG_ENV_IS_IN_SPI_FLASH is not set
```
