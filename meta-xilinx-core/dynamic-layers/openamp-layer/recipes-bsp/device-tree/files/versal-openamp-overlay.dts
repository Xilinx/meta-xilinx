/*
 * SPDX-License-Identifier: MIT
 *
 * dts overlay file for Versal OpenAMP
 *
 * Copyright (C) 2022, Advanced Micro Devices, Inc.  All rights reserved.
 *
 */

/dts-v1/;
/plugin/;

#include "versal-openamp.dtsi"
