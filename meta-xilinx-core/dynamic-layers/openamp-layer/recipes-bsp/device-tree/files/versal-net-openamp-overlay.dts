/*
 * SPDX-License-Identifier: MIT
 *
 * dts overlay file for Versal NET OpenAMP
 *
 * Copyright (C) 2023, Advanced Micro Devices, Inc.  All rights reserved.
 *
 */

/dts-v1/;
/plugin/;

#include "versal-net-openamp.dtsi"
