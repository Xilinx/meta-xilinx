## meta-xilinx-standalone/conf/machine/cortexa72.conf
```bitbake
DEFAULTTUNE ?= "cortexa72"

require conf/machine/include/arm/arch-armv8.inc

TUNEVALID[cortexa72] = "Enable Cortex-A72 specific processor optimizations"
TUNE_CCARGS .= "${@bb.utils.contains('TUNE_FEATURES', 'cortexa72', ' -mcpu=cortex-a72', '', d)}"

AVAILTUNES += "cortexa72"

ARMPKGARCH_tune-cortexa72             = "cortexa72"

TUNE_FEATURES_tune-cortexa72          = "${TUNE_FEATURES_tune-aarch64} cortexa72"
PACKAGE_EXTRA_ARCHS_tune-cortexa72    = "${PACKAGE_EXTRA_ARCHS_tune-aarch64}"


#LANGUAGES_append = ",lto"

GCC_CONFIGURE_A72 ?= " \
        --disable-bootstrap \
        --disable-multiarch \
        --disable-threads \
        --enable-c99 \
        --enable-checking=yes \
        --enable-linker-build-id \
        --enable-long-long \
        --enable-lto \
	--enable-multilib \
        --enable-plugins \
        --enable-shared \
	--enable-threads=no \
        --with-cloog=no \
        --with-gnu-as \
        --with-gnu-ld \
        --with-isl=no \
	--with-multilib-list=aprofile \
	--with-ppl=no \
"

EXTRA_OECONF_pn-gcc-cross-${TARGET_ARCH}_append_xilinx-standalone = " \
        ${GCC_CONFIGURE_A72} \
"

BINUTILS_CONFIGURE_A72 ?= " \
	--disable-gprof \
	--disable-libdecnumber \
	--disable-readline \
	--disable-shared \
	--enable-lto \
	--enable-static \
"

EXTRA_OECONF_pn-binutils-cross-${TARGET_ARCH}_append_xilinx-standalone = " \
        ${BINUTILS_CONFIGURE_A72} \
"
```

## meta-xilinx-standalone/conf/machine/cortexr5.conf
```bitbake
DEFAULTTUNE ?= "cortexr5"

require conf/machine/include/arm/arch-arm.inc

TUNEVALID[cortexr5] = "Enable Cortex-r5 specific processor optimizations"
TUNE_CCARGS .= "${@bb.utils.contains('TUNE_FEATURES', 'cortexr5', ' -mcpu=cortex-r5', '', d)}"

AVAILTUNES += "cortexr5"

ARMPKGARCH_tune-cortexr5 = "cortexr5"

TUNE_FEATURES_tune-cortexr5 = "cortexr5"

#PACKAGE_EXTRA_ARCHS_tune-cortexr5 = "cortexr5"


GCC_CONFIGURE_R5 ?= " \
        --disable-decimal-float \
        --disable-libffi \
        --disable-libgomp \
        --disable-libquadmath \
        --disable-libssp \
        --disable-shared \
        --disable-threads \
        --disable-tls \
        --enable-plugins \
        --with-gnu-as \
        --with-gnu-ld \
        --with-headers=yes \
        --with-host-libstdcxx=-static-libgcc \
         --with-multilib-list=rmprofile \
"


EXTRA_OECONF_pn-gcc-cross-${TARGET_ARCH}_xilinx-standalone_append = " \
        ${GCC_CONFIGURE_R5} \
"

BINUTILS_CONFIGURE_R5 ?= " \
	--disable-docs \
	--disable-nls \
	-enable-interwork \
"

EXTRA_OECONF_pn-binutils-cross-${TARGET_ARCH}_xilinx-standalone_append = " \
        ${BINUTILS_CONFIGURE_R5} \
"
```

## meta-xilinx-standalone/conf/machine/microblaze-versal-fw.conf
```bitbake
# Definition for versal PSM and PLM Firmware

DEFAULTTUNE ?= "microblaze"

require conf/machine/versal-generic.conf

AVAILTUNES += "microblaze"
TUNE_FEATURES:tune-microblaze = "microblaze v10.0 barrel-shift pattern-compare fpu-soft"
PACKAGE_EXTRA_ARCHS:tune-microblaze = "${TUNE_PKGARCH}"

LINKER_HASH_STYLE:microblaze = ""
```

## meta-xilinx-standalone/conf/machine/microblaze-zynqmp-pmu.conf
```bitbake
# Definition for ZynqMP PMU Firmware

DEFAULTTUNE ?= "microblaze"

# Based on zynqmp-generic
require conf/machine/zynqmp-generic.conf

# Endianess, multiplier, barrel shift, pattern compare, floating point double or single, are the possibilities
AVAILTUNES += "microblaze"
TUNE_FEATURES_tune-microblaze = "microblaze v9.2 barrel-shift pattern-compare"
PACKAGE_EXTRA_ARCHS_tune-microblaze = "${TUNE_PKGARCH}"

LINKER_HASH_STYLE_microblaze = ""
```

## meta-xilinx-standalone/conf/machine/zynqmp-pmu.conf
```bitbake
DEFAULTTUNE ?= "microblaze"

require conf/machine/include/microblaze/arch-microblaze.inc

# Endianess, multiplier, barrel shift, pattern compare, floating point double or single, are the possibilities
AVAILTUNES += "microblaze"
TUNE_FEATURES_tune-microblaze = "microblaze v10.0 barrel-shift pattern-compare"
PACKAGE_EXTRA_ARCHS_tune-microblaze = "${TUNE_PKGARCH}"
SOC_FAMILY = "zynqmp"

TARGET_LINK_HASH_STYLE_microblaze = ""

GCC_CONFIGURE_MB ?= " \
        --disable-__cxa_atexit \
        --disable-libgomp \
        --disable-shared \
        --enable-lto \
        --enable-target-optspace \
        --enable-threads=no \
        --with-isl=no \
        --with-ppl=no \
        --without-long-double-128 \
	--disable-multilib \
"

EXTRA_OECONF_pn-gcc-cross-${TARGET_ARCH}_xilinx-standalone_append = " \
	${GCC_CONFIGURE_MB} \
"

EXTRA_OECONF_pn-gcc-cross-canadian-${TARGET_ARCH}_xilinx-standalone_append = " \
	${GCC_CONFIGURE_MB} \
"

BINUTILS_CONFIGURE_MB ?= " \
	--disable-initfini-array \
	--disable-nls \
	--enable-gold=no \
	--enable-ld=yes \
	--enable-multilib \
"

EXTRA_OECONF_pn-binutils-cross-${TARGET_ARCH}_xilinx-standalone_append = " \
	${BINUTILS_CONFIGURE_MB} \
"
```

## meta-xilinx-vendor/conf/layer.conf
```bitbake
# We have a conf and classes directory, add to BBPATH
BBPATH .= ":${LAYERDIR}"

# We have a packages directory, add to BBFILES
BBFILES += "${LAYERDIR}/recipes-*/*/*.bb \
            ${LAYERDIR}/recipes-*/*/*.bbappend"

BBFILES_DYNAMIC += " \
xilinx-tools:${LAYERDIR}/dynamic-layers/meta-xilinx-tools/recipes-*/*/*.bb \
xilinx-tools:${LAYERDIR}/dynamic-layers/meta-xilinx-tools/recipes-*/*/*.bbappend \
"

BBFILE_COLLECTIONS += "xilinx-vendor"
BBFILE_PATTERN_xilinx-vendor = "^${LAYERDIR}/"
BBFILE_PRIORITY_xilinx-vendor = "5"

LAYERSUMMARY_xilinx-vendor = "AMD Xilinx vendor BSPs (Avnet, Digilent, \
etc.)"
LAYERDESCRIPTION_xilinx-vendor = "Vendor BSP layer carrying \
third-party Zynq-7000 / Zynq UltraScale+ board configurations from \
Avnet, Digilent, and other AMD partners (MicroZed, MiniZed, PicoZed, \
ZedBoard, Zybo, etc.)."

LAYERDEPENDS_xilinx-vendor = "xilinx"
LAYERSERIES_COMPAT_xilinx-vendor = "scarthgap"
```

## meta-xilinx-vendor/conf/machine/microzed-zynq7.conf
```bitbake
#@TYPE: Machine
#@NAME: microzed-zynq7
#@DESCRIPTION: Machine configuration for the Avnet MicroZed system-on-module (Xilinx Zynq-7000, dual-core Cortex-A9). See https://www.avnet.com/wps/portal/us/products/avnet-boards/avnet-board-families/microzed/.

require conf/machine/zynq-generic.conf

SPL_BINARY ?= "spl/boot.bin"
UBOOT_ELF = "u-boot"

EXTRA_IMAGEDEPENDS += " \
		u-boot-xlnx-uenv \
		"

KERNEL_DEVICETREE = "zynq-microzed.dtb"

IMAGE_BOOT_FILES += " \
		boot.bin \
		uEnv.txt \
		"
```

## meta-xilinx-vendor/conf/machine/minized-zynq7.conf
```bitbake
#@TYPE: Machine
#@NAME: minized-zynq7
#@DESCRIPTION: Machine configuration for the Avnet MiniZed development board (Xilinx Zynq-7000 single-core Cortex-A9). See https://www.avnet.com/wps/portal/us/products/avnet-boards/avnet-board-families/minized/.

require conf/machine/zynq-generic.conf

MACHINE_FEATURES = "ext2 vfat usbhost wifi bluetooth"

UBOOT_MACHINE ?= "zynq_minized_config"

EXTRA_IMAGEDEPENDS += " \
		u-boot-xlnx-uenv \
		"

SERIAL_CONSOLES ?= "115200;ttyPS0"

MACHINE_ESSENTIAL_EXTRA_RDEPENDS += "device-tree"

MACHINE_ESSENTIAL_EXTRA_RRECOMMENDS += "linux-firmware-bcm43430"

IMAGE_BOOT_FILES += " \
		uEnv.txt \
		"
```

## meta-xilinx-vendor/conf/machine/picozed-zynq7.conf
```bitbake
#@TYPE: Machine
#@NAME: picozed-zynq7
#@DESCRIPTION: Machine configuration for the Avnet PicoZed system-on-module (Xilinx Zynq-7000, dual-core Cortex-A9). See https://www.avnet.com/wps/portal/us/products/avnet-boards/avnet-board-families/picozed/.
#
# Note: This machine configuration is intended as a generic config for
# the picozed SOM. It also covers the multiple SKUs for the picoZed
# including 7010, 7020, 7015 and 7030.

require conf/machine/zynq-generic.conf

SPL_BINARY ?= "spl/boot.bin"
UBOOT_ELF = "u-boot"

EXTRA_IMAGEDEPENDS += " \
		u-boot-xlnx-uenv \
		"

IMAGE_BOOT_FILES += " \
		boot.bin \
		uEnv.txt \
		"
```

## meta-xilinx-vendor/conf/machine/ultra96-zynqmp.conf
```bitbake
# This machine has been removed.  Temporarily enable it to work around various build expectations.

require conf/machine/zynqmp-eg-generic.conf
```

## meta-xilinx-vendor/conf/machine/zedboard-zynq7.conf
```bitbake
#@TYPE: Machine
#@NAME: zedboard-zynq7
#@DESCRIPTION: Machine configuration for the Avnet/Digilent ZedBoard development board (Xilinx Zynq-7000 XC7Z020, dual-core Cortex-A9). See https://www.avnet.com/wps/portal/us/products/avnet-boards/avnet-board-families/zedboard/.
#
# For details on the Evaluation board:
#     http://www.zedboard.org/content/overview
# For design files (including 'zynq_fsbl_0.elf') for the ZedBoard:
#     http://www.zedboard.org/reference-designs-categories/zynq-concepts-tools-and-techniques-zedboard
#

require conf/machine/zynq-generic.conf

SPL_BINARY ?= "spl/boot.bin"

KERNEL_DEVICETREE = "zynq-zed.dtb"

IMAGE_BOOT_FILES += " \
		boot.bin \
		uEnv.txt \
		boot.scr \
		"
```

## meta-xilinx-vendor/conf/machine/zybo-linux-bd-zynq7.conf
```bitbake
#@TYPE: Machine
#@NAME: zybo-linux-bd-zynq7
#@DESCRIPTION: Machine configuration for the Digilent Zybo board (Xilinx Zynq-7000, dual-core Cortex-A9) using the upstream zybo-linux-bd Linux/U-Boot board-design integration project.
#
# generated base on ZYBO linux-bd project
#

require conf/machine/zynq-generic.conf

MACHINE_FEATURES += "keyboard screen alsa sdio"

SPL_BINARY ?= "spl/boot.bin"
FORCE_PLATFORM_INIT = "1"
UBOOT_ELF = "u-boot"

IMAGE_BOOT_FILES += " \
		boot.bin \
		bitstream \
		uEnv.txt \
		"

KERNEL_FEATURES += " \
		features/xilinx/v4l2/v4l2.scc \
		"
```

## meta-xilinx-vendor/conf/machine/zybo-zynq7.conf
```bitbake
#@TYPE: Machine
#@NAME: zybo-zynq7
#@DESCRIPTION: Machine configuration for the Digilent Zybo board (Xilinx Zynq-7000 XC7Z010, dual-core Cortex-A9). See https://digilent.com/reference/programmable-logic/zybo/start.
#
# For details on the ZYBO board:
#     https://www.digilentinc.com/Products/Detail.cfm?Prod=ZYBO
#

require conf/machine/zynq-generic.conf

SPL_BINARY ?= "spl/boot.bin"
UBOOT_ELF = "u-boot"

EXTRA_IMAGEDEPENDS += " \
		u-boot-xlnx-uenv \
		"

KERNEL_DEVICETREE = "zynq-zybo.dtb"

IMAGE_BOOT_FILES += " \
		boot.bin \
		uEnv.txt \
		"
```

## meta-xilinx-virtualization/conf/layer.conf
```bitbake
# We have a conf and classes directory, add to BBPATH
BBPATH .= ":${LAYERDIR}"

# We have packages directories, add to BBFILES
BBFILES += "${LAYERDIR}/recipes-*/*/*.bb \
            ${LAYERDIR}/recipes-*/*/*.bbappend"

BBFILE_COLLECTIONS += "xilinx-virtualization"
BBFILE_PATTERN_xilinx-virtualization = "^${LAYERDIR}/"
BBFILE_PRIORITY_xilinx-virtualization = "5"

LAYERDEPENDS_xilinx-virtualization = "\
    xilinx \
    virtualization-layer \
    security \
    tpm-layer \
    "

LAYERSERIES_COMPAT_xilinx-virtualization = "scarthgap"

XILINX_XEN_VERSION[v2024.1] = "4.18+stable-xilinx+git%"
XILINX_XEN_VERSION[v2024.2] = "4.18+stable-xilinx+git%"
PREFERRED_VERSION_xen ?= "${@d.getVarFlag('XILINX_XEN_VERSION', d.getVar('XILINX_RELEASE_VERSION')) or '4.18+stable-xilinx+git%'}"
PREFERRED_VERSION_xen-tools ?= "${@d.getVarFlag('XILINX_XEN_VERSION', d.getVar('XILINX_RELEASE_VERSION')) or '4.18+stable-xilinx+git%'}"
```

## meta-zc702/conf/layer.conf
```bitbake
# We have a conf and classes directory, add to BBPATH
BBPATH := "${BBPATH}:${LAYERDIR}"

# We have a packages directory, add to BBFILES
BBFILES := "${BBFILES} ${LAYERDIR}/recipes-*/*/*.bb"
BBFILES += " ${LAYERDIR}/recipes-*/*/*.bbappend"

BBFILE_COLLECTIONS += "zc702"
BBFILE_PATTERN_zc702 := "^${LAYERDIR}/"
BBFILE_PRIORITY_zc702 = "8"
```

## meta-zc702/conf/machine/zc702.conf
```bitbake
#@TYPE: Machine
#@NAME: zc702 
#@DESCRIPTION: Machine support for zc702.
#               

PREFERRED_VERSION_linux-xlnx ?= "3.6%"
PREFERRED_VERSION_u-boot-xlnx ?= "v2012.10%"

require conf/machine/include/tune-zynq.inc

# ZC70x machine definition known by Xilinx UBOOT
UBOOT_MACHINE = "zynq_zc70x_config"

SERIAL_CONSOLE = "115200 ttyPS0"
```

## meta-zedboard/conf/layer.conf
```bitbake
# We have a conf and classes directory, add to BBPATH
BBPATH := "${BBPATH}:${LAYERDIR}"

# We have a packages directory, add to BBFILES
BBFILES := "${BBFILES} ${LAYERDIR}/recipes-*/*/*.bb"
BBFILES += " ${LAYERDIR}/recipes-*/*/*.bbappend"

BBFILE_COLLECTIONS += "zedboard"
BBFILE_PATTERN_zedboard := "^${LAYERDIR}/"
BBFILE_PRIORITY_zedboard = "8"
```

## meta-zedboard/conf/machine/zedboard.conf
```bitbake
#@TYPE: Machine
#@NAME: zedboard 
#@DESCRIPTION: Machine support for zedboard.
#              http://www.zedboard.org/ 

# Versions corresponding to zedboard documentation
PREFERRED_VERSION_linux-xlnx ?= "3.8%"
PREFERRED_VERSION_u-boot-xlnx ?= "v2013.01%"

require conf/machine/include/tune-zynq.inc

# Zedboard machine definition known by Xilinx UBOOT
UBOOT_MACHINE = "zynq_zed_config"

SERIAL_CONSOLE = "115200 ttyPS0"
```
