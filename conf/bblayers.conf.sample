## conf/bblayers.conf.sample
```bitbake
# LAYER_CONF_VERSION is increased each time build/conf/bblayers.conf
# changes incompatibly
LCONF_VERSION = "6"

BBPATH = "${TOPDIR}"
BBFILES ?= ""

BBLAYERS ?= " \
  ##OEROOT##/meta \
  ##OEROOT##/meta-xilinx \
  ##OEROOT##/meta-openembedded/meta-oe \
  "

BBLAYERS_NON_REMOVABLE ?= " \
  ##OEROOT##/meta \
  ##OEROOT##/meta-xilinx \
  "
```

## conf/distro/include/tcmode-external-xilinx.inc
```bitbake
#
# Configuration to use external Xilinx toolchain
#

TOOLCHAIN_PATH_ADD = "${EXTERNAL_TOOLCHAIN}/bin:"
PATH =. "${TOOLCHAIN_PATH_ADD}"

XILINX_TARGET_SYS_aarch64 ?= "aarch64-linux-gnu"
XILINX_TARGET_SYS_armv7a ?= "arm-linux-gnueabihf"
XILINX_TARGET_SYS_microblazeel ?= "microblazeel-xilinx-linux-gnu"
XILINX_TARGET_SYS = "${TARGET_SYS}"

TARGET_PREFIX = "${XILINX_TARGET_SYS}-"

PREFERRED_PROVIDER_linux-libc-headers = "linux-libc-headers-xilinx"
PREFERRED_PROVIDER_linux-libc-headers-dev = "linux-libc-headers-xilinx"
PREFERRED_PROVIDER_virtual/linux-libc-headers = "linux-libc-headers-xilinx"
PREFERRED_PROVIDER_libgcc = "libgcc-xilinx"
PREFERRED_PROVIDER_virtual/${TARGET_PREFIX}compilerlibs = "gcc-runtime-xilinx"
PREFERRED_PROVIDER_virtual/${TARGET_PREFIX}binutils = "binutils-cross-xilinx-${TARGET_ARCH}"

PREFERRED_PROVIDER_virtual/${TARGET_PREFIX}gcc = "gcc-cross-xilinx-${TARGET_ARCH}"
PREFERRED_PROVIDER_virtual/${TARGET_PREFIX}gcc-initial = "gcc-cross-xilinx-${TARGET_ARCH}"
PREFERRED_PROVIDER_virtual/${TARGET_PREFIX}gcc-intermediate = "gcc-cross-xilinx-${TARGET_ARCH}"
PREFERRED_PROVIDER_virtual/${TARGET_PREFIX}g++ = "gcc-cross-xilinx-${TARGET_ARCH}"

PREFERRED_PROVIDER_gcc-sanitizers ?= "gcc-sanitizers-xilinx"

PREFERRED_PROVIDER_virtual/${TARGET_PREFIX}libc-for-gcc = "glibc-xilinx"
PREFERRED_PROVIDER_virtual/${TARGET_PREFIX}libc-initial = "glibc-xilinx"
PREFERRED_PROVIDER_glibc = "glibc-xilinx"
PREFERRED_PROVIDER_virtual/libc = "glibc-xilinx"
PREFERRED_PROVIDER_virtual/libintl = "glibc-xilinx"
PREFERRED_PROVIDER_virtual/libiconv = "glibc-xilinx"
PREFERRED_PROVIDER_glibc-thread-db = "glibc-xilinx"

WARN_QA_remove = "ldflags textrel"
ERROR_QA_remove = "ldflags textrel"

# No need to re-compile the locale files
GLIBC_INTERNAL_USE_BINARY_LOCALE = "precompiled"
ENABLE_BINARY_LOCALE_GENERATION = ""

TOOLCHAIN_OPTIONS = " --sysroot=${STAGING_DIR_HOST}"
# Fix up default hash, enforce it in for CC_ARCH for packages that ignore LDFLAGS.
TARGET_CC_ARCH_append = " ${TARGET_LINK_HASH_STYLE}"

# Default sysroot is inside the Xilinx ARM v7-A toolchain in the '<XILINX_TARGET_SYS>/libc' (no debug-root)
EXTERNAL_TOOLCHAIN_SYSROOT_armv7a ??= "${EXTERNAL_TOOLCHAIN}/${XILINX_TARGET_SYS}/libc"
EXTERNAL_TOOLCHAIN_DBGROOT_armv7a ??= ""

# Default sysroot is inside the Xilinx ARM v8-A toolchain in the '<XILINX_TARGET_SYS>/libc' (no debug-root)
EXTERNAL_TOOLCHAIN_SYSROOT_aarch64 ??= "${EXTERNAL_TOOLCHAIN}/${XILINX_TARGET_SYS}/libc"
EXTERNAL_TOOLCHAIN_DBGROOT_aarch64 ??= "${EXTERNAL_TOOLCHAIN}/${XILINX_TARGET_SYS}/debug-root"

# Default sysroot is inside the Xilinx MicroBlaze toolchain in the '<XILINX_TARGET_SYS>/sys-root'
EXTERNAL_TOOLCHAIN_SYSROOT_microblazeel ??= "${EXTERNAL_TOOLCHAIN}/${XILINX_TARGET_SYS}/sys-root"
EXTERNAL_TOOLCHAIN_DBGROOT_microblazeel ??= "${EXTERNAL_TOOLCHAIN}/${XILINX_TARGET_SYS}/debug-root"

addhandler toolchain_setup
toolchain_setup[eventmask] = "bb.event.BuildStarted"
python toolchain_setup () {
    import errno

    d = e.data
    d = d.createCopy()
    d.finalize()

    tarprefix = d.expand('${TARGET_PREFIX}')
    files = []
    if (tarprefix == "arm-linux-gnueabihf-") or (tarprefix == "arm-xilinx-linux-gnueabi-"):
        files.append((tarprefix + "ld", tarprefix + "ld.bfd"))

    if len(files) > 0:
        ext_bindir = d.expand('${EXTERNAL_TOOLCHAIN}/bin')
        loc_bindir = d.getVar('STAGING_BINDIR_TOOLCHAIN', True)
        bb.utils.mkdirhier(loc_bindir)
        for f in files:
            source = os.path.join(ext_bindir, f[0])
            dest = os.path.join(loc_bindir, f[1])
            try:
                os.symlink(source, dest)
            except OSError as exc:
                if exc.errno == errno.EEXIST:
                    break
                bb.fatal("Unable to populate toolchain binary symlink for %s: %s" % (f[0], f[1]))
}

XILINX_VER_MAIN ?= "2000.0"

require conf/distro/include/xilinx-versions.inc

# Setup suitable toolchain flags
require conf/distro/include/as-needed.inc
```

## conf/distro/include/xilinx-versions.inc
```bitbake
def xlnx_run(d, cmd, *args):
	import bb.process
	import subprocess

	topdir = d.getVar('TOPDIR', True)
	toolchain_path = d.getVar('EXTERNAL_TOOLCHAIN', True)
	if not toolchain_path:
		return 'UNKNOWN', 'UNKNOWN'

	target_prefix = d.getVar('TARGET_PREFIX', True)
	path = os.path.join(toolchain_path, 'bin', target_prefix + cmd)
	args = [path] + list(args)

	return bb.process.run(args, cwd=topdir, stderr=subprocess.PIPE)

def xlnx_get_version(d):
	try:
		stdout, stderr = xlnx_run(d, 'gcc', '-v')
	except bb.process.CmdError as exc:
		bb.error('Failed to obtain CodeSourcery toolchain version: %s' % exc)
		bb.error('Make sure that MACHINE is set correctly in your local.conf and the toolchain supports %s.' % d.getVar("TARGET_ARCH", True))
		return 'UNKNOWN'
	else:
		lines = stderr.splitlines()
		for i in reversed(range(len(lines))):
			if len(lines[i]) != 0:
				return lines[i]
		return 'UNKNOWN'

def xlnx_get_gcc_version(d):
	version = xlnx_get_version(d)
	if version != 'UNKNOWN':
		return version.split()[2]
	else:
		return version

def xlnx_get_libc_version(d):
	import fnmatch

	syspath = d.expand('${EXTERNAL_TOOLCHAIN_SYSROOT}')
	if not syspath:
		return 'UNKNOWN'

	libpath = syspath + '/lib/'
	if not os.path.exists(libpath):
		libpath = syspath + '/sgxx-glibc/lib/'

	if os.path.exists(libpath):
		for root,dirs,files in os.walk(libpath):
			for filename in fnmatch.filter(files,'libc-*.so'):
				return filename[5:-3]
	return 'UNKNOWN'

def xlnx_get_kernel_version(d):
	syspath = d.expand('${EXTERNAL_TOOLCHAIN_SYSROOT}')
	if not syspath:
		return 'UNKNOWN'

	vf = syspath + '/usr/include/linux/version.h'
	if not os.path.exists(vf):
		vf = syspath + '/sgxx-glibc/usr/include/linux/version.h'

	try:
		f = open(vf, 'r')
	except (OSError, IOError):
		return 'UNKNOWN'

	l = f.readlines();
	f.close();
	for s in l:
		if s.find('LINUX_VERSION_CODE') > 0:
			ver = int(s.split()[2])
			maj = ver / 65536
			ver = ver % 65536
			min = ver / 256
			ver = ver % 256
			return str(maj)+'.'+str(min)+'.'+str(ver)
	return 'UNKNOWN'

def xlnx_get_gdb_version(d):
	try:
		stdout, stderr = xlnx_run(d, 'gdb', '-v')
	except bb.process.CmdError:
		return 'UNKNOWN'
	else:
		first_line = stdout.splitlines()[0]
		return first_line.split()[-1]

python xilinx_version_handler () {
    d = e.data
    ld = d.createCopy()
    ld.finalize()

    d.setVar('XILINX_VER_GCC', xlnx_get_gcc_version(ld))
    d.setVar('XILINX_VER_LIBC', xlnx_get_libc_version(ld))
    d.setVar('XILINX_VER_KERNEL', xlnx_get_kernel_version(ld))
    d.setVar('XILINX_VER_GDB', xlnx_get_gdb_version(ld))
}
addhandler xilinx_version_handler
xilinx_version_handler[eventmask] = "bb.event.ConfigParsed"

# Ensure that any variable which includes the --sysroot (CC, CXX, etc) also
# depends on the toolchain version
TOOLCHAIN_OPTIONS[vardeps] += "XILINX_VER_MAIN XILINX_VER_GCC"
```

## conf/layer.conf
```bitbake
# We have a conf and classes directory, add to BBPATH
BBPATH := "${BBPATH}:${LAYERDIR}"

# We have a packages directory, add to BBFILES
BBFILES += "${LAYERDIR}/recipes-*/*/*.bb"
BBFILES += " ${LAYERDIR}/recipes-*/*/*.bbappend"

BBFILE_COLLECTIONS += "xilinx"
BBFILE_PATTERN_xilinx := "^${LAYERDIR}/"
BBFILE_PRIORITY_xilinx = "6"
```

## conf/machine/ep108-zynqmp.conf
```bitbake
#@TYPE: Machine
#@NAME: ep108-zynqmp
#@DESCRIPTION: Xilinx EP108 ZynqMP Emulation Platform

require conf/machine/include/tune-zynqmp.inc
require conf/machine/include/machine-xilinx-default.inc
require conf/machine/include/machine-xilinx-board.inc
require conf/machine/include/machine-xilinx-qemu.inc

MACHINE_FEATURES = ""

SERIAL_CONSOLE = "115200 ttyPS0"

KERNEL_DEVICETREE = "xilinx/zynqmp-ep108.dtb"

UBOOT_MACHINE = "xilinx_zynqmp_ep_config"
UBOOT_LOADADDRESS = "0x80000"
UBOOT_ENTRYPOINT = "0x80000"

EXTRA_IMAGEDEPENDS += "arm-trusted-firmware"

# This machine has a QEMU model, runqemu setup:
QB_MACHINE = "-machine xlnx-ep108"
QB_MEM = "-m 2048"
QB_OPT_APPEND = "-nographic -serial mon:stdio -serial null"
QB_TAP_OPT = "-netdev tap,id=net0,ifname=@TAP@,script=no,downscript=no -net nic,netdev=net0,macaddr=@MAC@"
QB_SLIRP_OPT = "-netdev user,id=net0 -net nic,netdev=net0"
```

## conf/machine/include/machine-xilinx-board.inc
```bitbake
# Default Xilinx Board settings

EXTRA_IMAGEDEPENDS += "virtual/bootloader"

MACHINE_ESSENTIAL_EXTRA_RDEPENDS_append_microblaze += "device-tree"

IMAGE_BOOT_FILES ?= "${KERNEL_IMAGETYPE} ${UBOOT_BINARY}"
```

## conf/machine/include/machine-xilinx-default.inc
```bitbake
# Default Xilinx BSP Machine settings

MACHINE_FEATURES_BACKFILL_CONSIDERED += "rtc"

# MicroBlaze cannot handle the execution of qemu-linux-user for gobject-introspection-data
MACHINE_FEATURES_BACKFILL_CONSIDERED_append_microblaze = " qemu-usermode"

# File System Configuration
IMAGE_FSTYPES ?= "tar.gz cpio cpio.gz.u-boot"

# Kernel Configuration
XILINX_DEFAULT_KERNEL := "linux-xlnx"
XILINX_DEFAULT_KERNEL_microblaze := "linux-yocto"
XILINX_DEFAULT_KERNEL_zynqmp := "linux-yocto"
PREFERRED_PROVIDER_virtual/kernel ??= "${XILINX_DEFAULT_KERNEL}"

# U-Boot Configuration
XILINX_DEFAULT_UBOOT := "u-boot-xlnx"
XILINX_DEFAULT_UBOOT_zynqmp := "u-boot"
PREFERRED_PROVIDER_virtual/bootloader ??= "${XILINX_DEFAULT_UBOOT}"

UBOOT_SUFFIX ?= "img"
UBOOT_SUFFIX_zynqmp ?= "bin"
UBOOT_SUFFIX_microblaze ?= "bin"

UBOOT_BINARY ?= "u-boot.${UBOOT_SUFFIX}"
UBOOT_ELF ?= "u-boot"
UBOOT_ELF_aarch64 ?= "u-boot.elf"

XSERVER ?= " \
	xserver-xorg \
	xf86-input-evdev \
	xf86-input-mouse \
	xf86-input-keyboard \
	xf86-video-fbdev \
	${XSERVER_EXT} \
	"

XSERVER_EXT ?= ""
XSERVER_EXT_zynqmp ?= "xf86-video-armsoc"
```

## conf/machine/include/machine-xilinx-qemu.inc
```bitbake
EXTRA_IMAGEDEPENDS += "qemu-native qemu-helper-native"

def qemu_default_dtb(d):
    if d.getVar("MACHINE_DEVICETREE", True):
        dtbs = d.getVar("MACHINE_DEVICETREE", True).split(" ")
        dtbs = [os.path.splitext(os.path.basename(d)) for d in dtbs]
        dtbs = ["%s.dtb" % name for name, ext in dtbs if ext == ".dts" or ext == ".dtb"]
        return dtbs[0] if dtbs else ""
    elif d.getVar("KERNEL_DEVICETREE", True):
        dtbs = d.getVar("KERNEL_DEVICETREE", True).split(" ")
        dtbs = [os.path.basename(d) for d in dtbs]
        return d.getVar("KERNEL_IMAGETYPE", True) + "-" + (dtbs[0] if dtbs else "")
    return ""

def qemu_default_serial(d):
    if d.getVar("SERIAL_CONSOLE", True):
        speed, console = d.getVar("SERIAL_CONSOLE", True).split(" ", 1)
        # zynqmp uses earlycon and stdout (in dtb)
        if "zynqmp" in d.getVar("MACHINEOVERRIDES", True).split(":"):
            return ""
        return "console=%s,%s earlyprintk" % (console, speed)
    return ""

def qemu_target_binary(d):
    ta = d.getVar("TARGET_ARCH", True)
    if ta == "microblazeeb":
        ta = "microblaze"
    elif ta == "arm":
        ta = "aarch64"
    if qemuboot_xilinx_enabled(d):
        return "qemu-xilinx/qemu-system-%s" % ta
    return "qemu-system-%s" % ta

def qemuboot_xilinx_enabled(d):
    if bb.utils.contains("MACHINE_FEATURES", "qemu-system-xilinx", True, False, d):
        if d.getVar("XILINX_QEMUBOOT", True) == "1":
            return True
    return False

def qemuboot_xilinx_multi_enabled(d):
    if bb.utils.contains("MACHINE_FEATURES", "qemu-system-xilinx", True, False, d):
        if d.getVar("XILINX_QEMUBOOT_MULTI", True) == "1":
            return True
    return False

def qemuboot_xilinx_hw_devicetrees(d):
    if bb.utils.contains("MACHINE_FEATURES", "qemu-system-xilinx", True, False, d):
        if d.getVar("XILINX_QEMUBOOT_MULTI", True) == "1":
            return " -hw-dtb ${DEPLOY_DIR_IMAGE}/qemu-hw-devicetrees/MULTI_ARCH/"
    return " -hw-dtb ${DEPLOY_DIR_IMAGE}/qemu-hw-devicetrees/SINGLE_ARCH/"

def qemuboot_xilinx_unhalt(d):
    if bb.utils.contains("MACHINE_FEATURES", "qemu-system-xilinx", True, False, d):
        if d.getVar("XILINX_QEMUBOOT_MULTI", True) == "1":
            return " -global xlnx,zynqmp-boot.cpu-num=0 -global xlnx,zynqmp-boot.use-pmufw=true "
    return " -device loader,addr=0xfd1a0104,data=0x8000000e,data-len=4 "

# For runqemu, default setup across all machines in meta-xilinx
IMAGE_CLASSES += "qemuboot"
QB_SYSTEM_NAME ?= "${@qemu_target_binary(d)}"
QB_DEFAULT_FSTYPE ?= "cpio"

XILINX_QEMUBOOT[doc] = "Set this variable to '1' to enable the generation of qemuboot.conf which uses the Xilinx QEMU."
XILINX_QEMUBOOT ?= ""

# Dependencies for native Xilinx QEMU
# XILINX_QEMU_DEPENDS ?= "qemu-xilinx-native"
# If the machine supports the Xilinx QEMU, add the dependencies
EXTRA_IMAGEDEPENDS += "${@bb.utils.contains('MACHINE_FEATURES', 'qemu-system-xilinx', '${XILINX_QEMU_DEPENDS}', '', d)}"

# Add an override for when booting with the Xilinx QEMU
MACHINEOVERRIDES .= "${@':qemuboot-xilinx' if qemuboot_xilinx_enabled(d) else ''}"
MACHINEOVERRIDES .= "${@':qemuboot-xilinx-multi' if qemuboot_xilinx_multi_enabled(d) else ''}"

# This is ignored if using Xilinx's QEMU fork
QB_DTB ?= "${@qemu_default_dtb(d)}"

# ZynqMP machines need special "-hw-dtb" device trees for the Xilinx QEMU
XILINX_QEMU_DEPENDS_append_zynqmp = " qemu-devicetrees"

QB_DEFAULT_KERNEL_qemuboot-xilinx = "none"
QB_KERNEL_CMDLINE_APPEND ?= "${@qemu_default_serial(d)}"

# Default machine targets for Xilinx QEMU (FDT Generic)
QB_MACHINE_qemuboot-xilinx_aarch64 = "-machine arm-generic-fdt"
QB_MACHINE_qemuboot-xilinx_arm = "-machine arm-generic-fdt-plnx"
QB_MACHINE_qemuboot-xilinx_microblaze = "-machine microblaze-generic-fdt"
```
