## conf/machine/include/microblaze/arch-microblaze.inc
```bitbake
# MicroBlaze architecture tune feature configuration

# Architecture feature and override
TUNEVALID[microblaze] = "MicroBlaze"
MACHINEOVERRIDES =. "${@bb.utils.contains("TUNE_FEATURES", "microblaze", "microblaze:", "" ,d)}"

# Endian
TUNEVALID[bigendian] = "Use Microblaze Big Endian."

MBPKGARCH_ENDIAN = "${@bb.utils.contains("TUNE_FEATURES", "bigendian", "eb", "el" ,d)}"

TUNE_CCARGS += "${@bb.utils.contains("TUNE_FEATURES", "bigendian", "-mbig-endian", "-mlittle-endian" ,d)}"

# General features
TUNEVALID[barrel-shift] = "Enable Hardware Barrel Shifter"
TUNEVALID[pattern-compare] = "Enable Pattern Compare Instructions"
TUNEVALID[reorder] = "Enable Reorder Instructions"

# General feature compiler args
TUNE_CCARGS += "${@bb.utils.contains("TUNE_FEATURES", "barrel-shift", "-mxl-barrel-shift", "-mno-xl-barrel-shift" ,d)}"
TUNE_CCARGS += "${@bb.utils.contains("TUNE_FEATURES", "pattern-compare", "-mxl-pattern-compare", "-mno-xl-pattern-compare" ,d)}"

# Disable reorder for v8.30 if pattern-compare is not enabled
TUNE_CCARGS += "${@bb.utils.contains("TUNE_FEATURES", "reorder", \
        bb.utils.contains("TUNE_FEATURES", "v8.30", \
            bb.utils.contains("TUNE_FEATURES", "pattern-compare", \
                "-mxl-reorder", "-mno-xl-reorder", d), \
            "-mxl-reorder", d), "-mno-xl-reorder", d)}"

# General feature package architecture formatting
MBPKGARCH_TUNE = ""
MBPKGARCH_TUNE .= "${@bb.utils.contains("TUNE_FEATURES", "barrel-shift", "-bs", "" ,d)}"
MBPKGARCH_TUNE .= "${@bb.utils.contains("TUNE_FEATURES", "pattern-compare", "-cmp", "" ,d)}"
MBPKGARCH_TUNE .= "${@bb.utils.contains("TUNE_FEATURES", "reorder", "-re", "" ,d)}"

# Additional features
require conf/machine/include/microblaze/feature-microblaze-versions.inc
require conf/machine/include/microblaze/feature-microblaze-math.inc

# Architecture name, either 'microblazeeb' or 'microblazeel' depending on endianess
TUNE_ARCH = "microblaze${@bb.utils.contains("TUNE_FEATURES", "bigendian", "eb", "el" ,d)}"

# Package Architecture formatting
TUNE_PKGARCH = "microblaze${MBPKGARCH_ENDIAN}${MBPKGARCH_VERSION}${MBPKGARCH_TUNE}${MBPKGARCH_MATH}"
```

## conf/machine/include/microblaze/feature-microblaze-barrel-shift.inc
```bitbake
TUNEVALID[barrel-shift] = "Enable Microblaze Hardware Barrel Shift."
MBCCARGSBARRELSHIFT += "${@bb.utils.contains("TUNE_FEATURES", "barrel-shift", "-mxl-barrel-shift", "-mno-xl-barrel-shift" ,d)}"
MBPKGBARRELSHIFT .= "${@bb.utils.contains("TUNE_FEATURES", "barrel-shift", "-bs", "" ,d)}"
```

## conf/machine/include/microblaze/feature-microblaze-divide.inc
```bitbake
TUNEVALID[divide-hard] = "Enable Microblaze hardware divider."
MBCCARGSDIV += "${@bb.utils.contains("TUNE_FEATURES", "divide-hard", "-mno-xl-soft-div", "-mxl-soft-div" ,d)}"
MBPKGDIV .= "${@bb.utils.contains("TUNE_FEATURES", "divide-hard", "-div", "" ,d)}"
```

## conf/machine/include/microblaze/feature-microblaze-endian.inc
```bitbake
# This feature file must be included/required FIRST as it defines the start of the PKGARCH bitbake variable
MBCCARGSENDIAN = ""
MBPKGENDIAN = ""

TUNEVALID[little-endian] = "Use Microblaze Little Endian."
MBCCARGSENDIAN += "${@bb.utils.contains("TUNE_FEATURES", "little-endian", "-mlittle-endian", "" ,d)}"
MBPKGENDIAN .= "${@bb.utils.contains("TUNE_FEATURES", "little-endian", "el", "" ,d)}"

TUNEVALID[big-endian] = "Use Microblaze Big Endian."
MBCCARGSENDIAN += "${@bb.utils.contains("TUNE_FEATURES", "big-endian", "-mbig-endian", "" ,d)}"
MBPKGENDIAN .= "${@bb.utils.contains("TUNE_FEATURES", "big-endian", "eb", "" ,d)}"

TUNECONFLICTS[little-endian] = "big-endian"
```

## conf/machine/include/microblaze/feature-microblaze-fpu.inc
```bitbake
TUNEVALID[fpu-soft] = "Use Microblaze software FPU"
TUNEVALID[fpu-hard] = "Enable Microblaze hardware FPU in basic mode."
TUNEVALID[fpu-hard-extended] = "Enable Microblaze hardware FPU in extended mode - conversion and square root instructions."

# Establish which fpu is configured in TUNE_FEATURES. Soft is the default for gcc.
MBCCARGSFPU_BASIC = "${@bb.utils.contains("TUNE_FEATURES", "fpu-hard", "-mhard-float", "", d)}"
MBCCARGSFPU = "${@bb.utils.contains("TUNE_FEATURES", "fpu-hard-extended", "-mhard-float -mxl-float-convert -mxl-float-sqrt", "${MBCCARGSFPU_BASIC}" ,d)}"

MBPKGFPU_BASIC = "${@bb.utils.contains("TUNE_FEATURES", "fpu-hard", "-fb", "", d)}"
MBPKGFPU = "${@bb.utils.contains("TUNE_FEATURES", "fpu-hard-extended", "-fe", "${MBPKGFPU_BASIC}", d)}"

# Set target fpu (bitbake known target) to soft or hard (basic or extended in microblaze language)
TARGETFPU_BASIC = "${@bb.utils.contains("TUNE_FEATURES", "fpu-hard", "fpu-hard", "fpu-soft", d)}"
TARGET_FPU = "${@bb.utils.contains("TUNE_FEATURES", "fpu-hard-extended", "fpu-hard", "${TARGETFPU_BASIC}", d)}"

TUNECONFLICTS[fpu-hard] = "fpu-soft"
TUNECONFLICTS[fpu-hard-extended] = "fpu-soft"
```

## conf/machine/include/microblaze/feature-microblaze-multiply.inc
```bitbake
TUNEVALID[multiply-low] = "Enable Microblaze Hardware Multiply with low (32 bit) result."
TUNEVALID[multiply-high] = "Enable Microblaze Hardware Multiply with high (64 bit) result."

# Establish which Multiply output result size to use
MBCCARGSMUL_BASIC = "${@bb.utils.contains("TUNE_FEATURES", "multiply-low", "-mno-xl-soft-mul", "-mxl-soft-mul" ,d)}"
MBCCARGSMUL = "${@bb.utils.contains("TUNE_FEATURES", "multiply-high", "-mno-xl-soft-mul -mxl-multiply-high", "${MBCCARGSMUL_BASIC}" ,d)}"

MBPKGMUL_BASIC = "${@bb.utils.contains("TUNE_FEATURES", "multiply-low", "-ml", "" ,d)}"
MBPKGMUL = "${@bb.utils.contains("TUNE_FEATURES", "multiply-high", "-mh", "${MBPKGMUL_BASIC}" ,d)}"
```

## conf/machine/include/microblaze/feature-microblaze-pattern-compare.inc
```bitbake
TUNEVALID[pattern-compare] = "Enable Microblaze Pattern Compare Instructions."
MBCCARGSPATTERNCOMPARE = "${@bb.utils.contains("TUNE_FEATURES", "pattern-compare", "-mxl-pattern-compare", "-mno-xl-pattern-compare" ,d)}"
MBPKGSPATTERNCOMPARE = "${@bb.utils.contains("TUNE_FEATURES", "pattern-compare", "-cmp", "" ,d)}"
```

## conf/machine/include/microblaze/feature-microblaze-reorder.inc
```bitbake
TUNEVALID[reorder] = "Enable Microblaze Reorder Instructions."
MBCCARGSREORDER = "${@bb.utils.contains("TUNE_FEATURES", "reorder", "-mxl-reorder", "-mno-xl-reorder" ,d)}"
MBPKGREORDER = "${@bb.utils.contains("TUNE_FEATURES", "reorder", "-re", "" ,d)}"
```

## conf/machine/include/microblaze/feature-microblaze-v10.inc
```bitbake
# Setup version 'feature set' for supported Microblaze version 10 versions

TUNEVALID[v10.0] = "Use Microblaze version 10.0"
MBCCARGSVERSION += "${@bb.utils.contains("TUNE_FEATURES", "v10.0", "-mcpu=v10.0", "" ,d)}"
MBPKGVERSION .= "${@bb.utils.contains("TUNE_FEATURES", "v10.0", "-v10.0", "" ,d)}"
```

## conf/machine/include/microblaze/feature-microblaze-v7.inc
```bitbake
# Setup version 'feature set' for supported Microblaze version 7 versions
TUNEVALID[v7.30] = "Use Microblaze version 7.30"

MBCCARGSVERSION += "${@bb.utils.contains("TUNE_FEATURES", "v7.30", "-mcpu=v7.30.a", "" ,d)}"
MBPKGVERSION .= "${@bb.utils.contains("TUNE_FEATURES", "v7.30", "-v7.30", "" ,d)}"

TUNECONFLICTS[v7.30] += "reorder little-endian"
```

## conf/machine/include/microblaze/feature-microblaze-v8.inc
```bitbake
# Setup version 'feature set' for supported Microblaze version 8 versions
TUNEVALID[v8.50] = "Use Microblaze version 8.50"
MBCCARGSVERSION += "${@bb.utils.contains("TUNE_FEATURES", "v8.50", "-mcpu=v8.50.a", "" ,d)}"
MBPKGVERSION .= "${@bb.utils.contains("TUNE_FEATURES", "v8.50", "-v8.50", "" ,d)}"

TUNEVALID[v8.40] = "Use Microblaze version 8.40"
MBCCARGSVERSION += "${@bb.utils.contains("TUNE_FEATURES", "v8.40", "-mcpu=v8.40.a", "" ,d)}"
MBPKGVERSION .= "${@bb.utils.contains("TUNE_FEATURES", "v8.40", "-v8.40", "" ,d)}"

TUNEVALID[v8.30] = "Use Microblaze version 8.30"
MBCCARGSVERSION += "${@bb.utils.contains("TUNE_FEATURES", "v8.30", "-mcpu=v8.30.a", "" ,d)}"
MBPKGVERSION .= "${@bb.utils.contains("TUNE_FEATURES", "v8.30", "-v8.30", "" ,d)}"

TUNEVALID[v8.20] = "Use Microblaze version 8.20"
MBCCARGSVERSION += "${@bb.utils.contains("TUNE_FEATURES", "v8.20", "-mcpu=v8.20.a", "" ,d)}"
MBPKGVERSION .= "${@bb.utils.contains("TUNE_FEATURES", "v8.20", "-v8.20", "" ,d)}"

TUNEVALID[v8.10] = "Use Microblaze version 8.10"
MBCCARGSVERSION += "${@bb.utils.contains("TUNE_FEATURES", "v8.10", "-mcpu=v8.10.a", "" ,d)}"
MBPKGVERSION .= "${@bb.utils.contains("TUNE_FEATURES", "v8.10", "-v8.10", "" ,d)}"

TUNEVALID[v8.00] = "Use Microblaze version 8.00"
MBCCARGSVERSION += "${@bb.utils.contains("TUNE_FEATURES", "v8.00", "-mcpu=v8.00.a", "" ,d)}"
MBPKGVERSION .= "${@bb.utils.contains("TUNE_FEATURES", "v8.00", "-v8.00", "" ,d)}"

TUNECONFLICTS[v8.00] += "reorder"
TUNECONFLICTS[v8.10] += "reorder"
TUNECONFLICTS[v8.20] += "reorder"

# Perform some additional sanity checking
python __anonymous () {
    import bb
    tune_features = bb.data.getVar('TUNE_FEATURES', d, 1)
    tuneslist = tune_features.split()

    #
    # GCC will fail on v8.30 if reorder and pattern-compare are not 
    # both in ccflags
    # -mxl-reorder requires -mxl-pattern-compare for -mcpu=v8.30.a
    # Check if either one exists alone and if so, add the other
    #
    if 'v8.30' in tuneslist:
        if 'reorder' in tuneslist and 'pattern-compare' not in tuneslist:
            d.setVar("TUNE_FEATURES", "%s pattern-compare" % tune_features)
}
```

## conf/machine/include/microblaze/feature-microblaze-v9.inc
```bitbake
# Setup version 'feature set' for supported Microblaze version 9 versions
TUNEVALID[v9.6] = "Use Microblaze version 9.6"
MBCCARGSVERSION += "${@bb.utils.contains("TUNE_FEATURES", "v9.6", "-mcpu=v9.6", "" ,d)}"
MBPKGVERSION .= "${@bb.utils.contains("TUNE_FEATURES", "v9.6", "-v9.6", "" ,d)}"

TUNEVALID[v9.0] = "Use Microblaze version 9.0"
MBCCARGSVERSION += "${@bb.utils.contains("TUNE_FEATURES", "v9.0", "-mcpu=v9.0", "" ,d)}"
MBPKGVERSION .= "${@bb.utils.contains("TUNE_FEATURES", "v9.0", "-v9.0", "" ,d)}"
```

## conf/machine/include/microblaze/feature-microblaze-versions.inc
```bitbake
# MicroBlaze versions are defined as features, the features are setup to
# conflict with other versions as well as unavailable features for particular
# versions.

def microblaze_parse_version(s):
    # versions before v9 use the "vX.YY.Z" scheme where Z = [ab]
    # versions after v8 use the "vX.Y" scheme
    import re
    m = re.search("^v(\d+)\.(\d+)(\.([ab]))?", s)
    if m:
        major, minor = int(m.group(1)), int(m.group(2))
        if major < 9:
            return (major, minor, m.group(4) or "a")
        return (major, minor)
    return None

def microblaze_version_conflict(ver, d):
    tunes = d.getVarFlags("TUNEVALID").keys()
    conflict = []
    version = microblaze_parse_version(ver)
    for i in tunes:
        iversion = microblaze_parse_version(i)
        if iversion and iversion != version:
            conflict.append(i)
    return " ".join(conflict)

def microblaze_current_version(d, gcc = False):
    tunes = (d.getVar("TUNE_FEATURES") or "").split()
    version = next((v for v in [microblaze_parse_version(i) for i in tunes] if v), None)
    if version:
        if version[0] <= 8 and len(version) > 2 and (gcc or version[2] != "a"):
            return "v%d.%02d.%s" % version[0:3]
        else:
            return "v%d.%d" % version[0:2]
    return ""

# MicroBlaze versions
TUNEVALID[v8.00] = "MicroBlaze version 8.00"
TUNEVALID[v8.10] = "MicroBlaze version 8.10"
TUNEVALID[v8.20] = "MicroBlaze version 8.20"
TUNEVALID[v8.30] = "MicroBlaze version 8.30"
TUNEVALID[v8.40] = "MicroBlaze version 8.40"
TUNEVALID[v8.50] = "MicroBlaze version 8.50"
TUNEVALID[v9.0] = "MicroBlaze version 9.0"
TUNEVALID[v9.1] = "MicroBlaze version 9.1"
TUNEVALID[v9.2] = "MicroBlaze version 9.2"
TUNEVALID[v9.3] = "MicroBlaze version 9.3"
TUNEVALID[v9.4] = "MicroBlaze version 9.4"
TUNEVALID[v9.5] = "MicroBlaze version 9.5"
TUNEVALID[v9.6] = "MicroBlaze version 9.6"
TUNEVALID[v10.0] = "MicroBlaze version 10.0"

# Version conflict matrix
TUNECONFLICTS[v8.00] := "${@microblaze_version_conflict('v8.00', d)}"
TUNECONFLICTS[v8.10] := "${@microblaze_version_conflict('v8.10', d)}"
TUNECONFLICTS[v8.20] := "${@microblaze_version_conflict('v8.20', d)}"
TUNECONFLICTS[v8.30] := "${@microblaze_version_conflict('v8.30', d)}"
TUNECONFLICTS[v8.40] := "${@microblaze_version_conflict('v8.40', d)}"
TUNECONFLICTS[v8.50] := "${@microblaze_version_conflict('v8.50', d)}"
TUNECONFLICTS[v9.0] := "${@microblaze_version_conflict('v9.0', d)}"
TUNECONFLICTS[v9.1] := "${@microblaze_version_conflict('v9.1', d)}"
TUNECONFLICTS[v9.2] := "${@microblaze_version_conflict('v9.2', d)}"
TUNECONFLICTS[v9.3] := "${@microblaze_version_conflict('v9.3', d)}"
TUNECONFLICTS[v9.4] := "${@microblaze_version_conflict('v9.4', d)}"
TUNECONFLICTS[v9.5] := "${@microblaze_version_conflict('v9.5', d)}"
TUNECONFLICTS[v9.6] := "${@microblaze_version_conflict('v9.6', d)}"
TUNECONFLICTS[v10.0] := "${@microblaze_version_conflict('v10.0', d)}"

# Version/feature conflicts
TUNECONFLICTS[v8.00] += "reorder"
TUNECONFLICTS[v8.10] += "reorder"
TUNECONFLICTS[v8.20] += "reorder"

# Version flags
TUNE_CCARGS += "-mcpu=${@microblaze_current_version(d, True)}"
MBPKGARCH_VERSION = "-${@microblaze_current_version(d)}"
```

## conf/machine/include/tune-microblaze-features.inc
```bitbake
# The order of these files defines the order of sections in the PKGARCH variable
require conf/machine/include/microblaze/feature-microblaze-endian.inc
require conf/machine/include/microblaze/feature-microblaze-versions.inc
require conf/machine/include/microblaze/feature-microblaze-barrel-shift.inc
require conf/machine/include/microblaze/feature-microblaze-multiply.inc
require conf/machine/include/microblaze/feature-microblaze-divide.inc
require conf/machine/include/microblaze/feature-microblaze-fpu.inc
require conf/machine/include/microblaze/feature-microblaze-pattern-compare.inc
require conf/machine/include/microblaze/feature-microblaze-reorder.inc

# Architecture name, either 'microblaze' or 'microblazeel' depending on endianess
TUNE_ARCH = "microblaze${@bb.utils.contains("TUNE_FEATURES", "little-endian", "el", "eb" ,d)}"

# Compiler args
TUNE_CCARGS += "${MBCCARGSENDIAN} ${MBCCARGSVERSION} ${MBCCARGSBARRELSHIFT} ${MBCCARGSMUL} ${MBCCARGSDIV} ${MBCCARGSFPU} ${MBCCARGSPATTERNCOMPARE} ${MBCCARGSREORDER}"

# Package Architecture formatting
MBPKGMATH = "${MBPKGMUL}${MBPKGDIV}${MBPKGFPU}"
TUNE_PKGARCH = "microblaze${MBPKGENDIAN}${MBPKGVERSION}${MBPKGBARRELSHIFT}${MBPKGSPATTERNCOMPARE}${MBPKGREORDER}${MBPKGMATH}"
```

## conf/machine/include/tune-microblaze.inc
```bitbake
DEFAULTTUNE ?= "microblaze"

require conf/machine/include/tune-microblaze-features.inc

TUNEVALID[microblaze] = "Microblaze"
AVAILTUNES += "microblaze"

TUNE_FEATURES_tune-microblaze = "microblaze"
PACKAGE_EXTRA_ARCHS_tune-microblaze = "${TUNE_PKGARCH}"

# override for architecture
MACHINEOVERRIDES =. "${@bb.utils.contains("TUNE_FEATURES", "microblaze", "microblaze:", "" ,d)}"

# Linux Configuration
KERNEL_IMAGETYPE ?= "linux.bin.ub"

# U-Boot Configuration
UBOOT_MACHINE ?= "microblaze-generic_config"

# linux-yocto KMACHINE
KMACHINE ?= "microblaze"

# default to use the gdb 7.7.1
PREFERRED_VERSION_gdb ?= "7.7.1"
PREFERRED_VERSION_gdb-cross ?= "7.7.1"
PREFERRED_VERSION_gdb-cross-canadian ?= "7.7.1"
```
