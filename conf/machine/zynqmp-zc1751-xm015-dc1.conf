## meta-vitis-tc/conf/machine/riscv-tc.conf
```bitbake
#@TYPE: Machine
#@NAME: riscv-tc
#@DESCRIPTION: Vitis baremetal toolchain machine: drives a multilib RISC-V (MicroBlaze-V, 32-bit and 64-bit) cross-toolchain build for use with AMD Vitis embedded software flows. Not intended to boot a Linux image.

require conf/machine/include/machine-xilinx-qemu.inc
require conf/multilib.conf
require conf/machine/include/mbv/arch-riscv.inc
require conf/machine/include/baremetal-tc.conf

# In order to support additional extensions, enable binutils 2.43.1
BINUVERSION = "2.43%"

# Set defaults
# We don't know why pie is not supported, but when enabled results in:
#   .../riscv32-xilinx-elf/12.2.0/ld: -pie not supported
GCCPIE:riscv-tc = ""
GLIBCPIE:riscv-tc = ""
SECURITY_CFLAGS:remove:riscv-tc = "${SECURITY_PIE_CFLAGS}"
SECURITY_CFLAGS:pn-libgcc:riscv-tc = ""

# Define all of the multilibs supported by this configuration
MULTILIB_GLOBAL_VARIANTS = "${@extend_variants(d,'MULTILIBS','multilib')}"

# riscv 64-bit it's been requested to move to the medany memory model
TARGET_CFLAGS:append:libc-newlib:riscv64 = " -mcmodel=medany"

############# DEFAULT SET ##################
MULTILIBS  = ""

# This is used when you clear the generated below in order to run the
# riscv-convert.sh script.  Even though its a duplicate, do not
# remove.
#
# Base configuration
# CFLAGS:
DEFAULTTUNE = "rv32"

AVAILTUNES += "rv32"
TUNE_FEATURES:tune-rv32 = "rv 32 i"
PACKAGE_EXTRA_ARCHS:tune-rv32 = "${TUNE_RISCV_PKGARCH}"
BASE_LIB:tune-rv32 = "lib"

############ GENERATED #############
# Multilibs defined in recipes-devtools/gcc/gcc-xilinx-standalone-multilib.inc
# Everything below is generated by riscv-convert.sh
MULTILIBS  = ""
MULTILIBS += "multilib:librv32i"
MULTILIBS += "multilib:librv32ib"
MULTILIBS += "multilib:librv32ic"
MULTILIBS += "multilib:librv32icb"
MULTILIBS += "multilib:librv32im"
MULTILIBS += "multilib:librv32imb"
MULTILIBS += "multilib:librv32imc"
MULTILIBS += "multilib:librv32imcb"
MULTILIBS += "multilib:librv32imac"
MULTILIBS += "multilib:librv32imac_zicsr_zifencei"
MULTILIBS += "multilib:librv32imf_zicsr"
MULTILIBS += "multilib:librv32imfc_zicsr"
MULTILIBS += "multilib:librv32imafc_zicsr"
MULTILIBS += "multilib:librv32imfdc_zicsr"
MULTILIBS += "multilib:librv64i"
MULTILIBS += "multilib:librv64ic"
MULTILIBS += "multilib:librv64im"
MULTILIBS += "multilib:librv64imc"
MULTILIBS += "multilib:librv64imac"
MULTILIBS += "multilib:librv64imf_zicsr"
MULTILIBS += "multilib:librv64imfc_zicsr"
MULTILIBS += "multilib:librv64imafc_zicsr"
MULTILIBS += "multilib:librv64imfdc_zicsr"
MULTILIBS += "multilib:librv64imafdcb_zicbom_zicsr_zifencei"

# Base configuration
# CFLAGS:
DEFAULTTUNE = "rv32"

AVAILTUNES += "rv32"
TUNE_FEATURES:tune-rv32 = "rv 32 i"
PACKAGE_EXTRA_ARCHS:tune-rv32 = "${TUNE_RISCV_PKGARCH}"
BASE_LIB:tune-rv32 = "lib"


# rv32i/ilp32
# CFLAGS: -march=rv32i -mabi=ilp32
DEFAULTTUNE:virtclass-multilib-librv32i = "rv32i"

AVAILTUNES += "rv32i"
TUNE_FEATURES:tune-rv32i = "${@mbv.tune.riscv_isa_to_tune("rv32i")}"
PACKAGE_EXTRA_ARCHS:tune-rv32i = "${TUNE_RISCV_PKGARCH}"
BASE_LIB:tune-rv32i = "lib/rv32i/ilp32"


# rv32ib/ilp32
# CFLAGS: -march=rv32ib -mabi=ilp32
DEFAULTTUNE:virtclass-multilib-librv32ib = "rv32ib"

AVAILTUNES += "rv32ib"
TUNE_FEATURES:tune-rv32ib = "${@mbv.tune.riscv_isa_to_tune("rv32ib")}"
PACKAGE_EXTRA_ARCHS:tune-rv32ib = "${TUNE_RISCV_PKGARCH}"
BASE_LIB:tune-rv32ib = "lib/rv32ib/ilp32"


# rv32ic/ilp32
# CFLAGS: -march=rv32ic -mabi=ilp32
DEFAULTTUNE:virtclass-multilib-librv32ic = "rv32ic"

AVAILTUNES += "rv32ic"
TUNE_FEATURES:tune-rv32ic = "${@mbv.tune.riscv_isa_to_tune("rv32ic")}"
PACKAGE_EXTRA_ARCHS:tune-rv32ic = "${TUNE_RISCV_PKGARCH}"
BASE_LIB:tune-rv32ic = "lib/rv32ic/ilp32"


# rv32icb/ilp32
# CFLAGS: -march=rv32icb -mabi=ilp32
DEFAULTTUNE:virtclass-multilib-librv32icb = "rv32icb"

AVAILTUNES += "rv32icb"
TUNE_FEATURES:tune-rv32icb = "${@mbv.tune.riscv_isa_to_tune("rv32icb")}"
PACKAGE_EXTRA_ARCHS:tune-rv32icb = "${TUNE_RISCV_PKGARCH}"
BASE_LIB:tune-rv32icb = "lib/rv32icb/ilp32"


# rv32im/ilp32
# CFLAGS: -march=rv32im -mabi=ilp32
DEFAULTTUNE:virtclass-multilib-librv32im = "rv32im"

AVAILTUNES += "rv32im"
TUNE_FEATURES:tune-rv32im = "${@mbv.tune.riscv_isa_to_tune("rv32im")}"
PACKAGE_EXTRA_ARCHS:tune-rv32im = "${TUNE_RISCV_PKGARCH}"
BASE_LIB:tune-rv32im = "lib/rv32im/ilp32"


# rv32imb/ilp32
# CFLAGS: -march=rv32imb -mabi=ilp32
DEFAULTTUNE:virtclass-multilib-librv32imb = "rv32imb"

AVAILTUNES += "rv32imb"
TUNE_FEATURES:tune-rv32imb = "${@mbv.tune.riscv_isa_to_tune("rv32imb")}"
PACKAGE_EXTRA_ARCHS:tune-rv32imb = "${TUNE_RISCV_PKGARCH}"
BASE_LIB:tune-rv32imb = "lib/rv32imb/ilp32"


# rv32imc/ilp32
# CFLAGS: -march=rv32imc -mabi=ilp32
DEFAULTTUNE:virtclass-multilib-librv32imc = "rv32imc"

AVAILTUNES += "rv32imc"
TUNE_FEATURES:tune-rv32imc = "${@mbv.tune.riscv_isa_to_tune("rv32imc")}"
PACKAGE_EXTRA_ARCHS:tune-rv32imc = "${TUNE_RISCV_PKGARCH}"
BASE_LIB:tune-rv32imc = "lib/rv32imc/ilp32"


# rv32imcb/ilp32
# CFLAGS: -march=rv32imcb -mabi=ilp32
DEFAULTTUNE:virtclass-multilib-librv32imcb = "rv32imcb"

AVAILTUNES += "rv32imcb"
TUNE_FEATURES:tune-rv32imcb = "${@mbv.tune.riscv_isa_to_tune("rv32imcb")}"
PACKAGE_EXTRA_ARCHS:tune-rv32imcb = "${TUNE_RISCV_PKGARCH}"
BASE_LIB:tune-rv32imcb = "lib/rv32imcb/ilp32"


# rv32imac/ilp32
# CFLAGS: -march=rv32imac -mabi=ilp32
DEFAULTTUNE:virtclass-multilib-librv32imac = "rv32imac"

AVAILTUNES += "rv32imac"
TUNE_FEATURES:tune-rv32imac = "${@mbv.tune.riscv_isa_to_tune("rv32imac")}"
PACKAGE_EXTRA_ARCHS:tune-rv32imac = "${TUNE_RISCV_PKGARCH}"
BASE_LIB:tune-rv32imac = "lib/rv32imac/ilp32"


# rv32imac_zicsr_zifencei/ilp32
# CFLAGS: -march=rv32imac_zicsr_zifencei -mabi=ilp32
DEFAULTTUNE:virtclass-multilib-librv32imac_zicsr_zifencei = "rv32imac_zicsr_zifencei"

AVAILTUNES += "rv32imac_zicsr_zifencei"
TUNE_FEATURES:tune-rv32imac_zicsr_zifencei = "${@mbv.tune.riscv_isa_to_tune("rv32imac_zicsr_zifencei")}"
PACKAGE_EXTRA_ARCHS:tune-rv32imac_zicsr_zifencei = "${TUNE_RISCV_PKGARCH}"
BASE_LIB:tune-rv32imac_zicsr_zifencei = "lib/rv32imac_zicsr_zifencei/ilp32"


# rv32imf_zicsr/ilp32f
# CFLAGS: -march=rv32imf_zicsr -mabi=ilp32f
DEFAULTTUNE:virtclass-multilib-librv32imf_zicsr = "rv32imf_zicsr"

AVAILTUNES += "rv32imf_zicsr"
TUNE_FEATURES:tune-rv32imf_zicsr = "${@mbv.tune.riscv_isa_to_tune("rv32imf_zicsr")}"
PACKAGE_EXTRA_ARCHS:tune-rv32imf_zicsr = "${TUNE_RISCV_PKGARCH}"
BASE_LIB:tune-rv32imf_zicsr = "lib/rv32imf_zicsr/ilp32f"


# rv32imfc_zicsr/ilp32f
# CFLAGS: -march=rv32imfc_zicsr -mabi=ilp32f
DEFAULTTUNE:virtclass-multilib-librv32imfc_zicsr = "rv32imfc_zicsr"

AVAILTUNES += "rv32imfc_zicsr"
TUNE_FEATURES:tune-rv32imfc_zicsr = "${@mbv.tune.riscv_isa_to_tune("rv32imfc_zicsr")}"
PACKAGE_EXTRA_ARCHS:tune-rv32imfc_zicsr = "${TUNE_RISCV_PKGARCH}"
BASE_LIB:tune-rv32imfc_zicsr = "lib/rv32imfc_zicsr/ilp32f"


# rv32imafc_zicsr/ilp32f
# CFLAGS: -march=rv32imafc_zicsr -mabi=ilp32f
DEFAULTTUNE:virtclass-multilib-librv32imafc_zicsr = "rv32imafc_zicsr"

AVAILTUNES += "rv32imafc_zicsr"
TUNE_FEATURES:tune-rv32imafc_zicsr = "${@mbv.tune.riscv_isa_to_tune("rv32imafc_zicsr")}"
PACKAGE_EXTRA_ARCHS:tune-rv32imafc_zicsr = "${TUNE_RISCV_PKGARCH}"
BASE_LIB:tune-rv32imafc_zicsr = "lib/rv32imafc_zicsr/ilp32f"


# rv32imfdc_zicsr/ilp32d
# CFLAGS: -march=rv32imfdc_zicsr -mabi=ilp32d
DEFAULTTUNE:virtclass-multilib-librv32imfdc_zicsr = "rv32imfdc_zicsr"

AVAILTUNES += "rv32imfdc_zicsr"
TUNE_FEATURES:tune-rv32imfdc_zicsr = "${@mbv.tune.riscv_isa_to_tune("rv32imfdc_zicsr")}"
PACKAGE_EXTRA_ARCHS:tune-rv32imfdc_zicsr = "${TUNE_RISCV_PKGARCH}"
BASE_LIB:tune-rv32imfdc_zicsr = "lib/rv32imfdc_zicsr/ilp32d"


# rv64i/lp64
# CFLAGS: -march=rv64i -mabi=lp64
DEFAULTTUNE:virtclass-multilib-librv64i = "rv64i"

AVAILTUNES += "rv64i"
TUNE_FEATURES:tune-rv64i = "${@mbv.tune.riscv_isa_to_tune("rv64i")}"
PACKAGE_EXTRA_ARCHS:tune-rv64i = "${TUNE_RISCV_PKGARCH}"
BASE_LIB:tune-rv64i = "lib/rv64i/lp64"


# rv64ic/lp64
# CFLAGS: -march=rv64ic -mabi=lp64
DEFAULTTUNE:virtclass-multilib-librv64ic = "rv64ic"

AVAILTUNES += "rv64ic"
TUNE_FEATURES:tune-rv64ic = "${@mbv.tune.riscv_isa_to_tune("rv64ic")}"
PACKAGE_EXTRA_ARCHS:tune-rv64ic = "${TUNE_RISCV_PKGARCH}"
BASE_LIB:tune-rv64ic = "lib/rv64ic/lp64"


# rv64im/lp64
# CFLAGS: -march=rv64im -mabi=lp64
DEFAULTTUNE:virtclass-multilib-librv64im = "rv64im"

AVAILTUNES += "rv64im"
TUNE_FEATURES:tune-rv64im = "${@mbv.tune.riscv_isa_to_tune("rv64im")}"
PACKAGE_EXTRA_ARCHS:tune-rv64im = "${TUNE_RISCV_PKGARCH}"
BASE_LIB:tune-rv64im = "lib/rv64im/lp64"


# rv64imc/lp64
# CFLAGS: -march=rv64imc -mabi=lp64
DEFAULTTUNE:virtclass-multilib-librv64imc = "rv64imc"

AVAILTUNES += "rv64imc"
TUNE_FEATURES:tune-rv64imc = "${@mbv.tune.riscv_isa_to_tune("rv64imc")}"
PACKAGE_EXTRA_ARCHS:tune-rv64imc = "${TUNE_RISCV_PKGARCH}"
BASE_LIB:tune-rv64imc = "lib/rv64imc/lp64"


# rv64imac/lp64
# CFLAGS: -march=rv64imac -mabi=lp64
DEFAULTTUNE:virtclass-multilib-librv64imac = "rv64imac"

AVAILTUNES += "rv64imac"
TUNE_FEATURES:tune-rv64imac = "${@mbv.tune.riscv_isa_to_tune("rv64imac")}"
PACKAGE_EXTRA_ARCHS:tune-rv64imac = "${TUNE_RISCV_PKGARCH}"
BASE_LIB:tune-rv64imac = "lib/rv64imac/lp64"


# rv64imf_zicsr/lp64f
# CFLAGS: -march=rv64imf_zicsr -mabi=lp64f
DEFAULTTUNE:virtclass-multilib-librv64imf_zicsr = "rv64imf_zicsr"

AVAILTUNES += "rv64imf_zicsr"
TUNE_FEATURES:tune-rv64imf_zicsr = "${@mbv.tune.riscv_isa_to_tune("rv64imf_zicsr")}"
PACKAGE_EXTRA_ARCHS:tune-rv64imf_zicsr = "${TUNE_RISCV_PKGARCH}"
BASE_LIB:tune-rv64imf_zicsr = "lib/rv64imf_zicsr/lp64f"


# rv64imfc_zicsr/lp64f
# CFLAGS: -march=rv64imfc_zicsr -mabi=lp64f
DEFAULTTUNE:virtclass-multilib-librv64imfc_zicsr = "rv64imfc_zicsr"

AVAILTUNES += "rv64imfc_zicsr"
TUNE_FEATURES:tune-rv64imfc_zicsr = "${@mbv.tune.riscv_isa_to_tune("rv64imfc_zicsr")}"
PACKAGE_EXTRA_ARCHS:tune-rv64imfc_zicsr = "${TUNE_RISCV_PKGARCH}"
BASE_LIB:tune-rv64imfc_zicsr = "lib/rv64imfc_zicsr/lp64f"


# rv64imafc_zicsr/lp64f
# CFLAGS: -march=rv64imafc_zicsr -mabi=lp64f
DEFAULTTUNE:virtclass-multilib-librv64imafc_zicsr = "rv64imafc_zicsr"

AVAILTUNES += "rv64imafc_zicsr"
TUNE_FEATURES:tune-rv64imafc_zicsr = "${@mbv.tune.riscv_isa_to_tune("rv64imafc_zicsr")}"
PACKAGE_EXTRA_ARCHS:tune-rv64imafc_zicsr = "${TUNE_RISCV_PKGARCH}"
BASE_LIB:tune-rv64imafc_zicsr = "lib/rv64imafc_zicsr/lp64f"


# rv64imfdc_zicsr/lp64d
# CFLAGS: -march=rv64imfdc_zicsr -mabi=lp64d
DEFAULTTUNE:virtclass-multilib-librv64imfdc_zicsr = "rv64imfdc_zicsr"

AVAILTUNES += "rv64imfdc_zicsr"
TUNE_FEATURES:tune-rv64imfdc_zicsr = "${@mbv.tune.riscv_isa_to_tune("rv64imfdc_zicsr")}"
PACKAGE_EXTRA_ARCHS:tune-rv64imfdc_zicsr = "${TUNE_RISCV_PKGARCH}"
BASE_LIB:tune-rv64imfdc_zicsr = "lib/rv64imfdc_zicsr/lp64d"


# rv64imafdcb_zicbom_zicsr_zifencei/lp64d
# CFLAGS: -march=rv64imafdcb_zicbom_zicsr_zifencei -mabi=lp64d
DEFAULTTUNE:virtclass-multilib-librv64imafdcb_zicbom_zicsr_zifencei = "rv64imafdcb_zicbom_zicsr_zifencei"

AVAILTUNES += "rv64imafdcb_zicbom_zicsr_zifencei"
TUNE_FEATURES:tune-rv64imafdcb_zicbom_zicsr_zifencei = "${@mbv.tune.riscv_isa_to_tune("rv64imafdcb_zicbom_zicsr_zifencei")}"
PACKAGE_EXTRA_ARCHS:tune-rv64imafdcb_zicbom_zicsr_zifencei = "${TUNE_RISCV_PKGARCH}"
BASE_LIB:tune-rv64imafdcb_zicbom_zicsr_zifencei = "lib/rv64imafdcb_zicbom_zicsr_zifencei/lp64d"
```

## meta-xilinx-bsp/conf/layer.conf
```bitbake
# We have a conf and classes directory, add to BBPATH
BBPATH .= ":${LAYERDIR}"

# We have a packages directory, add to BBFILES
BBFILES += "${LAYERDIR}/recipes-*/*/*.bb"
BBFILES += "${LAYERDIR}/recipes-*/*/*.bbappend"

BBFILE_COLLECTIONS += "xilinx-bsp"
BBFILE_PATTERN_xilinx-bsp = "^${LAYERDIR}/"
BBFILE_PRIORITY_xilinx-bsp = "5"

LAYERSUMMARY_xilinx-bsp = "AMD Xilinx core BSP (Versal/Zynq/MicroBlaze \
evaluation boards)"
LAYERDESCRIPTION_xilinx-bsp = "BSP layer providing the supported AMD \
Xilinx evaluation board machine configurations (Versal \
VCK/VEK/VMK/VPK/VRK, Versal Gen 2, Zynq UltraScale+, Zynq-7000, \
MicroBlaze)."
BBFILE_PATTERN_IGNORE_EMPTY_xilinx-bsp = "1"

LAYERDEPENDS_xilinx-bsp = "xilinx"

LAYERSERIES_COMPAT_xilinx-bsp = "scarthgap"
```

## meta-xilinx-bsp/conf/machine/a2197-zynqmp.conf
```bitbake
#@TYPE: Machine
#@NAME: a2197-zynqmp 
##@DESCRIPTION: Machine support for A2197 system controller.


SOC_VARIANT ?= "eg"

require conf/machine/include/tune-zynqmp.inc
require conf/machine/include/machine-xilinx-overrides.inc
require conf/machine/include/machine-xilinx-default.inc

MACHINE_FEATURES = "rtc ext2 ext3 vfat usbhost"

UBOOT_MACHINE = "xilinx_zynqmp_p_a2197_00_revA_defconfig"
SPL_BINARY ?= "spl/boot.bin"

SERIAL_CONSOLE = "115200 ttyPS0"
SERIAL_CONSOLES_CHECK = "${SERIAL_CONSOLES}"

PREFERRED_PROVIDER_virtual/kernel ?= "linux-xlnx"
PREFERRED_PROVIDER_virtual/bootloader ?= "u-boot-xlnx"

# PMU instance args
PMU_FIRMWARE_DEPLOY_DIR ?= "${TOPDIR}/pmutmp/deploy/images/zynqmp-pmu"
PMU_FIRMWARE_IMAGE_NAME ?= "pmu-firmware-zynqmp-pmu"

EXTRA_IMAGEDEPENDS += " \
   u-boot-zynq-uenv \
   arm-trusted-firmware \
   virtual/boot-bin \
   virtual/bootloader \
   u-boot-zynq-scr \
"
IMAGE_BOOT_FILES += " \
    uEnv.txt \
    atf-uboot.ub \
    boot.scr \
"
```

## meta-xilinx-bsp/conf/machine/ac701-microblazeel.conf
```bitbake
#@TYPE: Machine
#@NAME: ac701-microblazeel
#@DESCRIPTION: Machine configuration for the AC701 evaluation board.

#### Preamble
MACHINEOVERRIDES =. "${@['', 'ac701-microblazeel:']['ac701-microblazeel' !='${MACHINE}']}"
#### Regular settings follow

# Variables that changes based on hw design or board specific requirement must be
# defined before calling the required inclusion file else pre-expansion value
# defined in microblazeel-generic.conf will be set.

# Yocto AC701 FS-Boot variables
YAML_SERIAL_CONSOLE_STDIN:pn-fs-boot ?= "axi_uartlite_0"
YAML_SERIAL_CONSOLE_STDOUT:pn-fs-boot ?= "axi_uartlite_0"
YAML_MAIN_MEMORY_CONFIG:pn-fs-boot ?= "MIG_7SERIES_0"
YAML_FLASH_MEMORY_CONFIG:pn-fs-boot ?= "axi_quad_spi_0"
XSCTH_PROC:pn-fs-boot ?= "microblaze_0"

# Yocto AC701 device-tree variables
YAML_CONSOLE_DEVICE_CONFIG:pn-device-tree ?= "axi_uartlite_0"
YAML_MAIN_MEMORY_CONFIG:pn-device-tree ?= "MIG_7SERIES_0"
DT_PADDING_SIZE:pn-device-tree ?= "0x1000"
DTC_FLAGS:pn-device-tree ?= ""
XSCTH_PROC:pn-device-tree ?= "microblaze_0"
YAML_DT_BOARD_FLAGS ?= "{BOARD ac701-full}"

# Set DDR Base address for u-boot-xlnx-scr variables
DDR_BASEADDR ?= "0x80000000"
SKIP_APPEND_BASEADDR ?= "0"

# Required generic machine inclusion
require conf/machine/microblaze-generic.conf

# This machine conf file uses ac701-microblazeel xsa as reference input.
# User can override with ac701 custom xsa using HDF_BASE and HDF_PATH variables
# from local.conf.
HDF_MACHINE = "ac701-microblazeel"

#### No additional settings should be after the Postamble
#### Postamble
PACKAGE_EXTRA_ARCHS:append = "${@['', 'ac701_microblazeel']['ac701-microblazeel' != '${MACHINE}']}"
```

## meta-xilinx-bsp/conf/machine/cortexa53-zynqmp.conf
```bitbake
DEFAULTTUNE ?= "cortexa53"

require conf/machine/include/tune-cortexa53.inc

SOC_FAMILY = "zynqmp"
```

## meta-xilinx-bsp/conf/machine/cortexa72-versal.conf
```bitbake
DEFAULTTUNE ?= "cortexa72"

require conf/machine/include/tune-cortexa72.inc

SOC_FAMILY = "versal"
#LANGUAGES_append = ",lto"
```

## meta-xilinx-bsp/conf/machine/cortexr5-zynqmp.conf
```bitbake
DEFAULTTUNE ?= "cortexr5f"

require conf/machine/include/tune-cortexrm.inc

SOC_FAMILY = "zynqmp"
```

## meta-xilinx-bsp/conf/machine/include/board/ultra96.inc
```bitbake
# Ultra96 items that need to be configured from zynqmp-generic
KERNEL_DEVICETREE:ultra96 = "xilinx/zynqmp-zcu100-revC.dtb"

# Affects meta-xilinx-tools xsctyaml.bbclass related items
YAML_SERIAL_CONSOLE_STDIN:ultra96 ?= "psu_uart_1"
YAML_SERIAL_CONSOLE_STDOUT:ultra96 ?= "psu_uart_1"

YAML_COMPILER_FLAGS:append:ultra96 = " -DBOARD_SHUTDOWN_PIN=2 -DBOARD_SHUTDOWN_PIN_STATE=0 "

# Enable bluetooth and wifi module
MACHINE_ESSENTIAL_EXTRA_RDEPENDS:append:ultra96 = " linux-firmware-wl18xx linux-firmware-ti-bt-wl180x"
```
