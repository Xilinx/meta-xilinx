## conf/machine/zynqmp-zc1751-xm015-dc1.conf
```bitbake
#@TYPE: Machine
#@NAME: zynqmp-zc1751-xm015-dc1
#@DESCRIPTION: Machine support for ZC1751 DC1  Evaluation Board.
#

require conf/machine/include/tune-zynqmp.inc
require conf/machine/include/machine-xilinx-default.inc
require conf/machine/include/machine-xilinx-board.inc

MACHINE_FEATURES = ""

UBOOT_MACHINE = "xilinx_zynqmp_zc1751_xm015_dc1_config"

SERIAL_CONSOLE = "115200 ttyPS0"

KERNEL_DEVICETREE = "xilinx/zynqmp-zc1751-xm015-dc1.dtb"
KCONFIG_MODE = "--alldefconfig"

EXTRA_IMAGEDEPENDS += "arm-trusted-firmware"
```

## conf/machine/zynqmp-zcu102.conf
```bitbake
#@TYPE: Machine
#@NAME: zynqmp-zcu102
#@DESCRIPTION: Machine support for ZCU102 Evaluation Board.
#

require conf/machine/include/tune-zynqmp.inc
require conf/machine/include/machine-xilinx-default.inc
require conf/machine/include/machine-xilinx-board.inc

MACHINE_FEATURES = "rtc ext2 ext3 vfat usbhost"

UBOOT_MACHINE = "xilinx_zynqmp_zcu102_revB_defconfig"

SERIAL_CONSOLE = "115200 ttyPS0"

KERNEL_DEVICETREE = "xilinx/zynqmp-zcu102-revB.dtb"
KCONFIG_MODE = "--alldefconfig"

EXTRA_IMAGEDEPENDS += "\
		arm-trusted-firmware \
		"
```

## meta-amd-zephyr/conf/distro/amd-zephyr.conf
```bitbake
require conf/distro/amd-zephyr.inc

# User gets the amd-zephyr distro overrides
DISTROOVERRIDES =. "amd-zephyr:"
```

## meta-amd-zephyr/conf/layer.conf
```bitbake
# We have a conf and classes directory, add to BBPATH
BBPATH .= ":${LAYERDIR}"

# We have recipes-* directories, add to BBFILES
BBFILES += "${LAYERDIR}/recipes-*/*/*.bb \
            ${LAYERDIR}/recipes-*/*/*.bbappend"

BBFILE_COLLECTIONS += "amd-zephyr"
BBFILE_PATTERN_amd-zephyr = "^${LAYERDIR}/"
BBFILE_PRIORITY_amd-zephyr = "6"

LAYERSUMMARY_amd-zephyr = "AMD Zephyr RTOS distro and machines"
LAYERDESCRIPTION_amd-zephyr = "Distribution and machine layer for AMD \
Zephyr RTOS targets, including the amd-zephyr distro and the mbv32 / \
xenvmgicv3 Zephyr BOARD machine configurations."

LAYERDEPENDS_amd-zephyr = "\
    core \
    meta-python \
    zephyrcore \
    xilinx \
    xilinx-microblaze \
    virtualization-layer \
    "

LAYERSERIES_COMPAT_amd-zephyr = "scarthgap"

# Default to 4.3.0 version
AMD_ZEPHYR_VERSION[v2025.1] = "3.7.0"
AMD_ZEPHYR_VERSION[v2025.2] = "3.7.0"
AMD_ZEPHYR_VERSION[v2026.1] = "4.3.0"
PREFERRED_VERSION_zephyr-kernel ?= "${@d.getVarFlag('AMD_ZEPHYR_VERSION', d.getVar('XILINX_RELEASE_VERSION')) or 'undefined'}"

# Default to 0.17.4 SDK version
AMD_ZEPHYR_SDK_VERSION[v2025.1] = "0.16.8"
AMD_ZEPHYR_SDK_VERSION[v2025.2] = "0.17.1"
AMD_ZEPHYR_SDK_VERSION[v2026.1] = "0.17.4"
PREFERRED_VERSION_zephyr-sdk-native ?= "${@d.getVarFlag('AMD_ZEPHYR_SDK_VERSION', d.getVar('XILINX_RELEASE_VERSION')) or 'undefined'}"
```

## meta-amd-zephyr/conf/machine/mbv32.conf
```bitbake
#@TYPE: Machine
#@NAME: mbv32
#@DESCRIPTION: Yocto machine that builds Zephyr RTOS images for the Zephyr BOARD 'mbv32' (32-bit AMD MicroBlaze-V RISC-V soft processor).

# This machine file is demostrate building stock zephyr amd mbv32 board using
# meta-amd-zephyr layer.
require conf/machine/include/riscv/tune-riscv.inc

DEFAULTTUNE = "riscv32"

# Zephyr RTOS settings
ZEPHYR_BOARD = "mbv32"
ARCH:mbv32 = "riscv32"
DISTRO = "amd-zephyr"
```

## meta-amd-zephyr/conf/machine/xenvmgicv3.conf
```bitbake
#@TYPE: Machine
#@NAME: xenvmgicv3
#@DESCRIPTION: Yocto machine that builds Zephyr RTOS images for the Zephyr BOARD 'xenvm' running under a Xen hypervisor with a GICv3 interrupt controller (Arm aarch64 guest).

# Include tune-cortexa72-cortexa53.inc
require conf/machine/include/arm/armv8a/tune-cortexa72-cortexa53.inc

DEFAULTTUNE = "cortexa72-cortexa53"

# Zephyr RTOS settings
ZEPHYR_BOARD = "xenvm/xenvm/gicv3"
ARCH:xenvm = "aarch64"
DISTRO = "amd-zephyr"
```

## meta-dpdk/conf/layer.conf
```bitbake
# We have a conf and classes directory, add to BBPATH
BBPATH .= ":${LAYERDIR}"

# We have recipes-* directories, add to BBFILES
BBFILES += "${LAYERDIR}/recipes-*/*/*.bb \
            ${LAYERDIR}/recipes-*/*/*.bbappend"

BBFILE_COLLECTIONS += "dpdk"
BBFILE_PATTERN_dpdk := "^${LAYERDIR}/"
BBFILE_PRIORITY_dpdk = "5"

LAYERDEPENDS_dpdk = "core"

# This should only be incremented on significant changes that will
# cause compatibility issues with other layers
LAYERVERSION_dpdk = "1"
LAYERSERIES_COMPAT_dpdk = "kirkstone langdale"

BBFILES_DYNAMIC += " \
    clang-layer:${LAYERDIR}/dynamic-layers/clang-layer/*/*/*.bb \
    clang-layer:${LAYERDIR}/dynamic-layers/clang-layer/*/*/*.bbappend \
"
```

## meta-kc705/conf/layer.conf
```bitbake
# We have a conf and classes directory, add to BBPATH
BBPATH := "${BBPATH}:${LAYERDIR}"

# We have a packages directory, add to BBFILES
BBFILES := "${BBFILES} ${LAYERDIR}/recipes-*/*/*.bb"
BBFILES += " ${LAYERDIR}/recipes-*/*/*.bbappend"

BBFILE_COLLECTIONS += "kc705"
BBFILE_PATTERN_kc705 := "^${LAYERDIR}/"
BBFILE_PRIORITY_kc705 = "8"
```

## meta-kc705/conf/machine/kc705-trd.conf
```bitbake
#@TYPE: Machine
#@NAME: kc705-trd
#@DESCRIPTION: Machine support for Xilinx KC705 TRD.

TARGET_CPU = "microblazeel"
MACHINE_FEATURES := ""

require conf/machine/include/tune-microblaze.inc
TUNE_FEATURES_tune-microblaze += "v8.50 little-endian barrel-shift pattern-compare reorder multiply-low"

SERIAL_CONSOLE = "115200 ttyS0"
```

## meta-microblaze/conf/layer.conf
```bitbake
# We have a conf and classes directory, add to BBPATH
BBPATH .= ":${LAYERDIR}"

# We have a packages directory, add to BBFILES
BBFILES += "${LAYERDIR}/recipes-*/*/*.bb"
BBFILES += "${LAYERDIR}/recipes-*/*/*.bbappend"

BBFILE_COLLECTIONS += "xilinx-microblaze"
BBFILE_PATTERN_xilinx-microblaze = "^${LAYERDIR}/"
BBFILE_PRIORITY_xilinx-microblaze = "5"

LAYERDEPENDS_xilinx-microblaze = "core"

LAYERSERIES_COMPAT_xilinx-microblaze = "scarthgap"

# Microblaze does not support stack-protector!
SECURITY_STACK_PROTECTOR:microblaze = ""

OLDEST_KERNEL:microblaze = "3.15"

INHERIT += "rust_microblaze"

MICROBLAZE_SKIP_MSG = ""
MICROBLAZE_SKIP_MSG:microblaze = "This recipe does not currently work on microblaze."

# ../../../alsa-lib-1.2.9/src/control/control.c:3648:1: error: symver is only supported on ELF platforms
SKIP_RECIPE[alsa-lib] = "${MICROBLAZE_SKIP_MSG}"
```

## meta-vitis-tc/conf/layer.conf
```bitbake
# We have a conf and classes directory, add to BBPATH
BBPATH .= ":${LAYERDIR}"

# Keep layer path so recipes can reference it
VITIS_TC_PATH = "${LAYERDIR}"

# We have a packages directory, add to BBFILES
BBFILES += " \
		${LAYERDIR}/recipes-*/*/*.bb \
		${LAYERDIR}/recipes-*/*/*.bbappend"

BBFILE_COLLECTIONS += "vitis-tc"
BBFILE_PRIORITY_vitis-tc = "6"

LAYERSUMMARY_vitis-tc = "AMD Vitis baremetal cross-toolchain machines"
LAYERDESCRIPTION_vitis-tc = "Layer providing baremetal cross-toolchain \
machine .conf files (AArch32, AArch64, Cortex-R/M, MicroBlaze, \
MicroBlaze-V) and supporting recipes for AMD Vitis embedded software \
flows."
BBFILE_PATTERN_vitis-tc := "^${LAYERDIR}/"

LAYERDEPENDS_vitis-tc = "\
    core \
    xilinx \
    xilinx-microblaze \
    xilinx-standalone \
    "

LAYERSERIES_COMPAT_vitis-tc = "scarthgap"
```

## meta-vitis-tc/conf/machine/aarch32-tc.conf
```bitbake
require conf/machine/include/machine-xilinx-qemu.inc
require conf/multilib.conf
require conf/machine/include/arm/armv7a/tune-cortexa9.inc
require conf/machine/include/baremetal-tc.conf

# Define all of the multilibs supproted by this configuration
MULTILIB_GLOBAL_VARIANTS = "${@extend_variants(d,'MULTILIBS','multilib')}"

MULTILIBS  = ""
MULTILIBS += "multilib:libv7fphard"
MULTILIBS += "multilib:libv7afpthf"
MULTILIBS += "multilib:libv7asimdhard"
MULTILIBS += "multilib:libvtvesimdhf"
MULTILIBS += "multilib:libv8asimdhard"

TUNE_CCARGS = "${TUNE_CCARGS:tune-${DEFAULTTUNE}}"
TUNE_PKGARCH = "${TUNE_PKGARCH:tune-${DEFAULTTUNE}}"

# Base configuration
# CFLAGS:
DEFAULTTUNE = "aarch32"

AVAILTUNES += "aarch32"
PACKAGE_EXTRA_ARCHS:tune-aarch32 = "${TUNE_PKGARCH:tune-aarch32}"
BASE_LIB:tune-aarch32 = "lib"
TUNE_FEATURES:tune-aarch32 = "arm"
TUNE_CCARGS:tune-aarch32 = ""
TUNE_PKGARCH:tune-aarch32 = "aarch32"


# thumb/v7+fp/hard
# CFLAGS: -mthumb -march=armv7+fp -mfloat-abi=hard
DEFAULTTUNE:virtclass-multilib-libv7fphard = "armv7fphard"

AVAILTUNES += "armv7fphard"
PACKAGE_EXTRA_ARCHS:tune-armv7fphard = "${TUNE_PKGARCH:tune-armv7fphard}"
BASE_LIB:tune-armv7fphard = "lib/thumb/v7+fp/hard"
TUNE_FEATURES:tune-armv7fphard = "arm"
TUNE_CCARGS:tune-armv7fphard = "-mthumb -march=armv7+fp -mfloat-abi=hard"
TUNE_PKGARCH:tune-armv7fphard = "armv7fpthf"


# thumb/v7-a+fp/hard
# CFLAGS: -mthumb -march=armv7-a+fp -mfloat-abi=hard
DEFAULTTUNE:virtclass-multilib-libv7afpthf = "armv7afpthf"

AVAILTUNES += "armv7afpthf"
PACKAGE_EXTRA_ARCHS:tune-armv7afpthf = "${TUNE_PKGARCH:tune-armv7afpthf}"
BASE_LIB:tune-armv7afpthf = "lib/thumb/v7-a+fp/hard"
TUNE_FEATURES:tune-armv7afpthf = "arm"
TUNE_CCARGS:tune-armv7afpthf = "-mthumb -march=armv7-a+fp -mfloat-abi=hard"
TUNE_PKGARCH:tune-armv7afpthf = "armv7afpthf"


# thumb/v7-a+simd/hard
# CFLAGS: -mthumb -march=armv7-a+simd -mfloat-abi=hard
DEFAULTTUNE:virtclass-multilib-libv7asimdhard = "armv7asimdhard"

AVAILTUNES += "armv7asimdhard"
PACKAGE_EXTRA_ARCHS:tune-armv7asimdhard = "${TUNE_PKGARCH:tune-armv7asimdhard}"
BASE_LIB:tune-armv7asimdhard = "lib/thumb/v7-a+simd/hard"
TUNE_FEATURES:tune-armv7asimdhard = "arm"
TUNE_CCARGS:tune-armv7asimdhard = "-mthumb -march=armv7-a+simd -mfloat-abi=hard"
TUNE_PKGARCH:tune-armv7asimdhard = "armv7asimdthf"


# thumb/v7ve+simd/hard
# CFLAGS: -mthumb -march=armv7ve+simd -mfloat-abi=hard
DEFAULTTUNE:virtclass-multilib-libvtvesimdhf = "armvtvesimdhf"

AVAILTUNES += "armvtvesimdhf"
PACKAGE_EXTRA_ARCHS:tune-armvtvesimdhf = "${TUNE_PKGARCH:tune-armvtvesimdhf}"
BASE_LIB:tune-armvtvesimdhf = "lib/thumb/v7ve+simd/hard"
TUNE_FEATURES:tune-armvtvesimdhf = "arm"
TUNE_CCARGS:tune-armvtvesimdhf = "-mthumb -march=armv7ve+simd -mfloat-abi=hard"
TUNE_PKGARCH:tune-armvtvesimdhf = "armv7vesimdthf"


# thumb/v8-a+simd/hard
# CFLAGS:  -mthumb -march=armv8-a+simd -mfloat-abi=hard
DEFAULTTUNE:virtclass-multilib-libv8asimdhard = "armv8asimdhard"

AVAILTUNES += "armv8asimdhard"
PACKAGE_EXTRA_ARCHS:tune-armv8asimdhard = "${TUNE_PKGARCH:tune-armv8asimdhard}"
BASE_LIB:tune-armv8asimdhard = "lib/thumb/v8-a+simd/hard"
TUNE_FEATURES:tune-armv8asimdhard = "arm"
TUNE_CCARGS:tune-armv8asimdhard = "-mthumb -march=armv8-a+simd -mfloat-abi=hard"
TUNE_PKGARCH:tune-armv8asimdhard = "armv8asimdthf"
```
