## meta-xilinx-bsp/conf/machine/include/machine-xilinx-overrides.inc
```bitbake
SOC_VARIANT ??= ""
MACHINEOVERRIDES =. "${@['', '${SOC_FAMILY}${SOC_VARIANT}:']['${SOC_VARIANT}' != '']}"

INHERIT += "machine-overrides-extender"

MACHINEOVERRIDES_EXTENDER_zynqmpeg = "mali400"
MACHINEOVERRIDES_EXTENDER_zynqmpev = "mali400:vcu"
```

## meta-xilinx-bsp/conf/machine/include/soc-tune-include.inc
```bitbake
DEFAULTTUNE ??= "armv8a"

# Unfortunately various tunefiles don't include each other, so create
# a list of things to require based on the DEFAULTTUNE setting.
TUNEFILE[cortexr5] = "conf/machine/include/arm/armv7r/tune-cortexr5.inc"
TUNEFILE[cortexa9thf-neon] = "conf/machine/include/arm/armv7a/tune-cortexa9.inc"
TUNEFILE[armv8a] = "conf/machine/include/arm/arch-armv8a.inc"
TUNEFILE[cortexa53] = "conf/machine/include/arm/armv8a/tune-cortexa53.inc"
TUNEFILE[cortexa72] = "conf/machine/include/arm/armv8a/tune-cortexa72.inc"
TUNEFILE[cortexa72-cortexa53] = "conf/machine/include/arm/armv8a/tune-cortexa72-cortexa53.inc"
TUNEFILE[microblaze] = "conf/machine/include/xilinx-microblaze.inc"

# Default to arch-armv8a.inc
TUNEFILE = "${@ d.getVarFlag('TUNEFILE', d.getVar('DEFAULTTUNE')) or 'conf/machine/include/arm/arch-armv8a.inc'}"

require ${TUNEFILE}
```
