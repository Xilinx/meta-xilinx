## conf/machine/include/tune-zynqmp.inc
```bitbake
DEFAULTTUNE ?= "aarch64"
SOC_FAMILY ?= "zynqmp"

require conf/machine/include/arm/arch-armv8.inc
require conf/machine/include/soc-family.inc

# Linux Configuration
KERNEL_IMAGETYPE ?= "Image"

# Support multilib on zynqmp
DEFAULTTUNE_virtclass-multilib-lib32 ?= "armv7vethf-neon-vfpv4"
```

## conf/machine/include/zynqmp-pmu-config.inc
```bitbake
# Enable the use of zynqmp-pmu for specific recipes only
def zynqmp_pmu_enable_for_bpns(d):
    bpns = [
        "binutils",
        "gcc", "libgcc",
        "newlib", "libgloss",
        "pmu-firmware",
        ]
    return " zynqmp-pmu" if (d.getVar("BPN") in bpns) else ""

BBCLASSEXTEND_append = "${@zynqmp_pmu_enable_for_bpns(d)}"

# Add the pkgarch to the extra list, this is done to avoid warnings about
# missing manifests due to implicit dependency chains on populate_sysroot when
# a recipe/task depends on a IMAGE_EXTRADEPENDS/do_deploy task which is
# provided by a zynqmp-pmu-* target.
PACKAGE_EXTRA_ARCHS_append = " microblazeel-v9.2-bs-cmp"
```

## conf/machine/kc705-microblazeel.conf
```bitbake
#@TYPE: Machine
#@NAME: kc705-microblazeel
#@DESCRIPTION: Machine support for Xilinx KC705 Embedded Kit.
#

require conf/machine/include/tune-microblaze.inc
require conf/machine/include/machine-xilinx-default.inc
require conf/machine/include/machine-xilinx-board.inc

TUNE_FEATURES_tune-microblaze += "v9.6 barrel-shift pattern-compare multiply-high"

MACHINE_FEATURES = ""

USE_VT = ""
SERIAL_CONSOLE = "115200 ttyS0"

MACHINE_ESSENTIAL_EXTRA_RDEPENDS += "device-tree"

EXTRA_IMAGEDEPENDS += "virtual/bitstream"

PREFERRED_PROVIDER_virtual/bootloader ?= "u-boot-xlnx"
PREFERRED_VERSION_u-boot-xlnx ?= "v2016.07-xilinx-v2016.4%"
```

## conf/machine/kc705-trd-microblazeel.conf
```bitbake
#@TYPE: Machine
#@NAME: kc705-trd-microblazeel
#@DESCRIPTION: Machine support for Xilinx KC705 Embedded Kit TRD.
#
# Note: this TRD contains the 'Xylon logiSDHC' additional IP core, this is not
#       supported by this BSP.
#
# For details on the TRD and Evaluation board:
#     http://www.xilinx.com/products/boards-and-kits/DK-K7-EMBD-G.htm
# For documentation and design files for the TRD:
#     http://www.xilinx.com/support/index.html/content/xilinx/en/supportNav/boards_and_kits/kintex-7_boards_and_kits/kintex-7_fpga_embedded_kit.html
#

require conf/machine/include/tune-microblaze.inc
require conf/machine/include/machine-xilinx-default.inc
require conf/machine/include/machine-xilinx-board.inc

TUNE_FEATURES_tune-microblaze += "v8.50 little-endian barrel-shift pattern-compare reorder multiply-low"

MACHINE_FEATURES = ""

USE_VT = ""
SERIAL_CONSOLE = "115200 ttyS0"

MACHINE_ESSENTIAL_EXTRA_RDEPENDS += "device-tree"
MACHINE_DEVICETREE = "kc705/kc705-trd-microblazeel.dts"

EXTRA_IMAGEDEPENDS += "virtual/bitstream"
```

## conf/machine/microblaze.conf
```bitbake
#@TYPE: Machine
#@NAME: microblaze
#@DESCRIPTION: microblaze

TARGET_CPU = "microblaze"
MACHINE_FEATURES := ""

require conf/machine/include/tune-microblaze.inc

KERNEL_IMAGETYPE = "uImage"

SERIAL_CONSOLE = "115200 ttyS0"
```

## conf/machine/microblazeel.conf
```bitbake
#@TYPE: Machine
#@NAME: microblazeel
#@DESCRIPTION: Microblaze (Little Endian)

# The Microblaze machine differ from those of 'fixed' architectures like 
# arm as Microblaze can have each of its hardware tune features configured 
# independently.
# For this reason the user must define the TUNE_FEATURES_tune-microblaze 
# in the local.conf file. 
# An example is:
# TUNE_FEATURES_tune-microblaze += "little-endian v830 barrel-shift multiply-high multiply-low pattern-compare reorder divide-hard fpu-hard fpu-hard-extended"
# If no other feature is defined in local.conf, then no hardware 
# features will be enabled.

TARGET_CPU = "microblazeel"
MACHINE_FEATURES := ""

require conf/machine/include/tune-microblaze.inc

TUNE_FEATURES_tune-microblaze += "little-endian v830"

KERNEL_IMAGETYPE = "uImage"

SERIAL_CONSOLE = "115200 ttyS0"
```

## conf/machine/microzed-zynq7.conf
```bitbake
#@TYPE: Machine
#@NAME: microzed-zynq7
#@DESCRIPTION: Machine support for microZed. (http://www.microzed.org/)

require conf/machine/include/tune-zynq.inc
require conf/machine/include/machine-xilinx-default.inc
require conf/machine/include/machine-xilinx-board.inc

MACHINE_FEATURES = "ext2 vfat usbhost"

# u-boot configuration
UBOOT_MACHINE = "zynq_microzed_config"
SPL_BINARY = "spl/boot.bin"

SERIAL_CONSOLE = "115200 ttyPS0"

MACHINE_ESSENTIAL_EXTRA_RDEPENDS += "device-tree"
MACHINE_DEVICETREE = "microzed/microzed-zynq7.dts"

IMAGE_BOOT_FILES += "boot.bin ${MACHINE}.dtb"
```

## conf/machine/picozed-zynq7.conf
```bitbake
#@TYPE: Machine
#@NAME: picozed-zynq7
#@DESCRIPTION: Machine support for picoZed. (http://www.picozed.org/)
#
# Note: This machine configuration is intended as a generic config for
# the picozed SOM. It also covers the multiple SKUs for the picoZed
# including 7010, 7020, 7015 and 7030.

require conf/machine/include/tune-zynq.inc
require conf/machine/include/machine-xilinx-default.inc
require conf/machine/include/machine-xilinx-board.inc

MACHINE_FEATURES = "ext2 vfat usbhost usbgadget"

# u-boot configuration
UBOOT_MACHINE = "zynq_picozed_config"
SPL_BINARY = "spl/boot.bin"

SERIAL_CONSOLE = "115200 ttyPS0"

MACHINE_ESSENTIAL_EXTRA_RDEPENDS += "device-tree"
MACHINE_DEVICETREE = "picozed/picozed-zynq7.dts"

IMAGE_BOOT_FILES += "boot.bin ${MACHINE}.dtb"
```

## conf/machine/qemumicroblaze-s3adsp1800.conf
```bitbake
#@TYPE: Machine
#@NAME: qemumicroblaze-s3adsp1800
#@DESCRIPTION: MicroBlaze QEMU machine support ('petalogix-s3adsp1800' model)

require conf/machine/include/tune-microblaze.inc
require conf/machine/include/machine-xilinx-default.inc

TUNE_FEATURES_tune-microblaze += "v7.30 big-endian barrel-shift pattern-compare multiply-low"

MACHINE_FEATURES = ""

EXTRA_IMAGEDEPENDS += "qemu-native qemu-helper-native"

USE_VT = ""
SERIAL_CONSOLE = "115200 ttyUL0"

MACHINE_ESSENTIAL_EXTRA_RDEPENDS_remove = "device-tree"

# For runqemu
IMAGE_CLASSES += "qemuboot"
QB_SYSTEM_NAME = "qemu-system-microblaze"
QB_MEM = "-m 256"
QB_MACHINE = "-machine petalogix-s3adsp1800"
QB_OPT_APPEND = "-nographic -serial mon:stdio"
QB_DEFAULT_FSTYPE = "cpio"
QB_KERNEL_CMDLINE_APPEND = "console=ttyUL0 earlyprintk"
QB_TAP_OPT = "-netdev tap,id=net0,ifname=@TAP@,script=no,downscript=no -net nic,netdev=net0,macaddr=@MAC@"
QB_SLIRP_OPT = "-netdev user,id=net0 -net nic,netdev=net0"
```

## conf/machine/qemumicroblaze.conf
```bitbake
#@TYPE: Machine
#@NAME: qemumicroblaze
#@DESCRIPTION: MicroBlaze QEMU machine support ('petalogix-ml605' model)

require conf/machine/include/tune-microblaze.inc
require conf/machine/include/machine-xilinx-default.inc

TUNE_FEATURES_tune-microblaze += "v8.50 little-endian barrel-shift reorder pattern-compare divide-hard multiply-high fpu-hard"

MACHINE_FEATURES = ""

EXTRA_IMAGEDEPENDS += "qemu-native qemu-helper-native"

USE_VT = ""
SERIAL_CONSOLE = "115200 ttyS0"

# Use the networking setup from qemuarm
FILESOVERRIDES_append_pn-init-ifupdown = ":qemuarm"

# For runqemu
IMAGE_CLASSES += "qemuboot"
QB_SYSTEM_NAME = "qemu-system-microblazeel"
QB_MEM = "-m 256"
QB_MACHINE = "-machine petalogix-ml605"
QB_OPT_APPEND = "-nographic -serial mon:stdio"
QB_DEFAULT_FSTYPE = "cpio"
QB_KERNEL_CMDLINE_APPEND = "console=ttyS0 earlyprintk"
QB_TAP_OPT = "-netdev tap,id=net0,ifname=@TAP@,script=no,downscript=no -net nic,netdev=net0,macaddr=@MAC@"
QB_SLIRP_OPT = "-netdev user,id=net0 -net nic,netdev=net0"
```

## conf/machine/qemuzynq.conf
```bitbake
#@TYPE: Machine
#@NAME: qemuzynq
#@DESCRIPTION: Zynq QEMU machine support ('xilinx-zynq-a9' model)

require conf/machine/include/tune-zynq.inc
require conf/machine/include/machine-xilinx-default.inc

MACHINE_FEATURES = "ext2 vfat"

EXTRA_IMAGEDEPENDS += "qemu-native qemu-helper-native"

SERIAL_CONSOLE = "115200 ttyPS0"

MACHINE_ESSENTIAL_EXTRA_RDEPENDS += "device-tree"
MACHINE_DEVICETREE = "qemu/qemuzynq.dts"

# Use the networking setup from qemuarm
FILESOVERRIDES_append_pn-init-ifupdown = ":qemuarm"

# For runqemu
IMAGE_CLASSES += "qemuboot"
QB_SYSTEM_NAME = "qemu-system-arm"
QB_MEM = "-m 1024"
QB_MACHINE = "-machine xilinx-zynq-a9"
QB_DTB = "${MACHINE}.dtb"
QB_SERIAL_OPT = "-serial null -serial mon:stdio"
QB_OPT_APPEND = "-net nic -net nic -usb -usbdevice tablet"
QB_DEFAULT_FSTYPE = "cpio"
QB_KERNEL_CMDLINE_APPEND = "console=ttyPS0"
```

## conf/machine/qemuzynqmp.conf
```bitbake
#@TYPE: Machine
#@NAME: qemuzynqmp
#@DESCRIPTION: Zynq UltraScale+ QEMU machine support ('xlnx-zcu102' model)

MACHINEOVERRIDES =. "zcu102-zynqmp:"

require conf/machine/zcu102-zynqmp.conf

EXTRA_IMAGEDEPENDS += " \
                    qemu-native \
                    qemu-helper-native \
                    qemu-xilinx-native \
                    qemu-devicetrees \
                    "
```

## conf/machine/s3adsp1800-qemu-microblazeeb.conf
```bitbake
#@TYPE: Machine
#@NAME: s3adsp1800-qemu-microblazeeb
#@DESCRIPTION: MicroBlaze QEMU machine support ('petalogix-s3adsp1800' model)

require conf/machine/include/tune-microblaze.inc
require conf/machine/include/machine-xilinx-default.inc
require conf/machine/include/machine-xilinx-qemu.inc

TUNE_FEATURES_tune-microblaze += "v7.30 big-endian barrel-shift pattern-compare multiply-low"

MACHINE_FEATURES = ""

USE_VT = ""
SERIAL_CONSOLE = "115200 ttyUL0"

MACHINE_ESSENTIAL_EXTRA_RDEPENDS_remove = "device-tree"

# This machine is a targeting a QEMU model, runqemu setup:
QB_MEM = "-m 256"
QB_MACHINE = "-machine petalogix-s3adsp1800"
QB_OPT_APPEND = "-nographic -serial mon:stdio"
QB_TAP_OPT = "-netdev tap,id=net0,ifname=@TAP@,script=no,downscript=no -net nic,netdev=net0,macaddr=@MAC@"
QB_SLIRP_OPT = "-netdev user,id=net0 -net nic,netdev=net0"
```

## conf/machine/zc1254-zynqmp.conf
```bitbake
#@TYPE: Machine
#@NAME: zc1254-zynqmp
#@DESCRIPTION: Machine support for ZC1254 Evaluation Board.
#

require conf/machine/include/tune-zynqmp.inc
require conf/machine/include/machine-xilinx-default.inc
require conf/machine/include/machine-xilinx-board.inc
require conf/machine/include/machine-xilinx-qemu.inc

MACHINE_FEATURES = "rtc ext2 ext3 vfat usbhost"

UBOOT_MACHINE = "xilinx_zynqmp_zc1254_revA_defconfig"

SERIAL_CONSOLE = "115200 ttyPS0"

SERIAL_CONSOLES_CHECK = "${SERIAL_CONSOLES}"

KERNEL_DEVICETREE = "xilinx/zynqmp-zc1254-revA.dtb"
```

## conf/machine/zc1751-xm016-dc2-zynqmp.conf
```bitbake
#@TYPE: Machine
#@NAME: zynqmp-zc1751-xm016-dc2
#@DESCRIPTION: Machine support for ZC1751 DC2  Evaluation Board.
#

require conf/machine/include/tune-zynqmp.inc
require conf/machine/include/machine-xilinx-default.inc
require conf/machine/include/machine-xilinx-board.inc

MACHINE_FEATURES = ""

UBOOT_MACHINE = "xilinx_zynqmp_zc1751_xm016_dc2_defconfig"

SERIAL_CONSOLE = "115200 ttyPS0"

KERNEL_DEVICETREE = "xilinx/zynqmp-zc1751-xm016-dc2.dtb"
KCONFIG_MODE = "--alldefconfig"
```

## conf/machine/zc702-zynq7.conf
```bitbake
#@TYPE: Machine
#@NAME: zc702-zynq7
#@DESCRIPTION: Machine support for ZC702 Evaluation Board.
#
# For details on the Evaluation board:
#     http://www.xilinx.com/products/boards-and-kits/EK-Z7-ZC702-G.htm
# For documentation and design files for the ZC702:
#     http://www.xilinx.com/support/index.html/content/xilinx/en/supportNav/boards_and_kits/zynq-7000_soc_boards_and_kits/zynq-7000_soc_zc702_evaluation_kit.html
# For the FSBL 'zynq_fsbl_0.elf' refer to UG873 and the associated design files.
#

require conf/machine/include/tune-zynq.inc
require conf/machine/include/machine-xilinx-default.inc
require conf/machine/include/machine-xilinx-board.inc

MACHINE_FEATURES = "rtc ext2 ext3 vfat usbhost"

# u-boot configuration
UBOOT_MACHINE = "zynq_zc702_config"
SPL_BINARY = "spl/boot.bin"

SERIAL_CONSOLE = "115200 ttyPS0"

KERNEL_DEVICETREE = "zynq-zc702.dtb"
KERNEL_FEATURES += "features/rtc/rtc.scc"

IMAGE_BOOT_FILES += "boot.bin uEnv.txt ${KERNEL_IMAGETYPE}-zynq-zc702.dtb"
```

## conf/machine/zc706-zynq7.conf
```bitbake
#@TYPE: Machine
#@NAME: zc706-zynq7
#@DESCRIPTION: Machine support for ZC706 Evaluation Board.
#
# For details on the Evaluation board:
#     http://www.xilinx.com/products/boards-and-kits/EK-Z7-ZC706-G.htm
# For documentation and design files for the ZC702:
#     http://www.xilinx.com/support/index.html/content/xilinx/en/supportNav/boards_and_kits/zynq-7000_soc_boards_and_kits/zynq-7000_soc_zc706_evaluation_kit.html
# For the FSBL 'zynq_fsbl_0.elf' refer to UG873 and the associated design files.
#

require conf/machine/include/tune-zynq.inc
require conf/machine/include/machine-xilinx-default.inc
require conf/machine/include/machine-xilinx-board.inc

MACHINE_FEATURES = "rtc ext2 vfat usbhost usbgadget"

# u-boot configuration
UBOOT_MACHINE = "zynq_zc706_config"
SPL_BINARY = "spl/boot.bin"

SERIAL_CONSOLE = "115200 ttyPS0"

KERNEL_DEVICETREE = "zynq-zc706.dtb"
KERNEL_FEATURES += "features/rtc/rtc.scc"
```

## conf/machine/zcu100-zynqmp.conf
```bitbake
#@TYPE: Machine
#@NAME: zcu100-zynqmp
#@DESCRIPTION: Machine support for ZCU100 Evaluation Board.
#

require conf/machine/include/tune-zynqmp.inc
require conf/machine/include/machine-xilinx-default.inc
require conf/machine/include/machine-xilinx-board.inc
require conf/machine/include/machine-xilinx-qemu.inc

MACHINE_FEATURES = "rtc ext2 ext3 vfat usbhost qemu-system-xilinx wifi bluetooth"

UBOOT_MACHINE = "xilinx_zynqmp_zcu100_revB_defconfig"

SERIAL_CONSOLE = "115200 ttyPS0"

SERIAL_CONSOLES_CHECK = "${SERIAL_CONSOLES}"

KERNEL_DEVICETREE = "xilinx/zynqmp-zcu100-revB.dtb"

PREFERRED_PROVIDER_virtual/kernel ?= "linux-xlnx"
PREFERRED_PROVIDER_virtual/bootloader ?= "u-boot-xlnx"

MACHINE_ESSENTIAL_EXTRA_RRECOMMENDS += "zcu100-power-button wl18xx-fw"

# This machine has a QEMU model, runqemu setup:
# There is no ZCU100 in mainline, use the ZCU102
QB_MACHINE = "-machine xlnx-zcu102"
QB_MEM = "-m 2048"
QB_OPT_APPEND = "-nographic -serial null -serial mon:stdio"
# There is no Ethernet, which means no network for QEMU
QB_TAP_OPT = "-net none"
QB_SLIRP_OPT = "-net none"

# Xilinx QEMU options
QB_OPT_APPEND_append_qemuboot-xilinx = "${@qemuboot_xilinx_hw_devicetrees(d)}"
QB_OPT_APPEND_append_qemuboot-xilinx = "zcu100-arm.dtb "

# Load the boot media
QB_OPT_APPEND_append_qemuboot-xilinx = " -device loader,file=${DEPLOY_DIR_IMAGE}/arm-trusted-firmware.elf,cpu-num=0 \
		-device loader,file=${DEPLOY_DIR_IMAGE}/u-boot.elf \
		"

# Load the kernel image so the user can run 'booti 0x80000 0x6000000 0x4000000' to boot the kernel
QB_DEFAULT_FSTYPE_qemuboot-xilinx = "cpio.gz.u-boot"
QB_ROOTFS_OPT_qemuboot-xilinx = " -device loader,addr=0x6000000,file=@ROOTFS@,force-raw=true"
QB_OPT_APPEND_append_qemuboot-xilinx = " -device loader,addr=0x4000000,file=${DEPLOY_DIR_IMAGE}/${QB_DTB} \
		-device loader,addr=0x80000,file=${DEPLOY_DIR_IMAGE}/${KERNEL_IMAGETYPE} \
		"

# Reset and unhalt CPU0
QB_OPT_APPEND_append_qemuboot-xilinx = "${@qemuboot_xilinx_unhalt(d)}"

# Multi-arch options
QB_OPT_APPEND_append_qemuboot-xilinx-multi = " -machine-path ${DEPLOY_DIR_IMAGE}/qemu-tmp"

QB_OPT_XILINX_PMU_ROM ?= "/not/found"
QB_BACKGROUND_COMMAND_qemuboot-xilinx-multi = "${STAGING_BINDIR_NATIVE}/qemu-xilinx/qemu-system-microblazeel -M microblaze-fdt"
QB_BACKGROUND_COMMAND_append_qemuboot-xilinx-multi = " -display none ${@qemuboot_xilinx_hw_devicetrees(d)}/zynqmp-pmu.dtb"
QB_BACKGROUND_COMMAND_append_qemuboot-xilinx-multi = " -kernel ${QB_OPT_XILINX_PMU_ROM}"
QB_BACKGROUND_COMMAND_append_qemuboot-xilinx-multi = " -device loader,file=${DEPLOY_DIR_IMAGE}/pmu-firmware-${MACHINE}.elf"
QB_BACKGROUND_COMMAND_append_qemuboot-xilinx-multi = " -machine-path ${DEPLOY_DIR_IMAGE}/qemu-tmp"
QB_BACKGROUND_COMMAND_append_qemuboot-xilinx-multi = " -device loader,addr=0xfd1a0074,data=0x1011003,data-len=4 -device loader,addr=0xfd1a007C,data=0x1010f03,data-len=4"
```
