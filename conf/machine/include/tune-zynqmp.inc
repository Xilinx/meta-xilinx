## conf/machine/zcu102-zynqmp.conf
```bitbake
#@TYPE: Machine
#@NAME: zcu102-zynqmp
#@DESCRIPTION: Machine support for ZCU102 Evaluation Board.

require conf/machine/include/tune-zynqmp.inc
require conf/machine/include/machine-xilinx-default.inc
require conf/machine/include/machine-xilinx-board.inc
require conf/machine/include/machine-xilinx-qemu.inc
include conf/machine/include/zynqmp-pmu-config.inc

MACHINE_FEATURES = "rtc ext2 ext3 vfat usbhost"

UBOOT_MACHINE = "xilinx_zynqmp_zcu102_revB_defconfig"

SERIAL_CONSOLE = "115200 ttyPS0"
SERIAL_CONSOLES_CHECK = "${SERIAL_CONSOLES}"

KERNEL_DEVICETREE = "xilinx/zynqmp-zcu102-revB.dtb xilinx/zynqmp-zcu102.dtb"

PREFERRED_PROVIDER_virtual/kernel ?= "linux-xlnx"
PREFERRED_PROVIDER_virtual/bootloader ?= "u-boot-xlnx"
PREFERRED_PROVIDER_virtual/pmu-firmware ?= "zynqmp-pmu-pmu-firmware"

EXTRA_IMAGEDEPENDS += " \
		arm-trusted-firmware \
		qemu-devicetrees \
		virtual/pmu-firmware \
		"

# This machine has a QEMU model, runqemu setup:
IMAGE_CLASSES += "qemuboot-xilinx"
QB_MACHINE = "-machine xlnx-zcu102"
QB_MEM = "-m 4096"
QB_OPT_APPEND = "-nographic -serial mon:stdio -serial null"
QB_NETWORK_DEVICE = "-net nic -net nic -net nic -net nic,netdev=net0,macaddr=@MAC@"

# Use qemu-xilinx instead of mainline
PREFERRED_PROVIDER_qemu-helper-native = "qemu-xilinx-helper-native"

# Use the multiarch script instead of launching QEMU directly
QB_SYSTEM_NAME_append = "-multiarch"

# Setup hw-dtb, unhalt, atf and u-boot loading
QB_OPT_APPEND_append_qemuboot-xilinx = " \
		-hw-dtb ${DEPLOY_DIR_IMAGE}/qemu-hw-devicetrees/multiarch/zcu102-arm.dtb \
		${@qemu_zynqmp_unhalt(d, True)} \
		-device loader,file=${DEPLOY_DIR_IMAGE}/arm-trusted-firmware.elf,cpu-num=0 \
		-device loader,file=${DEPLOY_DIR_IMAGE}/u-boot.elf \
		"

# Load the kernel image so the user can run 'booti 0x80000 0x6000000 0x4000000' to boot the kernel
QB_DEFAULT_FSTYPE_qemuboot-xilinx = "cpio.gz.u-boot"
QB_ROOTFS_OPT_qemuboot-xilinx = " -device loader,addr=0x6000000,file=@ROOTFS@,force-raw=true"
QB_OPT_APPEND_append_qemuboot-xilinx = " \
		-device loader,addr=0x4000000,file=${DEPLOY_DIR_IMAGE}/${QB_DTB} \
		-device loader,addr=0x80000,file=${DEPLOY_DIR_IMAGE}/${KERNEL_IMAGETYPE} \
		-pmu-args '${QB_PMU_OPT}' \
		"

PMU_ROM ?= "${DEPLOY_DIR_IMAGE}/pmu-rom.elf"
QB_PMU_OPT = " \
		-M microblaze-fdt \
		-display none \
		-hw-dtb ${DEPLOY_DIR_IMAGE}/qemu-hw-devicetrees/multiarch/zynqmp-pmu.dtb \
		-kernel ${PMU_ROM} \
		-device loader,file=${DEPLOY_DIR_IMAGE}/pmu-${MACHINE}.elf \
		-device loader,addr=0xfd1a0074,data=0x1011003,data-len=4 \
		-device loader,addr=0xfd1a007C,data=0x1010f03,data-len=4 \
		"
```

## conf/machine/zcu106-zynqmp.conf
```bitbake
#@TYPE: Machine
#@NAME: zcu106-zynqmp
#@DESCRIPTION: Machine support for ZCU106 Evaluation Board.
#

require conf/machine/include/tune-zynqmp.inc
require conf/machine/include/machine-xilinx-default.inc
require conf/machine/include/machine-xilinx-board.inc

MACHINE_FEATURES = "rtc ext2 ext3 vfat usbhost"

UBOOT_MACHINE = "xilinx_zynqmp_zcu106_defconfig"

SERIAL_CONSOLE = "115200 ttyPS0"

KERNEL_DEVICETREE = "xilinx/zynqmp-zcu106.dtb"

PREFERRED_PROVIDER_virtual/kernel ?= "linux-xlnx"
PREFERRED_PROVIDER_virtual/bootloader ?= "u-boot-xlnx"
```

## conf/machine/zedboard-zynq7.conf
```bitbake
#@TYPE: Machine
#@NAME: zedboard-zynq7
#@DESCRIPTION: Machine support for ZedBoard. (http://www.zedboard.org/)
#
# For details on the Evaluation board:
#     http://www.zedboard.org/content/overview
# For design files (including 'zynq_fsbl_0.elf') for the ZedBoard:
#     http://www.zedboard.org/reference-designs-categories/zynq-concepts-tools-and-techniques-zedboard
#

require conf/machine/include/tune-zynq.inc
require conf/machine/include/machine-xilinx-default.inc
require conf/machine/include/machine-xilinx-board.inc

# Zedboard machine definition known by Xilinx UBOOT
UBOOT_MACHINE = "zynq_zed_config"

SERIAL_CONSOLE = "115200 ttyPS0"

MACHINE_DEVICETREE := " \
		zedboard/zedboard-zynq7-board.dtsi \
		zedboard/zedboard-zynq7.dts \
		"

IMAGE_BOOT_FILES += "boot.bin uEnv.txt ${MACHINE}.dtb"

EXTRA_IMAGEDEPENDS += "virtual/boot-bin"
```

## conf/machine/zybo-linux-bd-zynq7.conf
```bitbake
#@TYPE: Machine
#@NAME: zybo-linux-bd-zynq7
#@DESCRIPTION: Machine support for zybo-linux-bd project.
#
# generated base on ZYBO linux-bd project
#

require conf/machine/include/tune-zynq.inc
require conf/machine/include/machine-xilinx-default.inc
require conf/machine/include/machine-xilinx-board.inc

PREFERRED_PROVIDER_virtual/kernel ?= "linux-xlnx"
PREFERRED_PROVIDER_virtual/bootloader ?= "u-boot"

MACHINE_FEATURES = "ext2 vfat usbhost usbgadget keyboard screen alsa sdio"
SERIAL_CONSOLE = "115200 ttyPS0"

MACHINE_ESSENTIAL_EXTRA_RDEPENDS += "device-tree"

UBOOT_MACHINE = "zynq_zybo_config"
SPL_BINARY = "spl/boot.bin"
FORCE_PS7INIT = "zybo"

EXTRA_IMAGEDEPENDS += "virtual/bitstream"

IMAGE_BOOT_FILES += "boot.bin \
		${MACHINE}.dtb \
		bitstream \
		"

KERNEL_FEATURES += " \
		bsp/zybo-linux-bd-zynq7/zybo-snd.scc \
		bsp/digilent/drm-digilent.scc \
		features/gpio/kb-gpio.scc \
		features/v4l2/v4l2-xilinx.scc \
		"
```

## conf/machine/zybo-zynq7.conf
```bitbake
#@TYPE: Machine
#@NAME: zybo-zynq7
#@DESCRIPTION: Machine support for ZYBO.
#
# For details on the ZYBO board:
#     https://www.digilentinc.com/Products/Detail.cfm?Prod=ZYBO
#

require conf/machine/include/tune-zynq.inc
require conf/machine/include/machine-xilinx-default.inc
require conf/machine/include/machine-xilinx-board.inc

MACHINE_FEATURES = "ext2 vfat usbhost usbgadget"

# u-boot configuration
UBOOT_MACHINE = "zynq_zybo_config"
SPL_BINARY = "spl/boot.bin"

SERIAL_CONSOLE = "115200 ttyPS0"

KERNEL_DEVICETREE = "zynq-zybo.dtb"

IMAGE_BOOT_FILES += "boot.bin ${KERNEL_IMAGETYPE}-zynq-zybo.dtb"
```

## conf/machine/zynq.conf
```bitbake
#@TYPE: Machine
#@NAME: zynq
#@DESCRIPTION: zynq

MACHINE_FEATURES := ""

require conf/machine/include/tune-cortexa9.inc

KERNEL_IMAGETYPE = "uImage"

SERIAL_CONSOLE = "115200 ttyPS0"
```

## conf/machine/zynq7-zedboard.conf
```bitbake
#@TYPE: Machine
#@NAME: zynq7-zedboard
#@DESCRIPTION: Machine support for zedboard. (http://www.zedboard.org/)

# Versions corresponding to zedboard documentation
PREFERRED_VERSION_linux-xlnx ?= "3.8%"
PREFERRED_VERSION_u-boot-xlnx ?= "v2013.01%"

require conf/machine/include/tune-zynq.inc

# Zedboard machine definition known by Xilinx UBOOT
UBOOT_MACHINE = "zynq_zed_config"

SERIAL_CONSOLE = "115200 ttyPS0"

MACHINE_DEVICETREE := " \
		${XILINX_BOARDDIR}/zedboard/zynq7-zedboard.dtsi \
		${XILINX_BOARDDIR}/zedboard/zynq7-zedboard-mmcblkc0p2.dts \
		${XILINX_BOARDDIR}/zedboard/zynq7-zedboard-ram.dts \
		"
MACHINE_KCONFIG := " \
		${XILINX_BOARDDIR}/common/xilinx_zynq_defconfig_${LINUX_VERSION}.cfg \
		${XILINX_BOARDDIR}/common/nortc.cfg \
		"
```
