/*
 * Zedboard DTS file header for sdcard/mmc partition 2 boot.
 */

/dts-v1/;
/include/ "zynq7-zedboard.dtsi"
/ {
	chosen {
		bootargs = "console=ttyPS0,115200 root=/dev/mmcblk0p2 ro earlyprintk";
	} ;
} ;
